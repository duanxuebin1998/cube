/*
 * crc.c
 *
 *  Created on: Mar 19, 2025
 *      Author: Duan Xuebin
 */
#include <my_crc.h>
#include "crc.h"
#include "stdio.h"

/******************************
 * CRC 高字节表
 *******************************/
static const uint8_t auchCRCHi[256] = { 0x00, 0xC1, 0x81, 0x40, 0x01, 0xC0, 0x80, 0x41, 0x01, 0xC0, 0x80, 0x41, 0x00, 0xC1, 0x81, 0x40, 0x01, 0xC0, 0x80, 0x41,
		0x00, 0xC1, 0x81, 0x40, 0x00, 0xC1, 0x81, 0x40, 0x01, 0xC0, 0x80, 0x41, 0x01, 0xC0, 0x80, 0x41, 0x00, 0xC1, 0x81, 0x40, 0x00, 0xC1, 0x81, 0x40, 0x01,
		0xC0, 0x80, 0x41, 0x00, 0xC1, 0x81, 0x40, 0x01, 0xC0, 0x80, 0x41, 0x01, 0xC0, 0x80, 0x41, 0x00, 0xC1, 0x81, 0x40, 0x01, 0xC0, 0x80, 0x41, 0x00, 0xC1,
		0x81, 0x40, 0x00, 0xC1, 0x81, 0x40, 0x01, 0xC0, 0x80, 0x41, 0x00, 0xC1, 0x81, 0x40, 0x01, 0xC0, 0x80, 0x41, 0x01, 0xC0, 0x80, 0x41, 0x00, 0xC1, 0x81,
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		0xC0, 0x80, 0x41, 0x01, 0xC0, 0x80, 0x41, 0x00, 0xC1, 0x81, 0x40 };

/************************
 *CRC 低字节表
 ***********************/
static const uint8_t auchCRCLo[256] = { 0x00, 0xC0, 0xC1, 0x01, 0xC3, 0x03, 0x02, 0xC2, 0xC6, 0x06, 0x07, 0xC7, 0x05, 0xC5, 0xC4, 0x04, 0xCC, 0x0C, 0x0D, 0xCD,
		0x0F, 0xCF, 0xCE, 0x0E, 0x0A, 0xCA, 0xCB, 0x0B, 0xC9, 0x09, 0x08, 0xC8, 0xD8, 0x18, 0x19, 0xD9, 0x1B, 0xDB, 0xDA, 0x1A, 0x1E, 0xDE, 0xDF, 0x1F, 0xDD,
		0x1D, 0x1C, 0xDC, 0x14, 0xD4, 0xD5, 0x15, 0xD7, 0x17, 0x16, 0xD6, 0xD2, 0x12, 0x13, 0xD3, 0x11, 0xD1, 0xD0, 0x10, 0xF0, 0x30, 0x31, 0xF1, 0x33, 0xF3,
		0xF2, 0x32, 0x36, 0xF6, 0xF7, 0x37, 0xF5, 0x35, 0x34, 0xF4, 0x3C, 0xFC, 0xFD, 0x3D, 0xFF, 0x3F, 0x3E, 0xFE, 0xFA, 0x3A, 0x3B, 0xFB, 0x39, 0xF9, 0xF8,
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		0x47, 0x46, 0x86, 0x82, 0x42, 0x43, 0x83, 0x41, 0x81, 0x80, 0x40 };

/**
 * @brief CRC16/MODBUS 校验计算
 * @param data 输入数据指针
 * @param length 数据长度（字节）
 * @return 16位CRC校验值
 */
uint16_t CRC16_Calculate(const uint8_t *data, uint32_t length) {
	uint8_t crc_hi = 0xFF;
	uint8_t crc_lo = 0xFF;

	while (length--) {
		uint8_t index = crc_lo ^ *data++;
		crc_lo = crc_hi ^ auchCRCHi[index];
		crc_hi = auchCRCLo[index];
	}

	return (crc_hi << 8) | crc_lo;
}
/*接收到的数据包进行CRC校验*/
/* 接收到的数据包进行CRC校验 */
bool SlaveCheckCRC(uint8_t const *revframe, int framelen) {
    unsigned char Hi, Lo;
    unsigned short crc;

    // 修复类型不匹配问题
    crc = CRC16_Calculate((const unsigned char *)revframe, framelen - 2);

    Lo = crc & 0x00ff;
    Hi = crc >> 8;

    if ((Hi != revframe[framelen - 1]) || (Lo != revframe[framelen - 2])) {
        printf("CRC Error: Calc Hi=%02x, Lo=%02x | Frame Hi=%02x, Lo=%02x\r\n",
              Hi, Lo,
              (unsigned char)revframe[framelen - 1],
              (unsigned char)revframe[framelen - 2]);
        return false;
    }
    return true;
}


/* lenBytes 必须是 4 的倍数，不足时用 0 填充 */
uint32_t CRC32_HAL(const uint8_t *buf, uint32_t lenBytes) {
	uint32_t word, crc;
	uint32_t words = lenBytes >> 2;                // HAL 接口的长度单位是“32-bit word” :contentReference[oaicite:3]{index=3}
	crc = HAL_CRC_Calculate(&hcrc, (uint32_t*) buf, words);

	/* 处理尾部 1‒3 个字节 */
	uint8_t remain = lenBytes & 3U;
	if (remain) {
		word = 0;
		memcpy(&word, buf + (words << 2), remain);
		crc = HAL_CRC_Accumulate(&hcrc, &word, 1);
	}

	return crc;   // HAL 已做反射，这里做最后一步取反
}
/* --------------- 测试用例表 -------------- */
typedef struct {
	const char *name; /* 用例名 */
	const uint8_t *data; /* 数据指针 */
	uint32_t len; /* 数据长度（字节） */
	uint32_t expect; /* 期望 CRC32 */
} CRC_TestCase;

static const uint8_t vector1[] = "123456789"; /* 0xCBF43926 */
static const uint8_t vector2[] = { 0x00 }; /* 0xD202EF8D */
static const uint8_t vector3[] = { 0x01, 0x02, 0x03, 0x04, 0x05, 0x06, 0x07, 0x08, 0x09, 0x0A }; /* 0xE3069283 */

static const CRC_TestCase kCases[] = { { "ASCII 123456789", vector1, sizeof(vector1) - 1, 0xAFF19057 }, { "Single 0x00 Byte", vector2, sizeof(vector2),
		0xC704DD7B }, { "10‑byte Incremental", vector3, sizeof(vector3), 0xE8008411 }, };
#define CASE_COUNT (sizeof(kCases)/sizeof(kCases[0]))

/* ---------------- 测试主函数 ------------- */
void CRC32_HAL_Test(void) {
	uint32_t ok = 0;

	printf("\r\n===== CRC32_HAL 单元测试开始 =====\r\n");
	for (uint32_t i = 0; i < CASE_COUNT; ++i) {
		const CRC_TestCase *c = &kCases[i];
		uint32_t crc = CRC32_HAL(c->data, c->len);

		printf("[%lu] %s : 0x%08lX  (期望 0x%08lX)  ... ", (unsigned long) i, c->name, (unsigned long) crc, (unsigned long) c->expect);

		if (crc == c->expect) {
			printf("PASS\r\n");
			++ok;
		} else {
			printf("FAIL\r\n");
		}
	}

	printf("===== 全部 %lu/%lu 用例通过! =====\r\n", (unsigned long) ok, (unsigned long) CASE_COUNT);
}
