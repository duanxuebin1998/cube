#include "Display.h"
#include "hgs.h"
#include "stdlib.h"
#include "math.h"
#include "exit.h"
#include "modbus_agreement.h"
#include "display_tankopera.h"



#define DEBUG_DISPLAY 0

//struct ScreenDisplay SDisPosi;
struct ScreenPARA screen_parameter = {0};//屏幕存储参数
static bool flag_bright = false;            //亮屏标志位


static int PageAmount = 0;                  //总共显示几页
static bool flagofoillevelvalid = false;    //是否显示液位
static bool FlagofTotalTwoRow = false;      //标志位 - 总共要显示的内容只有两行
#define PARA_X 0
#define PARA_PAGE 1
#define PARA_NUM 2
#define PARA_VALID 3
enum{//用于记录每个参数显示在第几页第几行
    Para_AveDensity = 0,
    Para_AveTemperature,
    Para_Waterlevel,
    Para_Pressure,
    Para_Pressure2,
    Para_gsw,
    Para_tov,
    Para_flow_v_pipe,
    Para_flux,
    Para_alarm,
    Para_current,
    Para_weight,
    Para_position,
    Para_wireless_t,
    Para_V,
    Para_VMax,
    Para_VMin,
    
    Para_Amount,
};
static int ValidParaDisArr[Para_Amount][4] = {0};


/*字库索引数组*/
static uint8_t StockMap[] = "通讯尝试中液位跟随密度温℃版本水测量完成寻找标定零点校正获取称重步进未知无线提浮子至置阈值"
                            "向下运行上故障设备初始化罐底综合国满载空仪表配模式检修读实时区间每米自带宽拟静止电压效流速"
                            "力质体积磁致伸缩新老雷达计一机变送器算方轮询加转包抓主协议软件对外集超从待回检修单到监分布"
                            "部参数编码圈恢复出厂文份指令操作在←是否入返确认？退与显示换混相关据源气案改非法请输清写铁"
                            "失败直接隐藏字不范围异常油品类型保顶盘起高支撑原润滑苯胺乙烯丙酮酸甲酯丁腈冰二甲氯烷醇芳烃"
                            "环己氧基叔醚醛溶精制卤聚多元糠呋喃邻辛硫三偏硝盐氢钠仲石拱卧"
                            "球形蒸汽尺距离开手启闭短地址扫描路只能连台功打印容稍等几钟储管道径周期调低于盲报警语言发错"
                            "误础界面程序减比股长介信号后限例权屏幕维护视终继状态最探头浸小第悬停禁用弦工固产反先动当前"
                            "大英更传层滞域使磨结束针总阻六级内息命感顺有阈值角导本整";
static const int StockmapLength = (sizeof(StockMap) - 1) / 2; /*索引数组总文字个数*/
static const int wordbyte = 2;//一个汉字由几个字节组成
static uint8_t WordStock[255 * 28] =
{
    0x47,0xF0,0x21,0x20,0x20,0xC0,0x07,0xF0,0x04,0x90,0xE4,0x90,0x27,0xF0,0x24,0x90,0x24,0x90,0x27,0xF0,0x24,0x90,0x24,0xB0,0x50,0x00,0x8F,0xF8,/*"通",0*/
    0x40,0x00,0x2F,0xE0,0x22,0x20,0x02,0x20,0x02,0x20,0xE2,0x20,0x2F,0xE0,0x22,0x20,0x22,0x20,0x22,0x28,0x2A,0x28,0x32,0x28,0x22,0x18,0x02,0x08,/*"讯",1*/
    0x02,0x00,0x22,0x20,0x12,0x40,0xFF,0xF8,0x80,0x08,0x80,0x08,0x1F,0xC0,0x00,0x00,0x00,0x00,0x7F,0xF0,0x08,0x00,0x10,0x40,0x3F,0xE0,0x00,0x20,/*"尝",2*/
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    0x00,0x40,0x7F,0x40,0x48,0x40,0x48,0x40,0x48,0x60,0x7E,0x50,0x42,0x48,0x42,0x48,0x7E,0x40,0x48,0x40,0x48,0x40,0x48,0x40,0x7F,0x40,0x00,0x40,/*"卧",29*/

};

static uint8_t WordStock2[255 * 28] =
{
    0x00,0x50,0x00,0x48,0xF8,0x40,0x23,0xF8,0x20,0x40,0x22,0x48,0xF9,0x50,0x20,0x60,0x20,0xE0,0x21,0x50,0x3A,0x50,0xE4,0x48,0x00,0x40,0x01,0xC0,/*"球",30*/
    0x00,0x10,0x7E,0x10,0x24,0x20,0x24,0x40,0x24,0x90,0x24,0x10,0xFF,0x20,0x24,0x40,0x24,0x88,0x24,0x08,0x24,0x10,0x24,0x20,0x44,0x40,0x84,0x80,/*"形",31*/
    0x08,0x80,0xFF,0xF8,0x08,0x80,0x3F,0xC0,0x00,0x80,0x7D,0x10,0x09,0xA0,0x31,0x60,0xC7,0x18,0x00,0x00,0x3F,0xE0,0x00,0x00,0x48,0x90,0x84,0x48,/*"蒸",0*/
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	0x10,0x80,0xFE,0x80,0x10,0xF8,0x7D,0x10,0x56,0xA0,0x7C,0x40,0x38,0xA0,0x55,0x18,0x90,0x00,0x7F,0xF0,0x02,0x00,0x13,0xE0,0x12,0x00,0xFF,0xF8,/*"整",0*/


};
static uint8_t NumberStock[] = {

0x00,0x00,0x00,0x3C,0x66,0x6E,0x6E,0x66,0x76,0x76,0x66,0x3C,0x00,0x00,/*"0",0*/
0x00,0x00,0x00,0x0C,0x1C,0x7C,0x0C,0x0C,0x0C,0x0C,0x0C,0x0C,0x00,0x00,/*"1",1*/
0x00,0x00,0x00,0x3C,0x66,0x66,0x06,0x0C,0x18,0x30,0x60,0x7E,0x00,0x00,/*"2",2*/
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0x00,0x00,0x00,0x00,0x00,0x00,0x00,0x7E,0x00,0x00,0x00,0x00,0x00,0x00,/*"-",11*/

};

static uint8_t CharStockMap[] = "abcdefghijklmnopqrstuvwxyzABCDEFGHIJKLMNOPQRSTUVWXYZ./0123456789: +-?!%()";
static const int CharStockMapLength = (sizeof(CharStockMap) - 1);
static uint8_t CharStock[] = {

0x00,0x00,0x00,0x00,0x00,0x3C,0x06,0x06,0x3E,0x66,0x66,0x3E,0x00,0x00,/*"a",0*/
0x00,0x00,0x00,0x60,0x60,0x7C,0x66,0x66,0x66,0x66,0x66,0x7C,0x00,0x00,/*"b",1*/
0x00,0x00,0x00,0x00,0x00,0x3C,0x66,0x60,0x60,0x60,0x66,0x3C,0x00,0x00,/*"c",2*/
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0x00,0x00,0x00,0x30,0x18,0x18,0x0C,0x0C,0x0C,0x0C,0x0C,0x18,0x18,0x30,/*")",72*/
};

static uint8_t aubonlogo_128_64[] = {
0x00,0x1F,0x00,0x00,0x07,0xC0,0x00,0x00,0x00,0x00,0x00,0x00,0x00,0x00,0x00,0x00,0x00,0x1F,0x00,0x00,0x07,0x80,0x00,0x00,0x00,0x00,0x00,0x00,0x00,0x00,0x00,0x00,
0x00,0x3F,0x00,0x00,0x07,0x80,0x00,0x00,0x00,0x00,0x00,0x1C,0x00,0x03,0x80,0x00,0x00,0x3F,0x00,0x00,0x07,0x80,0x00,0x00,0x00,0x00,0x0C,0x1C,0x00,0x03,0x80,0x00,
0x00,0x3F,0x00,0x00,0x07,0x80,0x00,0x00,0x00,0x00,0x0C,0x18,0x00,0x03,0x80,0x00,0x00,0x3F,0x00,0x00,0x07,0x80,0x00,0x00,0x00,0x00,0x0C,0x18,0x00,0x03,0x83,0xF0,
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0xFC,0x07,0xC7,0xBE,0x79,0xE0,0x1F,0x83,0xC3,0xC0,0x33,0x00,0x1C,0x40,0x1C,0x00,0xF8,0x07,0xC7,0x3E,0x78,0xC0,0x0F,0x03,0xC7,0xC0,0x70,0x00,0x04,0x00,0x18,0x00,/*"C:\Users\ADMIN\Pictures\AUBON_128_64.bmp",0*/


};




static uint8_t matchingwordstock(uint8_t **display,int cnt,int x,int y,int shift);
static uint8_t judgedecimals(int value);
static uint8_t dis_number(int sgn,int value,int points,uint8_t line,uint8_t row,uint8_t shift,uint8_t deci);
static void oled_workingdata(void);
static void oled_equipment(void);
static void CalculateValidPara(void);
static void DIS_Equipment(void);
static bool ScreenOff( void );
static void SetScreenOff( void );


/*
**功能：显示汉字和字符
**参数：display - 指向要显示的字符串的指针的指针
        cnt - 显示汉字的个数
        x - 屏幕横坐标
        y - 屏幕纵坐标
        shift - 阴码阳码选项
**返回值：无
*/
static uint8_t matchingwordstock(uint8_t **display,int cnt,int x,int y,int shift)
{
    int i,j;
    const uint8_t *pdisplay;
    uint8_t *pstockmap;

    pdisplay = *display;/*指向要显示的字符串首地址*/
    for(i = 0;i < cnt;)
    {
        if(x >= OLED_LINE8_END)
            break;
        if((*pdisplay) < 128)
        {
            pstockmap = CharStockMap;
            for(j=0;j<CharStockMapLength;j++)
            {
                if(*pstockmap == *pdisplay)
                {
                    write_816(x,y,CharStock,j,shift);
                }
                pstockmap++;
            }
            x += 4;
            pdisplay++;
            i++;
        }
        else
        {
            pstockmap = StockMap;/*指向索引字库首地址*/
            /*遍历字库中是否有要显示的汉字*/
            for(j = 0;j< StockmapLength ;j++)
            {
                if((*pstockmap == *pdisplay) && (*(pstockmap + 1)== *(pdisplay + 1)))
                {
                    if(j < 255)//第一个字库255汉字
                    {
                        write_hanzi16(x,y,WordStock,j,j + 1,shift);
                    }
                    else 
                    {
                        write_hanzi16(x,y,WordStock2,j - 255,j + 1 - 255,shift);
                    }
                    break;
                }
                /*一个汉字占两个字节,所以索引指针每次加2*/
                pstockmap += wordbyte;
            }
            /*无论字库是否包含要显示的字,位置都向右移,字库中没有的空出位置*/
            x += 7;
            pdisplay += wordbyte;
            i += wordbyte;
        }
    }
    return x;
}
/* 显示多个汉字或字符 */
uint8_t OledDisplayLineWords(uint8_t* data,uint8_t x,uint8_t y,uint8_t shift)
{
    int len = 0;
    if(data == NULL) 
        return y;
    while(*(data + len) != 0)
    {
        len++;
    }
    y = matchingwordstock(&data,len,x,y,shift);
    return y;
}
/* 设备刚上电还未与CPU2通讯时显示初始化中 */
void EquipFirstPower(void)
{
    int line;
    oled_clear();
    DisplayLangaugeLineWords((uint8_t*)"通讯尝试中...",0,OLED_ROW4_1,0,(u8*)"Communicate Attempt...");
    line = DisplayLangaugeLineWords((uint8_t*)"版本:",0,OLED_ROW4_2,0,(u8*)"Version:");
    OledValueDisplay(CPU3VERSION,line,OLED_ROW4_2,0,3,NULL);
}
/* 刚上电时显示logo */
void DisplayAubonLogo(void)
{
    HAL_Delay(1000);
    HAL_Delay(1000);
    oled_map_128_64(aubonlogo_128_64);
    HAL_Delay(1000);
    HAL_Delay(1000);
    HAL_Delay(1000);
    HAL_Delay(1000);
    RefreshScreen();//显示完logo后立刻刷新一下屏幕
}
/* 显示设备数据 */
static void oled_workingdata(void)
{
    oled_clear();
    /* 显示设备状态 */
    oled_equipment();
}
/* 显示一个数字 */
uint8_t OledDisplayOneNmb(int c,uint8_t row,uint8_t line,uint8_t shift)
{
    write_816(line,row,NumberStock,c,shift);
    return (line + 4);
}
/* 显示数据 */
uint8_t OledValueDisplay(int value,uint8_t line,uint8_t row,uint8_t shift,uint8_t points,uint8_t* unit)
{
    uint8_t deci;
    int sgn = 1;
    //求出要显示的数据的总位数及符号
    deci = judgedecimals(value);
    if(value < 0)
    {
        sgn = -1;
        value = abs(value);
    }
    //显示数值
    line = dis_number(sgn,value,points,line,row,shift,deci);
    //显示单位
    if(unit != NULL)
        line = OledDisplayLineWords(unit,line,row,shift);
    return line;
}
/* 计算数值位数 */
static uint8_t judgedecimals(int value)
{
    uint8_t cnt = 1;
    uint32_t number;

    number = abs(value);
    while(number / 10)
    {
        cnt++;
        number /= 10;
    }
    return cnt;
}
/* 显示数字 */
static uint8_t dis_number(int sgn,int value,int points,uint8_t line,uint8_t row,uint8_t shift,uint8_t deci)
{
    int i;
    int n;

    //若有负号先显示出负号
    if(sgn == -1)
        line = OledDisplayOneNmb(11,row,line,shift);
    //显示数字
    if(deci <= points)
        line = OledDisplayOneNmb(0,row,line,shift);
    
    for(i = deci - 1;i >= points;i--)
    {
        n = value / pow(10,i) ;
        line = OledDisplayOneNmb(n,row,line,shift);
        value %= (uint32_t)pow(10,i);
    }
    if(points > 0)
    {
        line = OledDisplayOneNmb(10,row,line,shift);
        line -= 2;
        for(i = points - 1;i >= 0;i--)
        {
            n = value / pow(10,i) ;
            line = OledDisplayOneNmb(n,row,line,shift);
            value %= (uint32_t)pow(10,i);
        }
    }
    return line;
}
/* 显示模块初始化 */
void DisplayInit(void)
{
    OLED_Init();    //屏幕初始化
//    Timer7Init();   //长按确定键计时定时器
//    Timer1Init();   //检测按键,超时退出罐上操作定时器
//    Timer6Init();   //刷新屏幕定时器
//    Timer6Start(3);//3S刷新一次屏幕状态
//    readParaInit();
    ClearPageNum();
    InputValueInit();
}

/* 刷新屏幕 */
void RefreshScreen(void)
{
    if(FlagofTankOpera == false)
    {

        if(ScreenOff()) {
            oled_clear();
        }
        else
        {
            SetScreenOff();
            if(cnt_commutoCPU2 >= COMMU_ERROR_MAX)
                EquipFirstPower();
            else
                oled_workingdata();
        }
    }
}
/* 显示设备状态 */
static void oled_equipment(void)
{
    static int now_page = 0;
    u8 row = OLED_ROW4_2,line = 0;
    
    now_page++;
    if(now_page >= PageAmount)
    {
        now_page = 0;
    }
    //统计有多少个有效参数,并计算总页数
    CalculateValidPara();
    //显示当前设备状态
    DIS_Equipment();
    //液位
    if(flagofoillevelvalid == true)
    {
        if(FlagofTotalTwoRow == true)
            row = OLED_ROW4_3;
        else
            row = OLED_ROW4_2;
        line = DisplayLangaugeLineWords((u8*)"液位:",OLED_LINE8_1,row,0,(u8*)"Level:");
        if(inputValue.OilLevel == OILLEVELDOWNLIMIT)
            DisplayLangaugeLineWords((u8*)"低于盲区",line,row,0,(u8*)"Below Blind");
        else
            OledValueDisplay(inputValue.OilLevel,line,row,0,1,(u8*)"mm");
    }
    //水位
    if(ValidParaDisArr[Para_Waterlevel][PARA_VALID] == true && now_page == ValidParaDisArr[Para_Waterlevel][PARA_PAGE])
    {
        row = ValidParaDisArr[Para_Waterlevel][PARA_X];
        line = DisplayLangaugeLineWords((u8*)"水位:",OLED_LINE8_1,row,0,(u8*)"Water:");
        if(inputValue.WaterLevel == OILLEVELDOWNLIMIT)
            DisplayLangaugeLineWords((u8*)"低于盲区",line,row,0,(u8*)"Below Blind");
        else
            OledValueDisplay(inputValue.WaterLevel,line,row,0,1,(u8*)"mm");
    }
    //密度
    if(ValidParaDisArr[Para_AveDensity][PARA_VALID] == true && now_page == ValidParaDisArr[Para_AveDensity][PARA_PAGE])
    {
        row = ValidParaDisArr[Para_AveDensity][PARA_X];
        line = DisplayLangaugeLineWords((u8*)"密度:",OLED_LINE8_1,row,0,(u8*)"D:");
        OledValueDisplay(inputValue.SPM_Density,line,row,0,1,(u8*)"kg/m3");
    }
    //温度
    if(ValidParaDisArr[Para_AveTemperature][PARA_VALID] == true && now_page == ValidParaDisArr[Para_AveTemperature][PARA_PAGE])
    {
        row = ValidParaDisArr[Para_AveTemperature][PARA_X];
        line = DisplayLangaugeLineWords((u8*)"温度:",OLED_LINE8_1,row,0,(u8*)"Temp:");
        OledValueDisplay(inputValue.SPM_Temperature,line,row,0,1,(u8*)"℃");
    }
 
    //位置
    if(ValidParaDisArr[Para_position][PARA_VALID] == true && now_page == ValidParaDisArr[Para_position][PARA_PAGE])
    {
        row = ValidParaDisArr[Para_position][PARA_X];
        line = DisplayLangaugeLineWords((u8*)"位置:",OLED_LINE8_1,row,0,(u8*)"Pos:");
        OledValueDisplay(inputValue.RealtimePosition,line,row,0,1,(u8*)"mm");
    }
}
/* 显示多个汉字或字符 - 带中英文选择 */
uint8_t DisplayLangaugeLineWords(uint8_t* name1,uint8_t line,uint8_t row,uint8_t shift,uint8_t* name2)
{
    if(screen_parameter.language == LANGUAGE_CHINESE || name2 == NULL)
        line = OledDisplayLineWords(name1,line,row,shift);
    else if(screen_parameter.language == LANGUAGE_ENGLISH)
        line = OledDisplayLineWords(name2,line,row,shift);
    return line;
}

/* 计算要显示的参数个数 */
static void CalculateValidPara(void)
{
    static int ValidParaCnt = 0;//需要显示的有效参数
    static u8 start_x = 0;
    static int rowsperpage = 2;
    int i;
    
    /******计算总共有多少个有效参数需要显示******/
    ValidParaCnt = 0;
    //液位
    if((inputValue.OilLevel == UNVALID_LEVEL )||(inputValue.OilLevel == 0 ))
    {
        flagofoillevelvalid = false;
    }
    else
    {
        flagofoillevelvalid = true;
    }
    //密度
    if(!(inputValue.SPM_Density == UNVALID_DENSITY ))
    {
        ValidParaCnt++;
        ValidParaDisArr[Para_AveDensity][PARA_NUM] = ValidParaCnt;
		
        ValidParaDisArr[Para_AveDensity][PARA_VALID] = true;
    }
    else
        ValidParaDisArr[Para_AveDensity][PARA_VALID] = false;
    //温度
    if((inputValue.SPM_Temperature > UNVALID_TEMPERATURE_WIRELESS )&&(inputValue.SPM_Temperature <2000 ))
    {
        ValidParaCnt++;
        ValidParaDisArr[Para_AveTemperature][PARA_NUM] = ValidParaCnt;
        ValidParaDisArr[Para_AveTemperature][PARA_VALID] = true;
    }
    else
        ValidParaDisArr[Para_AveTemperature][PARA_VALID] = false;
    //水位
    if(!(inputValue.WaterLevel == LEVEL_DOWNLIMITWATER ))
    {
        ValidParaCnt++;
        ValidParaDisArr[Para_Waterlevel][PARA_NUM] = ValidParaCnt;
        ValidParaDisArr[Para_Waterlevel][PARA_VALID] = true;
    }
    else
        ValidParaDisArr[Para_Waterlevel][PARA_VALID] = false;
  
    //位置
    if((!(inputValue.EquipState == STATE_FLOWOIL))&&(inputValue.RealtimePosition != 0 ))
    {
        ValidParaCnt++;
        ValidParaDisArr[Para_position][PARA_NUM] = ValidParaCnt;
        ValidParaDisArr[Para_position][PARA_VALID] = true;
    }
    else
        ValidParaDisArr[Para_position][PARA_VALID] = false;
  
    #if DEBUG_DISPLAY
    printf("ValidParaCnt = %d\n",ValidParaCnt);
    #endif
    /******计算总共需用几页,以及起始行******/
    if(flagofoillevelvalid == true)
    {
        rowsperpage = 2;
        PageAmount = ceil(ValidParaCnt / (float)rowsperpage);
        start_x = OLED_ROW4_3;
    }
    else
    {
        rowsperpage = 3;
        PageAmount = ceil(ValidParaCnt / (float)rowsperpage);
        start_x = OLED_ROW4_2;
    }
    #if DEBUG_DISPLAY
    printf("rowsperpage = %d\n",rowsperpage);
    printf("PageAmount = %d\n",PageAmount);
    printf("start_x = %d\n",start_x);
    #endif
    /******计算每一个参数对应的行号和页号******/
    if(PageAmount == 0 && rowsperpage == 2)//特殊情况:一共只显示两行的情况下这两行要居中显示
    {
        FlagofTotalTwoRow = true;
    }
    else
    {
        FlagofTotalTwoRow = false;
        for(i = 0;i<Para_Amount;i++)
        {
            ValidParaDisArr[i][PARA_X] = ((ValidParaDisArr[i][PARA_NUM] - 1) % rowsperpage ) * (OLED_ROW4_2 - OLED_ROW4_1) + start_x;
            ValidParaDisArr[i][PARA_PAGE] = (ValidParaDisArr[i][PARA_NUM] - 1) / rowsperpage;
            #if DEBUG_DISPLAY
            printf("%d\tx = %d\tpage = %d\tnum = %d\n",i,ValidParaDisArr[i][PARA_X],ValidParaDisArr[i][PARA_PAGE],ValidParaDisArr[i][PARA_NUM]);
            #endif
        }
    }
}

static const EquipStateDisplay state_display_table[] = {
    { 0x0000, "待机中", "Standby" },
    { 0x0001, "设备初始化", "Initializing" },
    { 0x0002, "回零点中", "Back to Zero" },
    { 0x0010, "标定零点中", "Zero Calibration" },
    { 0x0011, "单点测量中", "Single Point-M" },
    { 0x0012, "运行到测量点中", "Run to Point" },
    { 0x0013, "分布测量中", "Spread Point-M" },
    { 0x0014, "无参分布测量中", "AI Spread Point-M" },
    { 0x0015, "标定液位", "Calibrate Oil Level" },
    { 0x0016, "读取参数中", "Reading Parameters" },
    { 0x0017, "向上运行中", "Running Up" },
    { 0x0018, "向下运行中", "Running Down" },
    { 0x0019, "设置零点编码值", "Set Zero Circle" },
    { 0x001A, "设置零点编码值", "Set Zero Angle" },
    { 0x001B, "恢复出厂设置中", "Factory Reset" },
    { 0x001C, "备份配置文件中", "Backing Up" },
    { 0x001D, "恢复配置文件中", "Restoring Config" },
    { 0x001E, "寻找液位中", "Finding Oil Level" },
    { 0x001F, "寻找水位中", "Finding Water Level" },
    { 0x0020, "寻找罐底中", "Finding Bottom" },
    { 0x0021, "设置电机零点中", "Set Motor Zero" },
    { 0x0022, "罐上仪表操作中", "Tank Operation" },
    { 0x0023, "综合指令", "Synthetics" },
    { 0x0024, "密度每米测量中", "Meter Density-M" },
    { 0x0025, "液位区间测量中", "Interval Density-M" },
    { 0x8010, "标定零点完成", "Zero Calib-C" },
    { 0x8011, "单点测量完成", "Single Point-C" },
    { 0x8012, "正在单点检测", "SP Testing" },
    { 0x8013, "分布测量完成", "Spread Point-C" },
    { 0x8014, "无参分布测量完成", "AI Spread-C" },
    { 0x8015, "标定液位完成", "Oil Calib-C" },
    { 0x8016, "读取参数完成", "Param Read-C" },
    { 0x8017, "向上运行完成", "Up Done" },
    { 0x8018, "向下运行完成", "Down Done" },
    { 0x8019, "设置零点编码值完成", "Zero Circle-C" },
    { 0x801A, "设置零点编码值完成", "Zero Angle-C" },
    { 0x801B, "恢复出厂设置完成", "Factory Reset-C" },
    { 0x801C, "备份配置完成", "Backup Done" },
    { 0x801D, "恢复配置完成", "Restore Done" },
    { 0x801E, "液位跟随中", "Level Following" },
    { 0x801F, "水位测量完成", "Water Level-C" },
    { 0x8020, "罐底测量完成", "Tank Bottom-C" },
    { 0x8021, "设置电机零点完成", "Motor Zero-C" },
    { 0x8022, "罐上仪表操作完成", "Tank Op-C" },
    { 0x8023, "综合指令完成", "Synthetics-C" },
    { 0x8024, "密度测量完成", "Density per M-C" },
    { 0x8025, "区间测量完成", "Interval-C" },
    { 0xFFFF, "故障:", "Failure:" }
};
const char* GetStateString(uint16_t state, uint8_t lang)
{
    for (int i = 0; i < sizeof(state_display_table) / sizeof(state_display_table[0]); i++) {
        if (state_display_table[i].state == state)
            return (lang == 0) ? state_display_table[i].disp_cn : state_display_table[i].disp_en;
    }
    return (lang == 0) ? "未知" : "Unknown";
}
static void DIS_Equipment(void)
{
    int row, line;
    uint16_t state = inputValue.EquipState;
    uint8_t lang = screen_parameter.language;

    if (lang > 1) lang = 1;
    row = FlagofTotalTwoRow ? OLED_ROW4_2 : OLED_ROW4_1;

    const char *disp_str = GetStateString(state, lang);
    line = OledDisplayLineWords((uint8_t*)disp_str, OLED_LINE8_1, row, 0);

    if (state == 0xFFFF) {
		uint16_t err_type = (inputValue.ErrorCode >> 16) & 0xFFFF;
		uint16_t err_pos  = inputValue.ErrorCode & 0xFFFF;

		char err_text[16];
		snprintf(err_text, sizeof(err_text), "%d-%d", err_type, err_pos);
		line = OledDisplayLineWords((uint8_t*)err_text, line, row, 0);
    }
}


/* 判断是否需要息屏 */
static bool ScreenOff( void )
{
    if(flag_bright)
        return false;
    
    if(screen_parameter.screenoff == 0)
        return false;
    
    return true;
}

/* 设置亮屏 */
void SetScreenBright( void )
{
    flag_bright = true;
}

/* 设置息屏 */
static void SetScreenOff( void )
{
    flag_bright = false;
}


