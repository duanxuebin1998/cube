#include "display.h"
#include "hgs.h"
#include "stdlib.h"
#include "math.h"
#include "exit.h"
#include "display_tankopera.h"
#include "tim.h"
#include "system_parameter.h"
#include "cpu2_communicate.h"
#include <stdio.h>
#include <string.h>

/* 显示模块调试输出编译开关；0 关闭额外调试路径，量产构建保持关闭以避免串口与刷新时序受日志影响。 */
#define DEBUG_DISPLAY 0
/* OLED 异常后的周期恢复尝试间隔 60000 ms；限制重复初始化频率，避免故障时持续占用总线。 */
#define DISPLAY_RECOVER_INTERVAL_MS 60000U
/* 单轮 OLED 恢复最多连续尝试 3 次；全部失败后等待下一恢复窗口或新的显式请求。 */
#define DISPLAY_RECOVER_MAX_ATTEMPTS 3U
/* 一次显示刷新等待完成的超时 500 ms；超过后进入显示故障与恢复处理。 */
#define DISPLAY_REFRESH_TIMEOUT_MS 500U
/* 菜单数值修改后高亮显示的保持时间 500 ms。 */
#define DISPLAY_VALUE_HIGHLIGHT_MS 500U
/* 状态页业务数据重建周期 2000 ms；页面扫描可更快，但过程量文本只按该节拍更新。 */
#define DISPLAY_STATUS_DATA_REFRESH_MS 2000U
/* 状态页最多容纳的可配置显示项数量 6；超过时必须分页或裁剪。 */
#define DISPLAY_STATUS_MAX_SLOTS 6U
/* 状态页单个数值区域高度 16 像素；用于局部清屏和重绘边界。 */
#define DISPLAY_VALUE_AREA_HEIGHT 16U
/* 主界面无按键 30000 ms 后允许进入熄屏状态。 */
#define DISPLAY_SCREEN_OFF_IDLE_MS 30000U
/* 菜单无操作 120000 ms 后自动退出，避免长期停留在参数编辑上下文。 */
#define DISPLAY_MENU_IDLE_EXIT_MS 120000U
/* 状态页切换后保持当前页的刷新周期数 3；用于抑制数据项变化造成的过快自动翻页。 */
#define DISPLAY_STATUS_PAGE_HOLD_REFRESHES 3U

/* struct ScreenDisplay SDisPosi; */
struct ScreenPARA screen_parameter = {0}; /* 屏幕存储参数 */
static volatile bool flag_bright = false;            /* 亮屏标志位 */
static volatile bool display_refresh_pending = false; /* 等待 Display_Task 消费的一次 OLED 刷新请求；定时器、按键和页面流程只置位，前台取走后在非中断上下文执行绘制。 */
static bool display_recover_before_draw = false; /* 下一帧绘制前必须先恢复 OLED 控制器和清屏的标志；由主动恢复、SPI 错误变化或周期恢复判定设置，帧结束后清除。 */
static volatile bool display_screen_off_active = false; /* OLED 已执行关显示命令的运行态标志；按键中断和前台绘制流程均会读取，因此使用 volatile 保证每次访问均取得最新状态。 */
static bool display_recover_requested = false; /* OLED 显式恢复或受控重试请求；下一次恢复判定消费后执行一次硬恢复。 */
static uint8_t display_recover_attempt_count = 0U; /* 当前 OLED 恢复轮次已经失败的次数；达到上限后不再逐帧硬复位。 */
static uint32_t display_last_recover_tick = 0U; /* 最近一次确认或发起 OLED 恢复的 HAL 毫秒节拍；用于限制周期恢复间隔，按无符号差值兼容系统节拍回绕。 */
static uint32_t display_last_spi_error_count = 0U; /* 显示恢复判定最近一次确认过的 OLED SPI 累计错误数；计数发生变化时要求下一帧重建控制器和显存状态。 */
static uint32_t display_last_refresh_ms = 0U; /* 最近一次 RefreshScreen 完整执行耗时，单位 ms；与 DISPLAY_REFRESH_TIMEOUT_MS 比较后累计刷新超时诊断。 */
static uint32_t display_refresh_timeout_count = 0U; /* RefreshScreen 单次耗时超过 DISPLAY_REFRESH_TIMEOUT_MS 的累计次数；仅作显示任务时序诊断，不参与刷新完成判定。 */
static volatile uint32_t display_last_key_tick = 0U; /* 最近一次按键唤醒或显示初始化时的 HAL 毫秒节拍；息屏判定按该值计算主界面连续无操作时长。 */
static uint32_t display_menu_last_activity_tick = 0U; /* 菜单最近一次有效操作时间，用于空闲自动退出。 */


static int PageAmount = 0;                  /* 总共显示几页 */
static bool flagofoillevelvalid = false;    /* 是否显示液位 */
static bool FlagofTotalTwoRow = false;      /* 标志位 - 总共要显示的内容只有两行 */
static void DIS_Equipment(void);
/* ValidParaDisArr 每项的行坐标字段索引 0；值为 OLED Y 像素坐标。 */
#define PARA_X 0
/* ValidParaDisArr 每项的页号字段索引 1；用于筛选当前页显示项。 */
#define PARA_PAGE 1
/* ValidParaDisArr 每项的有效显示顺序字段索引 2；从 1 开始参与分页布局。 */
#define PARA_NUM 2
/* ValidParaDisArr 每项的有效标志字段索引 3；为假时不得构建或绘制该项。 */
#define PARA_VALID 3
enum { /* 用于记录每个参数显示在第几页第几行 */
    Para_ErrorReason = 0,
    Para_ErrorReasonMore,
    Para_AveDensity,
    Para_AveTemperature,
    Para_Waterlevel,
    Para_Pressure,
    Para_Pressure2,
    Para_gsw,
    Para_tov,
    Para_flow_v_pipe,
    Para_flux,
    Para_alarm,
    Para_current,
    Para_weight,
    Para_torque_temperature,
    Para_sensor_value, /* sensor value */
    Para_capacitance,
    Para_angle_x,   /* 新增：陀螺仪 X 角度 */
    Para_angle_y,   /* 新增：陀螺仪 Y 角度 */
    Para_position,
	Para_tankheight, /* 新增：罐高 */
    Para_wireless_rssi, /* 新增：蓝牙连接 RSSI */
    Para_wireless_mac, /* 新增：连接从机蓝牙 MAC */
    Para_wireless_t,
    Para_V,
    Para_VMax,
    Para_VMin,
    
    Para_Amount,
};
/* 各参数菜单项的显示有效性、页号和布局属性缓存。 */
static int ValidParaDisArr[Para_Amount][4] = {0};

/**
 * @brief 读取并换算状态页使用的油位传感器频率。
 * @return 优先返回 oil_measurement.current_frequency；该值为 0 时回退到 debug_data.frequency，单位 Hz，最终转换为 int。
 */
static int GetOilSensorFrequencyForDisplay(void);

/* 结果页业务上下文；决定状态快照应组织油位、水位、密度分布、称重或故障等哪一类字段，避免仅凭设备主状态猜测页面内容。 */
typedef enum {
    /* 状态页结果上下文；用于选择当前业务结果应生成的字段集合。 */
    DISPLAY_RESULT_CONTEXT_NONE = 0, /* 当前页面解释为没有结果页上下文。 */
    DISPLAY_RESULT_CONTEXT_OIL_LEVEL, /* 当前页面解释为油位测量结果。 */
    DISPLAY_RESULT_CONTEXT_WATER_LEVEL, /* 当前页面解释为水位测量结果。 */
    DISPLAY_RESULT_CONTEXT_SINGLE_POINT, /* 当前页面解释为单点密度测量结果。 */
    DISPLAY_RESULT_CONTEXT_SINGLE_MONITOR, /* 当前页面解释为单点连续监测结果。 */
    DISPLAY_RESULT_CONTEXT_DENSITY_DISTRIBUTION, /* 当前页面解释为密度分布测量结果。 */
    DISPLAY_RESULT_CONTEXT_BOTTOM_HEIGHT, /* 当前页面解释为罐底和罐高测量结果。 */
    DISPLAY_RESULT_CONTEXT_MOTION_DEBUG, /* 当前页面解释为电机运动调试结果。 */
    DISPLAY_RESULT_CONTEXT_WEIGHT, /* 当前页面解释为扭力/重量结果。 */
    DISPLAY_RESULT_CONTEXT_READ_PARAMETER, /* 当前页面解释为参数读取结果。 */
    DISPLAY_RESULT_CONTEXT_ERROR /* 当前页面解释为故障详情结果。 */
} DisplayResultContext;

typedef enum {
    /* 状态页字段槽标识；每个标识对应固定的格式、单位或文本渲染规则。 */
    DISPLAY_STATUS_SLOT_NONE = 0, /* 本槽显示空槽。 */
    DISPLAY_STATUS_SLOT_ERROR_REASON, /* 本槽显示首条故障原因。 */
    DISPLAY_STATUS_SLOT_ERROR_REASON_MORE, /* 本槽显示其余故障原因提示。 */
    DISPLAY_STATUS_SLOT_OIL_LEVEL, /* 本槽显示油位。 */
    DISPLAY_STATUS_SLOT_WATER_LEVEL, /* 本槽显示水位。 */
    DISPLAY_STATUS_SLOT_DENSITY, /* 本槽显示密度。 */
    DISPLAY_STATUS_SLOT_TEMPERATURE, /* 本槽显示温度。 */
    DISPLAY_STATUS_SLOT_POSITION, /* 本槽显示传感器位置。 */
    DISPLAY_STATUS_SLOT_WEIGHT, /* 本槽显示扭力/重量。 */
    DISPLAY_STATUS_SLOT_TORQUE_TEMPERATURE, /* 本槽显示扭力传感器温度。 */
    DISPLAY_STATUS_SLOT_FREQUENCY, /* 本槽显示传感器频率。 */
    DISPLAY_STATUS_SLOT_CAPACITANCE, /* 本槽显示水位电容。 */
    DISPLAY_STATUS_SLOT_ANGLE_X, /* 本槽显示陀螺仪 X 轴角度。 */
    DISPLAY_STATUS_SLOT_ANGLE_Y, /* 本槽显示陀螺仪 Y 轴角度。 */
    DISPLAY_STATUS_SLOT_TANK_HEIGHT, /* 本槽显示罐高。 */
    DISPLAY_STATUS_SLOT_WIRELESS_RSSI, /* 本槽显示无线 RSSI。 */
    DISPLAY_STATUS_SLOT_WIRELESS_RSSI_NA, /* 本槽显示无线 RSSI 不可用提示。 */
    DISPLAY_STATUS_SLOT_WIRELESS_MAC_COMPACT, /* 本槽显示紧凑格式无线 MAC。 */
    DISPLAY_STATUS_SLOT_WIRELESS_MAC_1, /* 本槽显示无线 MAC 上半行。 */
    DISPLAY_STATUS_SLOT_WIRELESS_MAC_2, /* 本槽显示无线 MAC 下半行。 */
    DISPLAY_STATUS_SLOT_WIRELESS_MAC_NA /* 本槽显示无线 MAC 不可用提示。 */
} DisplayStatusSlotId;

typedef struct {
    /* 状态页的单个可渲染字段；数值字段和文本字段互斥，并携带行位置、单位及临时高亮期限。 */
    DisplayStatusSlotId id; /* 字段类型标识，决定本槽采用的标签、单位和格式化规则。 */
    bool is_text; /* 字段载荷类型标志；为真时读取 text，否则按 value 和 points 格式化。 */
    int32_t value; /* 数值字段的有符号原始值，按 points 指定的小数位显示。 */
    uint8_t points; /* 数值字段显示的小数位数。 */
    uint8_t row; /* 字段标签所在 OLED 行号。 */
    uint8_t value_line; /* 字段数值或文本所在 OLED 行号。 */
    const uint8_t *unit; /* 数值字段的只读单位字符串；无单位时为 NULL。 */
    char text[32]; /* 文本字段的本地副本，固定长度并保证以 NUL 结束。 */
    bool highlight_visible; /* 临时高亮当前是否可见；用于通信异常等短时提示。 */
    uint32_t highlight_until_tick; /* 临时高亮结束的 HAL 毫秒节拍。 */
} DisplayStatusSlot;

typedef struct {
    /* 一次完整状态页快照；先在非活动缓冲区生成全部字段，再整体切换为活动快照，避免刷新过程中混用不同轮询周期的数据。 */
    bool valid; /* 整份快照是否完整生成；为真后活动缓冲区才可交给绘制函数。 */
    uint16_t state; /* 生成快照时读取到的 CPU2 设备主状态。 */
    uint32_t error_code; /* 生成快照时读取到的 CPU2 汇总故障码。 */
    DisplayResultContext ctx; /* 本快照的结果页业务上下文。 */
    bool protocol_compatible; /* CPU2/CPU3 协议版本已确认兼容的标志。 */
    bool protocol_mismatch; /* 检测到 CPU2/CPU3 协议版本不一致的标志。 */
    uint8_t language; /* 生成文本时使用的界面语言快照。 */
    bool total_two_row; /* 总计区域是否占两行的布局标志。 */
    int page; /* 生成快照时的当前页索引。 */
    int page_amount; /* 当前结果上下文可显示的总页数。 */
    uint8_t slot_count; /* slots 中实际填充的字段数量，不得超过 DISPLAY_STATUS_MAX_SLOTS。 */
    DisplayStatusSlot slots[DISPLAY_STATUS_MAX_SLOTS]; /* 按显示顺序排列的字段槽数组。 */
} DisplayStatusSnapshot;

/* 上一份已经完整绘制的状态页快照，用于差异刷新。 */
static DisplayStatusSnapshot display_status_last_snapshot = {0};
/* 当前允许绘制函数读取的完整状态页快照。 */
static DisplayStatusSnapshot display_status_active_snapshot = {0};
static int display_status_page_index = 0; /* 状态页当前页索引；上下翻页时在可用页数内循环。 */
static uint8_t display_status_page_hold_count = 0U; /* 当前状态页已保持的业务数据刷新次数；达到 DISPLAY_STATUS_PAGE_HOLD_REFRESHES 后清零并切换到下一页。 */
static bool display_status_full_redraw_required = true; /* 状态页局部刷新缓存已经失效、下一帧必须全屏重绘的标志；前景页覆盖屏幕后置位，完整状态页绘制时清除。 */
static uint32_t display_status_last_data_refresh_tick = 0U; /* 状态页显示值最近一次采样时间。 */

/**
 * @brief 判断探底角度是否已配置为状态页显示项。
 * @return true 表示探底角度已配置为状态页显示项；false 表示探底角度尚未配置为状态页显示项。
 */
static bool IsBottomAngleDisplayEnabled(void)
{
    return (g_deviceParams.bottom_detect_mode != 0U);
}

/**
 * @brief 根据测量状态选择当前结果页的数据上下文。
 *
 * @param state CPU2 共享测量快照中的设备状态，用于选择单点、监测、分布、油位、水位或参数读取结果上下文。
 *
 * @return 返回与当前测量状态对应的结果页上下文；无匹配状态时返回 DISPLAY_RESULT_CONTEXT_NONE。
 */
static DisplayResultContext Display_GetResultContext(DeviceState state)
{
    switch (state)
    {
    case STATE_FINDOIL:
    case STATE_CALIBRATIONOILING:
    case STATE_FLOWOIL:
    case STATE_FINDOILOVER:
        return DISPLAY_RESULT_CONTEXT_OIL_LEVEL;

    case STATE_FINDWATER:
    case STATE_FOLLOW_WATER_POINT_SEARCHING:
    case STATE_FOLLOW_WATERING:
    case STATE_CALIBRATE_WATERING:
    case STATE_FINDWATER_OVER:
    case STATE_CALIBRATE_WATER_OVER:
        return DISPLAY_RESULT_CONTEXT_WATER_LEVEL;

    case STATE_SINGLEPOINTING:
    case STATE_RUNTOPOINTING:
    case STATE_SINGLEPOINTOVER:
        return DISPLAY_RESULT_CONTEXT_SINGLE_POINT;

    case STATE_SPTESTING:
        return DISPLAY_RESULT_CONTEXT_SINGLE_MONITOR;

    case STATE_GB_SPREADPOINTING:
    case STATE_SPREADPOINTING:
    case STATE_METER_DENSITY:
    case STATE_INTERVAL_DENSITY:
    case STATE_WARTSILA_DENSITY_START:
    case STATE_WARTSILA_DENSITY_MEASURING:
    case STATE_GB_SPREADPOINTOVER:
    case STATE_SPREADPOINTOVER:
    case STATE_COM_METER_DENSITY_OVER:
    case STATE_INTERVAL_DENSITY_OVER:
    case STATE_WARTSILA_DENSITY_OVER:
        return DISPLAY_RESULT_CONTEXT_DENSITY_DISTRIBUTION;

    case STATE_FINDBOTTOM:
    case STATE_FINDBOTTOM_OVER:
    case STATE_CALIBRATE_TANKHEIGHTING:
    case STATE_CALIBRATE_TANKHEIGHT_OVER:
        return DISPLAY_RESULT_CONTEXT_BOTTOM_HEIGHT;

    case STATE_RUNUPING:
    case STATE_RUNDOWNING:
    case STATE_RUNUPOVER:
    case STATE_RUNDOWNOVER:
    case STATE_RUN_TO_POSITIONING:
    case STATE_RUN_TO_POSITION_OVER:
    case STATE_FORCE_RUNUPING:
    case STATE_FORCE_RUNDOWNING:
    case STATE_FORCE_RUNUP_OVER:
    case STATE_FORCE_RUNDOWN_OVER:
    case STATE_FORCEZERO:
    case STATE_FORCEZERO_OVER:
    case STATE_MAINTENANCEMODE:
    case STATE_DEBUG_MODE:
        return DISPLAY_RESULT_CONTEXT_MOTION_DEBUG;

    case STATE_GET_FULLWEIGHT:
    case STATE_GET_EMPTYWEIGHT:
    case STATE_GET_FULLWEIGHT_OVER:
    case STATE_GET_EMPTYWEIGHT_OVER:
        return DISPLAY_RESULT_CONTEXT_WEIGHT;

    case STATE_SYNTHETICING:
        return DISPLAY_RESULT_CONTEXT_MOTION_DEBUG;

    case STATE_SYNTHETICING_OVER:
        return DISPLAY_RESULT_CONTEXT_DENSITY_DISTRIBUTION;

    case STATE_READPARAMETEROVER:
        return DISPLAY_RESULT_CONTEXT_READ_PARAMETER;

    case STATE_ERROR:
        return DISPLAY_RESULT_CONTEXT_ERROR;

    default:
        return DISPLAY_RESULT_CONTEXT_NONE;
    }
}

/**
 * @brief 判断温度值是否位于屏幕允许显示的有效范围内。
 *
 * @param temperature CPU2 温度原始值，单位 0.01 ℃ 且包含 +20000 偏移；显示层只接受 1 至 39999。
 * @return true 表示 temperature 严格大于 0 且小于 40000，属于屏幕允许显示的原始温度范围；false 表示值为 0 或不小于 40000，应按无效温度处理。
 */
static bool Display_IsTemperatureValid(uint32_t temperature)
{
    return (temperature > 0U) && (temperature < 40000U);
}

/**
 * @brief 把协议31中的扭力模块温度IEEE754原始位转换为0.01摄氏度整数。
 *
 * @details 调用场景：读取部件参数完成后的状态分页构建与刷新。
 * @note 关键约束：只在读取部件参数结果上下文使用，并拒绝NaN、无穷和超出显示范围的数据。
 *
 * @param ctx 本次处理使用的上下文或状态快照。该 DisplayResultContext 已由 CPU2 设备状态映射得到，用于选择单点、监测、分布、油位、水位或参数读取结果字段。
 * @param temperature_x100 温度定点值，单位 0.01 ℃。
 * @return true 表示扭力温度原始位为有限且可显示的 IEEE754 数值，并已换算为 0.01 ℃ 写入输出；false 表示输出指针为空、原始值为 NaN/无穷或超出允许温度范围。
 */
static bool Display_GetTorqueTemperatureX100(DisplayResultContext ctx,
                                             int32_t *temperature_x100)
{
    uint32_t temperature_bits;
    float temperature;
    float scaled;

    if ((ctx != DISPLAY_RESULT_CONTEXT_READ_PARAMETER) ||
        (temperature_x100 == NULL)) {
        return false;
    }

    temperature_bits = g_measurement.debug_data.torque_temperature_bits;
    if ((temperature_bits & 0x7F800000UL) == 0x7F800000UL) {
        return false;
    }

    memcpy(&temperature, &temperature_bits, sizeof(temperature));
    if ((temperature < -999.99f) || (temperature > 999.99f)) {
        return false;
    }

    scaled = temperature * 100.0f;
    *temperature_x100 = (int32_t)(scaled + ((scaled >= 0.0f) ? 0.5f : -0.5f));
    return true;
}

/**
 * @brief 判断设备状态是否属于可展示分布测量最终结果的完成态。
 *
 * @param state 待检查的 CPU2 设备状态；函数只接受各分布模式和综合测量的完成态。
 * @return true 表示设备状态属于可展示分布测量最终结果的完成态；false 表示设备状态不属于可展示分布测量最终结果的完成态。
 */
static bool Display_IsDensityDistributionCompleteState(DeviceState state)
{
    switch (state)
    {
    case STATE_GB_SPREADPOINTOVER:
    case STATE_SPREADPOINTOVER:
    case STATE_COM_METER_DENSITY_OVER:
    case STATE_INTERVAL_DENSITY_OVER:
    case STATE_WARTSILA_DENSITY_OVER:
    case STATE_SYNTHETICING_OVER:
        return true;
    default:
        return false;
    }
}

/**
 * @brief 判断当前设备状态是否包含可显示的密度分布测量值。
 *
 * @param state 待检查的 CPU2 设备状态；完成态、瓦锡兰测量中和参数读取完成态允许读取密度分布值。
 * @return true 表示 state 为任一分布或综合测量完成态、Wärtsilä 密度测量中，或参数读取完成态，可读取分布测量值；false 表示其它状态，当前没有可显示的分布值。
 */
static bool Display_IsDensityDistributionValueState(DeviceState state)
{
    return Display_IsDensityDistributionCompleteState(state) ||
           (state == STATE_WARTSILA_DENSITY_MEASURING) ||
           (state == STATE_READPARAMETEROVER);
}

/**
 * @brief 判断当前设备状态是否包含密度分布测量使用的有效油位。
 *
 * @param state 待检查的 CPU2 设备状态；只有分布或综合测量完成态允许使用配套油位。
 * @return true 表示 state 为国标、普通、每米、区间或 Wärtsilä 分布测量完成态，或综合测量完成态，可使用配套油位；false 表示其它状态，尚不能把分布测量油位作为有效结果。
 */
static bool Display_IsDensityDistributionOilLevelState(DeviceState state)
{
    return Display_IsDensityDistributionCompleteState(state);
}

/**
 * @brief 判断当前设备状态是否已经产生可显示的油位结果。
 *
 * @param state 待检查的 CPU2 设备状态；找油完成、油位跟随和综合测量完成态视为已有油位结果。
 * @return true 表示当前设备状态已经产生可显示的油位结果；false 表示当前设备状态尚未产生可显示的油位结果。
 */
static bool Display_IsOilLevelResultState(DeviceState state)
{
    return (state == STATE_FINDOILOVER) ||
           (state == STATE_FLOWOIL) ||
           (state == STATE_SYNTHETICING_OVER);
}

/**
 * @brief 判断当前设备状态是否已经产生可显示的水位结果。
 *
 * @param state 待检查的 CPU2 设备状态；找水、跟随、标定或综合测量完成态视为已有水位结果。
 * @return true 表示当前设备状态已经产生可显示的水位结果；false 表示当前设备状态尚未产生可显示的水位结果。
 */
static bool Display_IsWaterLevelResultState(DeviceState state)
{
    return (state == STATE_FINDWATER_OVER) ||
           (state == STATE_FOLLOW_WATERING) ||
           (state == STATE_CALIBRATE_WATER_OVER) ||
           (state == STATE_SYNTHETICING_OVER);
}

/**
 * @brief 读取当前结果页可显示的密度值。
 *
 * @param ctx 本次处理使用的上下文或状态快照。该 DisplayResultContext 已由 CPU2 设备状态映射得到，用于选择单点、监测、分布、油位、水位或参数读取结果字段。
 * @param density 密度原始值输出指针；上下文存在有效结果时写入 0.01 kg/m3 定点值。
 * @return true 表示指定结果上下文存在有效密度，并已写入 density；false 表示输出指针为空、上下文不提供密度、分布状态尚未形成结果，或值仍为 UNVALID_DENSITY。
 */
static bool Display_GetDensityValue(DisplayResultContext ctx, uint32_t *density)
{
    uint32_t value = UNVALID_DENSITY;
    DeviceState state = g_measurement.device_status.device_state;

    if (density == NULL) {
        return false;
    }

    switch (ctx)
    {
    case DISPLAY_RESULT_CONTEXT_SINGLE_POINT:
        value = g_measurement.single_point_measurement.density;
        break;
    case DISPLAY_RESULT_CONTEXT_SINGLE_MONITOR:
        value = g_measurement.single_point_monitoring.density;
        break;
    case DISPLAY_RESULT_CONTEXT_DENSITY_DISTRIBUTION:
        if (Display_IsDensityDistributionValueState(state)) {
            value = g_measurement.density_distribution.average_density;
        }
        break;
    default:
        break;
    }

    if (value == UNVALID_DENSITY) {
        return false;
    }

    *density = value;
    return true;
}

/**
 * @brief 读取当前结果页可显示的温度值。
 *
 * @param ctx 本次处理使用的上下文或状态快照。该 DisplayResultContext 已由 CPU2 设备状态映射得到，用于选择单点、监测、分布、油位、水位或参数读取结果字段。
 * @param temperature 温度原始值输出指针；上下文存在有效结果时写入带 +20000 偏移的 0.01 ℃ 定点值。
 * @return true 表示指定结果上下文存在有效温度，并已写入 temperature；false 表示输出指针为空、上下文不提供温度、分布状态尚未形成结果，或温度仍为无效占位值。
 */
static bool Display_GetTemperatureValue(DisplayResultContext ctx, uint32_t *temperature)
{
    uint32_t value = 0U;
    DeviceState state = g_measurement.device_status.device_state;

    if (temperature == NULL) {
        return false;
    }

    switch (ctx)
    {
    case DISPLAY_RESULT_CONTEXT_SINGLE_POINT:
        value = g_measurement.single_point_measurement.temperature;
        break;
    case DISPLAY_RESULT_CONTEXT_SINGLE_MONITOR:
        value = g_measurement.single_point_monitoring.temperature;
        break;
    case DISPLAY_RESULT_CONTEXT_DENSITY_DISTRIBUTION:
        if (Display_IsDensityDistributionValueState(state)) {
            value = g_measurement.density_distribution.average_temperature;
        }
        break;
    case DISPLAY_RESULT_CONTEXT_READ_PARAMETER:
        /* 读取部件参数完成态只展示 CPU2 刷新的 debug_data 快照，避免沿用上一次业务测量结果。 */
        value = g_measurement.debug_data.temperature;
        break;
    default:
        break;
    }

    if (!Display_IsTemperatureValid(value)) {
        return false;
    }

    *temperature = value;
    return true;
}

/**
 * @brief 读取当前结果页可显示的油位值。
 *
 * @param ctx 本次处理使用的上下文或状态快照。该 DisplayResultContext 已由 CPU2 设备状态映射得到，用于选择单点、监测、分布、油位、水位或参数读取结果字段。
 * @param oil_level 油位输出指针；上下文和设备状态有效时写入无符号 0.1 mm 结果。
 * @return true 表示当前油位或分布结果状态有效，且非哨兵油位已写入输出；false 表示输出指针为空、上下文/状态不允许展示油位，或结果仍为 UNVALID_LEVEL。
 */
static bool Display_GetOilLevelValue(DisplayResultContext ctx, uint32_t *oil_level)
{
    uint32_t value = UNVALID_LEVEL;
    DeviceState state = g_measurement.device_status.device_state;

    if (oil_level == NULL) {
        return false;
    }

    switch (ctx)
    {
    case DISPLAY_RESULT_CONTEXT_OIL_LEVEL:
        if (Display_IsOilLevelResultState(state)) {
            value = g_measurement.oil_measurement.oil_level;
        }
        break;
    case DISPLAY_RESULT_CONTEXT_DENSITY_DISTRIBUTION:
        if (Display_IsDensityDistributionOilLevelState(state)) {
            value = (state == STATE_SYNTHETICING_OVER)
                ? g_measurement.oil_measurement.oil_level
                : g_measurement.density_distribution.Density_oil_level;
        }
        break;

    default:
        break;
    }

    if (value == UNVALID_LEVEL) {
        return false;
    }

    *oil_level = value;
    return true;
}

/**
 * @brief 读取当前结果页可显示的水位值。
 *
 * @param ctx 本次处理使用的上下文或状态快照。该 DisplayResultContext 已由 CPU2 设备状态映射得到，用于选择单点、监测、分布、油位、水位或参数读取结果字段。
 * @param water_level 水位输出指针；设备状态有效且结果不是下限哨兵时写入无符号 0.1 mm 结果。
 * @return true 表示当前状态允许展示水位，且非下限哨兵值已写入输出；false 表示输出指针为空、状态不是水位结果态、上下文不匹配，或结果等于 LEVEL_DOWNLIMITWATER。
 */
static bool Display_GetWaterLevelValue(DisplayResultContext ctx, uint32_t *water_level)
{
    DeviceState state = g_measurement.device_status.device_state;

    if (water_level == NULL) {
        return false;
    }

    if (!Display_IsWaterLevelResultState(state)) {
        return false;
    }

    if ((ctx != DISPLAY_RESULT_CONTEXT_WATER_LEVEL) &&
        (state != STATE_SYNTHETICING_OVER)) {
        return false;
    }

    if (g_measurement.water_measurement.water_level == LEVEL_DOWNLIMITWATER) {
        return false;
    }

    *water_level = g_measurement.water_measurement.water_level;
    return true;
}

/**
 * @brief 综合设备状态和油位有效标志判断是否显示油位。
 *
 * @param ctx 本次处理使用的上下文或状态快照。该 DisplayResultContext 已由 CPU2 设备状态映射得到，用于选择单点、监测、分布、油位、水位或参数读取结果字段。
 * @return true 表示当前上下文和设备状态能够取得有效油位；false 表示Display_GetOilLevelValue 未取得可显示结果。
 */
static bool Display_ShouldShowOilLevel(DisplayResultContext ctx)
{
    uint32_t value;

    return Display_GetOilLevelValue(ctx, &value);
}

/**
 * @brief 综合设备状态和水位有效标志判断是否显示水位。
 *
 * @param ctx 本次处理使用的上下文或状态快照。该 DisplayResultContext 已由 CPU2 设备状态映射得到，用于选择单点、监测、分布、油位、水位或参数读取结果字段。
 * @return true 表示当前上下文和设备状态能够取得有效水位；false 表示Display_GetWaterLevelValue 未取得可显示结果。
 */
static bool Display_ShouldShowWaterLevel(DisplayResultContext ctx)
{
    uint32_t value;

    return Display_GetWaterLevelValue(ctx, &value);
}

/**
 * @brief 判断当前状态页是否应显示油位传感器频率。
 *
 * @param state 当前 CPU2 设备状态，用于判断油位频率是否属于本页有效诊断项。
 * @return true 表示设备状态为找油、油位标定或油位跟随，状态页应显示油位传感器频率；false 表示其它设备状态。
 */
static bool Display_ShouldShowOilFrequency(DeviceState state)
{
    switch (state)
    {
    case STATE_FINDOIL:
    case STATE_CALIBRATIONOILING:
    case STATE_FLOWOIL:
        return true;
    default:
        return false;
    }
}

/**
 * @brief 判断当前状态页是否应显示水位电容值。
 *
 * @param state 当前 CPU2 设备状态，用于判断水位电容是否属于本页有效诊断项。
 * @return true 表示设备状态为找水、跟随水位搜索、水位跟随或水位标定，状态页应显示水位电容；false 表示其它设备状态。
 */
static bool Display_ShouldShowWaterCapacitance(DeviceState state)
{
    switch (state)
    {
    case STATE_FINDWATER:
    case STATE_FOLLOW_WATER_POINT_SEARCHING:
    case STATE_FOLLOW_WATERING:
    case STATE_CALIBRATE_WATERING:
        return true;
    default:
        return false;
    }
}

/**
 * @brief 按结果页上下文、业务状态和频率有效性决定是否显示液位传感器频率。
 *
 * @param ctx 本次处理使用的上下文或状态快照。该 DisplayResultContext 已由 CPU2 设备状态映射得到，用于选择单点、监测、分布、油位、水位或参数读取结果字段。
 * @return true 表示调试频率已经非零，或当前为油位结果页且设备状态允许展示油频；false 表示频率仍无有效值，并且上下文或状态不满足油频显示条件。
 */
static bool Display_ShouldShowOilFrequencyValue(DisplayResultContext ctx)
{
    DeviceState state = g_measurement.device_status.device_state;

    if (ctx == DISPLAY_RESULT_CONTEXT_READ_PARAMETER) {
        /* 读取部件参数的频率来自 debug_data；液位过程仍使用业务测量频率。 */
        return (g_measurement.debug_data.frequency > 0U);
    }

    if (GetOilSensorFrequencyForDisplay() <= 0) {
        return false;
    }

    return (ctx == DISPLAY_RESULT_CONTEXT_OIL_LEVEL) &&
           Display_ShouldShowOilFrequency(state);
}

/**
 * @brief 按结果页上下文、业务状态和电容有效性决定是否显示水位电容。
 *
 * @param ctx 本次处理使用的上下文或状态快照。该 DisplayResultContext 已由 CPU2 设备状态映射得到，用于选择单点、监测、分布、油位、水位或参数读取结果字段。
 * @return true 表示水位电容快照已经非零，或当前为水位结果页且设备状态允许展示电容；false 表示电容仍无有效值，并且上下文或状态不满足显示条件。
 */
static bool Display_ShouldShowWaterCapacitanceValue(DisplayResultContext ctx)
{
    DeviceState state = g_measurement.device_status.device_state;

    if (ctx == DISPLAY_RESULT_CONTEXT_READ_PARAMETER) {
        /* 读取部件参数的电容来自 debug_data 快照，单位 0.1pF。 */
        return (g_measurement.debug_data.water_capacitance_x10 > 0U);
    }

    if (g_measurement.water_measurement.current_capacitance <= 0.0f) {
        return false;
    }

    return (ctx == DISPLAY_RESULT_CONTEXT_WATER_LEVEL) &&
           Display_ShouldShowWaterCapacitance(state);
}

/**
 * @brief 读取当前结果页可显示的传感器位置。
 *
 * @param ctx 本次处理使用的上下文或状态快照。该 DisplayResultContext 已由 CPU2 设备状态映射得到，用于选择单点、监测、分布、油位、水位或参数读取结果字段。
 * @param position 传感器位置输出指针；参数非 NULL 时写入当前 debug_data.sensor_position 快照。
 * @return true 表示 position 非空，当前传感器位置快照已写入输出；false 仅表示输出指针为空，函数未写入位置。
 */
static bool Display_GetPositionValue(DisplayResultContext ctx, int *position)
{
    (void)ctx;

    if (position == NULL) {
        return false;
    }

    *position = (int)g_measurement.debug_data.sensor_position;
    return true;
}

/**
 * @brief 判断当前状态页是否应显示实时扭力值。
 *
 * @param ctx 本次处理使用的上下文或状态快照。该 DisplayResultContext 已由 CPU2 设备状态映射得到，用于选择单点、监测、分布、油位、水位或参数读取结果字段。
 * @return 当前实现固定返回 true，所有 DisplayResultContext 均显示实时扭力值；该函数不存在 false 返回分支。
 */
static bool Display_ShouldShowWeight(DisplayResultContext ctx)
{
    (void)ctx;

    return true;
}

/**
 * @brief 判断当前故障是否具有可供状态页显示的详细原因。
 *
 * @param ctx 本次处理使用的上下文或状态快照。该 DisplayResultContext 已由 CPU2 设备状态映射得到，用于选择单点、监测、分布、油位、水位或参数读取结果字段。
 * @return true 表示当前页面上下文为故障结果页，且全局错误码不是 NO_ERROR，可以显示详细原因；false 表示不在故障结果页，或当前没有有效故障码。
 */
static bool Display_ShouldShowErrorReason(DisplayResultContext ctx)
{
    return (ctx == DISPLAY_RESULT_CONTEXT_ERROR) &&
           (g_measurement.device_status.error_code != NO_ERROR);
}

/**
 * @brief 判断CPU2/CPU3共享协议是否一致。
 *
 * 必须使用通信模块确认的当前连接快照，不能直接比较默认值或掉线前参数缓存。
 *
 * @return true 表示 CPU2 已上报的共享协议版本与 CPU3 当前协议兼容；false 表示协议快照尚不可用或版本不兼容，状态页应按协议不一致处理。
 */
static bool IsCpu2ProtocolCompatible(void)
{
    return CPU2_CommIsProtocolCompatible();
}

/**
 * @brief 仅在当前连接协议快照有效且版本不一致时报告不匹配。
 *
 * @return true 表示 CPU2 通信层已有有效协议版本快照且版本与 CPU3 不一致；false 表示快照尚未确认、通信不可用，或两端协议版本一致。
 */
static bool IsCpu2ProtocolMismatch(void)
{
    return CPU2_CommIsProtocolMismatch();
}

/**
 * @brief 返回故障码对应的中文原因文本。
 *
 * @param code 待判断、转换或上报的状态码。该整机错误码用于从 CPU3 故障文本表查找适合当前语言的现场原因。
 * @return 返回故障码对应的中文原因文本对应的只读文本首地址；内容由当前输入或语言配置选择，调用方不得修改或释放。
 */
static const char *Display_GetErrorReasonByCode(uint32_t code)
{
    switch (code) {

    case MOTOR_TMC_COMM_ERROR:
        return "TMC5130通信异常";
    case MOTOR_DISABLED:
        return "电机驱动电流未建立";
    case MOTOR_UNKNOWN_FEEDBACK:
        return "电机驱动故障类型未知";
    case MOTOR_STEP_ERROR:
        return "电机无有效位移";
    case MOTOR_CHARGE_PUMP_UNDER_VOLTAGE:
        return "电机驱动内部升压不足";
    case MOTOR_OVERTEMPERATURE:
        return "电机驱动过温停止";
    case MOTOR_RUN_TIMEOUT:
        return "电机运行超时";
    case MOTOR_TMC_CONFIG_LOST:
        return "电机驱动配置丢失";
    case MOTOR_STALL_ERROR:
        return "电机运行阻力大";
    case MOTOR_PHASE_SHORT_ERROR:
        return "电机相线短路";
    case MOTOR_PHASE_OPEN_ERROR:
        return "电机相线开路";
    case MOTOR_DRIVER_OVERTEMP_WARNING:
        return "电机驱动过温预警";
    case MOTOR_DRIVER_NOT_INITIALIZED:
        return "电机驱动未初始化";
    case MOTOR_STOP_WAIT_TIMEOUT:
        return "电机未按时停下";
    case MOTOR_ARRIVAL_WAIT_TIMEOUT:
        return "电机未按时到位";
    case ENCODER_TIMEOUT:
        return "编码器没有有效位置数据";
    case ENCODER_PARITY_ERROR:
        return "编码器数据校验失败";
    case ENCODER_LOST_STEP:
        return "编码器记录位移不足";
    case ENCODER_POWERON_FAIL:
        return "编码器位置记录不可用";
    case ENCODER_POWERON_CHANGE:
        return "编码器上电位置跳变";
    case ENCODER_DIFF_EXCESS:
        return "编码轮周长标定值过大";
    case ENCODER_CORDIC_OVERFLOW:
        return "编码器角度计算超限";
    case ENCODER_LINEARITY_WARNING:
        return "编码器角度线性异常";
    case ENCODER_OCF_INCOMPLETE:
        return "编码器角度计算未完成";
    case ENCODER_FIRST_SAMPLE_TIMEOUT:
        return "编码器首次读取超时";
    case ENCODER_CIRCUMFERENCE_CALIBRATION_ERROR:
        return "编码轮周长标定异常";
    case ENCODER_POSITION_JUMP:
        return "编码器运行位置跳变";
    case SENSOR_BCC_ERROR:
        return "传感器校验错误";
    case SONIC_FREQ_ABNORMAL:
        return "振动管频率异常";
    case SENSOR_DEVICE_COMM_TIMEOUT:
        return "传感器通信超时";
    case SENSOR_INTERNAL_CPU_COMM_TIMEOUT:
        return "传感器内部通信超时";
    case SENSOR_GYRO_ANGLE_ERROR:
        return "传感器角度异常";
    case SENSOR_INTERNAL_COMM_CHECK_ERROR:
        return "传感器内部通信校验失败";
    case SENSOR_NO_RESONANCE:
        return "传感器频率异常";
    case DENSITY_INVALID:
        return "密度值超出有效范围";
    case SENSOR_RESP_FORMAT_ERROR:
        return "传感器响应格式异常";
    case SENSOR_POWER_SUPPLY_ERROR:
        return "传感器电源异常";
    case SENSOR_GYRO_COMM_TIMEOUT:
        return "角度单元通信超时";
    case SENSOR_SELF_TEST_FAILED:
        return "传感器自检失败";
    case SENSOR_IDENTITY_MISMATCH:
        return "传感器身份不一致";
    case SENSOR_PROTOCOL_VERSION_INCOMPATIBLE:
        return "传感器协议版本不匹配";
    case SENSOR_MODE_NOT_READY:
        return "传感器模式未准备";
    case SENSOR_CONFIG_EPOCH_MISMATCH:
        return "传感器配置批次不一致";
    case SENSOR_STREAM_STATE_ERROR:
        return "传感器上报状态不一致";
    case SENSOR_DATA_STALE:
        return "传感器数据过期";
    case SENSOR_TEMPERATURE_RANGE_ERROR:
        return "传感器温度超限";
    case SENSOR_REMOTE_INTERNAL_ERROR:
        return "传感器内部故障";
    case SENSOR_ADDRESS_MISMATCH:
        return "传感器地址不匹配";
    case SENSOR_SESSION_INVALID:
        return "传感器连接状态失效";
    case SENSOR_SEQUENCE_ERROR:
        return "传感器应答序号不一致";
    case SENSOR_HANDSHAKE_REQUIRED:
        return "传感器需要重新确认连接";
    case SENSOR_REPLAY_DETECTED:
        return "收到重复的传感器数据";
    case SENSOR_CAPABILITY_UNSUPPORTED:
        return "传感器不支持所需功能";
    case SENSOR_COMMAND_UNSUPPORTED:
        return "传感器命令不支持";
    case SENSOR_ARGUMENT_REJECTED:
        return "传感器不接受当前参数";
    case SENSOR_MODE_MISMATCH:
        return "传感器测量模式不一致";
    case SENSOR_MODE_NOT_ALLOWED:
        return "传感器当前模式不允许操作";
    case SENSOR_TRANSACTION_PENDING:
        return "上一次传感器操作尚未完成";
    case SENSOR_DEVICE_BUSY:
        return "传感器设备忙";
    case SENSOR_PARAM_CRC_ERROR:
        return "传感器参数校验失败";
    case SENSOR_SAMPLE_COUNTER_ERROR:
        return "传感器采样序号异常";
    case SENSOR_STREAM_STOPPED:
        return "传感器周期上报已停止";
    case SENSOR_STREAM_NOT_ACTIVE:
        return "传感器周期上报未启动";
    case SENSOR_STREAM_ALREADY_ACTIVE:
        return "传感器周期上报重复启动";
    case SENSOR_STREAM_EXIT_FAILED:
        return "传感器周期上报退出失败";
    case MEASUREMENT_ZERO_OUT_OF_RANGE:
        return "零点位置超出允许范围";
    case MEASUREMENT_ZERO_REPEAT_FAIL:
        return "陀螺仪基准不稳定";
    case POSITION_DATA_INVALID:
        return "位置数据无效";
    case POSITION_TARGET_OVERRUN:
        return "运动位置超过设定";
    case POSITION_ARRIVAL_DEVIATION:
        return "电机到位偏差过大";
    case POSITION_MOTOR_NOT_STOPPED:
        return "电机未停止";
    case MEASUREMENT_OILLEVEL_HIGH:
        return "上行找液位到达位置上限";
    case MEASUREMENT_OVERSPEED:
        return "液位变化过快";
    case MEASUREMENT_HEIGHT_DEVIATION:
        return "实高偏差过大";
    case MEASUREMENT_OILLEVEL_LOW:
        return "下行未找到液位";
    case MEASUREMENT_OILLEVEL_NOTFOUND:
        return "上行未找到液位";
    case MEASUREMENT_WEIGHT_DOWN_FAIL:
        return "下行未找到罐底";
    case MEASUREMENT_WEIGHT_UP_FAIL:
        return "上行未找到零点";
    case MEASUREMENT_WATERLEVEL_LOW:
        return "下行未找到水位";
    case MEASUREMENT_DENSITY_NO_VALID_POINT:
        return "密度测量无有效点";
    case MEASUREMENT_DENSITY_SURFACE_NOTFOUND:
        return "密度测量未找到油面";
    case MEASUREMENT_DENSITY_LEVEL_TIMEOUT:
        return "密度找液位超时";
    case MEASUREMENT_FREQUENCY_LEVEL_TIMEOUT:
        return "频率找液位超时";
    case MEASUREMENT_LEVEL_REFERENCE_REFRESH_FAILED:
        return "液位定时矫正失败";
    case MEASUREMENT_BOTTOM_RELEASE_FAIL:
        return "探底前未能离开罐底";
    case MEASUREMENT_TANK_HEIGHT_NOT_CONFIGURED:
        return "未设置罐高标定值";
    case MEASUREMENT_WATER_CALIBRATION_NOT_CONFIGURED:
        return "未设置水位标定值";
    case MEASUREMENT_DENSITY_PLAN_INVALID:
        return "密度测点设置失败";
    case MEASUREMENT_TANK_HEIGHT_RESULT_INVALID:
        return "罐高测量结果无效";
    case MEASUREMENT_WATER_CALC_OUT_OF_RANGE:
        return "水位标定计算超限";
    case PARAM_EEPROM_FAIL:
        return "参数存储读写失败";
    case PARAM_UNINITIALIZED:
        return "参数未初始化";
    case PARAM_RANGE_ERROR:
        return "参数值超出范围";
    case PARAM_CRC_ERROR:
        return "参数完整性校验失败";
    case PARAM_CONFIG_MISSING:
        return "关键参数未设置";
    case PARAM_COMBINATION_CONFLICT:
        return "参数组合错误";
    case PARAM_FEATURE_UNSUPPORTED:
        return "功能无法使用";
    case PARAM_STORAGE_SIZE_MISMATCH:
        return "参数存储结构不匹配";
    case PARAM_STORAGE_VERSION_MISMATCH:
        return "参数存储版本不匹配";
    case PARAM_STORAGE_WRITE_VERIFY_FAILED:
        return "参数存储写入校验失败";
    case AD5421_INIT_ERROR:
        return "模拟输出初始化失败";
    case AD5421_READBACK_ERROR:
        return "模拟输出控制回读不一致";
    case AD5421_INTERNAL_COMM_ERROR:
        return "模拟输出内部通信异常";
    case AD5421_LOOP_CURRENT_HIGH:
        return "模拟输出电流过高";
    case AD5421_LOOP_CURRENT_LOW:
        return "模拟输出电流过低";
    case AD5421_LOOP_VOLTAGE_LOW:
        return "模拟输出环路电压低";
    case AD5421_SPI_TRANSFER_ERROR:
        return "主控与模拟量输出模块通信失败";
    case AD5421_ACCESS_BUSY:
        return "模拟输出状态异常";
    case AD5421_OVERTEMP_SHUTDOWN:
        return "模拟输出过温停止";
    case AD5421_OVERTEMP_WARNING:
        return "模拟输出过温预警";
    case COMM_UART_TRANSFER_ERROR:
        return "通信传输异常";
    case SLIPRING_COMM_FAIL:
        return "无线滑环通信失败";
    case SLIPRING_SIGNAL_WEAK:
        return "无线配对信号不达标";
    case WIRELESS_HOST_COMM_TIMEOUT:
        return "无线主机通信超时";
    case WIRELESS_SLAVE_COMM_TIMEOUT:
        return "无线从机未连接";
    case WIRELESS_RESP_FORMAT_ERROR:
        return "无线响应格式异常";
    case CPU2_COMM_TIMEOUT:
        return "主控通信超时";
    case CPU2_PROFILE_SYNC_FAILED:
        return "分布结果读取失败";
    case WIRELESS_SCAN_NO_DEVICE:
        return "无线扫描未发现设备";
    case WIRELESS_NAME_NOT_UNIQUE:
        return "无线名称重复";
    case WIRELESS_NAME_NOT_FOUND:
        return "无线名称未找到";
    case WIRELESS_NAME_INVALID:
        return "无线名称无效";
    case WIRELESS_NOT_HOST_MODE:
        return "无线非主机模式";
    case WEIGHT_OUT_OF_RANGE:
        return "满载标定扭力超过上限";
    case WEIGHT_UNDER_RANGE:
        return "满载标定扭力低于下限";
    case WEIGHT_COLLISION_DETECTED:
        return "扭力变化超过保护值";
    case WEIGHT_DRIFT_ERROR:
        return "空载标定扭力偏离零点";
    case WEIGHT_SENSOR_SATURATION:
        return "扭力传感器饱和";
    case WEIGHT_COMM_TIMEOUT:
        return "扭力通信超时";
    case SYSTEM_BUFFER_CAPACITY_ERROR:
        return "内部数据空间不足";
    case SYSTEM_CALL_CONDITION_ERROR:
        return "系统输入异常";
    case SYSTEM_CALCULATION_ERROR:
        return "系统计算异常";
    case POWER_SUPPLY_24V_UNDERVOLTAGE:
        return "整机24V欠压";
    case POWER_MONITOR_ADC_OVERRUN:
        return "电源采样数据处理不及时";
    case POWER_MONITOR_DMA_STOPPED:
        return "电源采样传输意外停止";
    case POWER_MONITOR_INIT_FAILED:
        return "电源采样启动失败";
    case POWER_MONITOR_RECOVERY_FAILED:
        return "电源采样连续恢复失败";
    case POWER_LOSS_POSITION_SAVE_FAILED:
        return "位置保存失败";
    default:
        break;
    }

    switch (code & 0xFFFF0000UL) {
    case 0x000B0000UL:
        return "电机故障";
    case 0x000C0000UL:
        return "编码器故障";
    case 0x000D0000UL:
        return "传感器故障";
    case 0x000E0000UL:
        return "位置故障";
    case 0x000F0000UL:
        return "测量故障";
    case 0x00110000UL:
        return "参数故障";
    case 0x00120000UL:
        return "扭力故障";
    case 0x00140000UL:
        return "通信故障";
    case 0x00150000UL:
        return "模拟输出故障";
    case 0x00160000UL:
        return "系统软件故障";
    case 0x00170000UL:
        return "电源监控故障";
    default:
        return "未知原因";
    }
}

/**
 * @brief 计算指定字节范围内文本的 OLED 像素宽度。
 *
 * @param text 待测量、排版或写入状态槽的 NUL 结尾显示文字；宽度计算同时处理 ASCII 与中文字节。
 * @param byte_limit 字节上限。
 * @return 返回文字占用的 OLED 像素宽度。
 */
static uint8_t Display_GetTextWidth(const char *text, uint8_t byte_limit)
{
    uint8_t width = 0U;
    uint8_t index = 0U;

    if (text == NULL) {
        return 0U;
    }

    while ((text[index] != '\0') && (index < byte_limit)) {
        if (((uint8_t)text[index]) < 128U) {
            width = (uint8_t)(width + 4U);
            index++;
        } else {
            width = (uint8_t)(width + 7U);
            index = (uint8_t)(index + 3U);
        }
    }

    return width;
}

/**
 * @brief 计算从指定横坐标起可在一行内显示的文本字节数。
 *
 * @param text 待测量、排版或写入状态槽的 NUL 结尾显示文字；宽度计算同时处理 ASCII 与中文字节。
 * @param start_x 起始位置。
 * @return 返回从指定横坐标起可在一行内显示的文本字节数的有效长度，单位字节；0 表示没有可供消费的数据。
 */
static uint8_t Display_GetFitTextBytes(const char *text, uint8_t start_x)
{
    uint8_t width = start_x;
    uint8_t index = 0U;

    if (text == NULL) {
        return 0U;
    }

    while (text[index] != '\0') {
        uint8_t char_width;
        uint8_t char_bytes;

        if (((uint8_t)text[index]) < 128U) {
            char_width = 4U;
            char_bytes = 1U;
        } else {
            char_width = 7U;
            char_bytes = 3U;
        }

        if ((uint8_t)(width + char_width) > OLED_LINE8_END) {
            break;
        }

        width = (uint8_t)(width + char_width);
        index = (uint8_t)(index + char_bytes);
    }

    return index;
}

/**
 * @brief 判断故障原因文字是否需要占用状态页两行。
 * @return true 表示故障原因文字需要占用状态页两行；false 表示故障原因文字不需要占用状态页两行。
 */
static bool Display_IsErrorReasonNeedTwoRows(void)
{
    const char *reason = Display_GetErrorReasonByCode(g_measurement.device_status.error_code);
    uint8_t prefix_width = Display_GetTextWidth("故障:", 7U);
    uint8_t first_bytes = Display_GetFitTextBytes(reason, prefix_width);

    return (reason[first_bytes] != '\0');
}

/**
 * @brief 返回故障原因在状态页中的第一行文字。
 *
 * @param row OLED 绘制使用的行号。取值使用 OLED_ROW4_x 等页面行坐标常量，决定文字或数字写入的纵向基线。
 */
static void Display_ErrorReasonLine(uint8_t row)
{
    char first_line[32];
    const char *reason = Display_GetErrorReasonByCode(g_measurement.device_status.error_code);
    uint8_t line = OledDisplayLineWords("故障:", OLED_LINE8_1, row, 0);
    uint8_t first_bytes = Display_GetFitTextBytes(reason, line);
    uint8_t i;

    for (i = 0U; (i < first_bytes) && (i < (sizeof(first_line) - 1U)); i++) {
        first_line[i] = reason[i];
    }
    first_line[i] = '\0';

    OledDisplayLineWords(first_line, line, row, 0);
}

/**
 * @brief 返回故障原因在状态页中的补充行文字。
 *
 * @param row OLED 绘制使用的行号。取值使用 OLED_ROW4_x 等页面行坐标常量，决定文字或数字写入的纵向基线。
 */
static void Display_ErrorReasonMoreLine(uint8_t row)
{
    const char *reason = Display_GetErrorReasonByCode(g_measurement.device_status.error_code);
    uint8_t prefix_width = Display_GetTextWidth("故障:", 7U);
    uint8_t first_bytes = Display_GetFitTextBytes(reason, prefix_width);

    if (reason[first_bytes] != '\0') {
        OledDisplayLineWords(&reason[first_bytes], OLED_LINE8_1, row, 0);
    }
}

/**
 * @brief 绘制当前故障的详细原因查看页。
 */
void Display_ShowErrorReasonPage(void)
{
    oled_clear();
    FlagofTotalTwoRow = false;
    DIS_Equipment();

    /* 只有存在有效故障码时才绘制故障原因，正常状态不占用原因行。 */
    if (g_measurement.device_status.error_code != NO_ERROR) {
        Display_ErrorReasonLine(OLED_ROW4_2);
        /* 故障原因超过单行显示宽度时再使用第三行，短原因继续保留单行布局。 */
        if (Display_IsErrorReasonNeedTwoRows()) {
            Display_ErrorReasonMoreLine(OLED_ROW4_3);
        }
    }

    DisplayLangaugeLineWords((uint8_t*)"返回", OLED_LINE8_1, OLED_ROW4_4, 0, (uint8_t*)"Back");
}

/**
 * @brief 读取并换算状态页使用的油位传感器频率。
 * @return 优先返回 oil_measurement.current_frequency；该值为 0 时回退到 debug_data.frequency，单位 Hz，最终转换为 int。
 */
static int GetOilSensorFrequencyForDisplay(void)
{
    if (g_measurement.oil_measurement.current_frequency != 0U)
    {
        return (int)g_measurement.oil_measurement.current_frequency;
    }

    return (int)g_measurement.debug_data.frequency;
}

/* 电机上行、下行和停止三种 16×16 单色图标点阵。 */
static const uint8_t MotorRunIcon16Stock[] = {
    0x02,0x00,0x07,0x00,0x0F,0x80,0x1A,0xC0,0x02,0x00,0x02,0x00,0x02,0x00,
    0x02,0x00,0x02,0x00,0x02,0x00,0x02,0x00,0x00,0x00,0x00,0x00,0x00,0x00, /* up */
    0x00,0x00,0x00,0x00,0x00,0x00,0x02,0x00,0x02,0x00,0x02,0x00,0x02,0x00,
    0x02,0x00,0x02,0x00,0x02,0x00,0x1A,0xC0,0x0F,0x80,0x07,0x00,0x02,0x00, /* down */
    0x00,0x00,0x00,0x00,0x1F,0xC0,0x1F,0xC0,0x1F,0xC0,0x1F,0xC0,0x1F,0xC0,
    0x1F,0xC0,0x1F,0xC0,0x1F,0xC0,0x1F,0xC0,0x00,0x00,0x00,0x00,0x00,0x00, /* stop */
};

/**
 * @brief 根据电机运动方向和动画节拍选择运行图标索引。
 * @return 返回当前方向和动画节拍对应的电机运行图标索引。
 */
static uint8_t GetMotorRunIconIndex(void)
{
    switch (g_measurement.debug_data.motor_state)
    {
    case 1U:
        return 0U;
    case 2U:
        return 1U;
    default:
        return 2U;
    }
}

/* 字库索引数组 */
/* StockMap 和 WordStock/WordStock2 必须一一对应；新增中文显示项时要同步追加点阵。 */
enum
{
    OLED_HANZI_UTF8_BYTES = 3U,
    OLED_HANZI_GLYPH_BYTES = 28U,
    OLED_HANZI_TABLE_MAX_GLYPHS = 255U
};
static const uint8_t StockMap[] = /* 000-031 */ "通讯尝试中液位跟随密度温℃版本水测量完成寻找标定零点校正获取称重"
                                   /* 032-063 */ "步进未知无线提浮子至置阈值向下运行上故障设备初始化罐底综合国满载"
                                   /* 064-095 */ "空仪表配模式检修读实时区间每米自带宽拟静止电压效流速力质体积磁致"
                                   /* 096-127 */ "伸缩新老雷达计一机变送器算方轮询加转包抓主协议软件对外集超从待回"
                                   /* 128-159 */ "单到监分布部参数编码圈恢复出厂文份指令操作在←是否入返确认？退与"
                                   /* 160-191 */ "显示换混相关据源气案改非法请输清写铁失败直接隐藏字不范围异常油品"
                                   /* 192-223 */ "类型保顶盘起高支撑原润滑苯胺乙烯丙酮酸甲酯丁腈冰二氯烷醇芳烃环己"
                                   /* 224-255 */ "氧基叔醚醛溶精制卤聚多元糠呋喃邻辛硫三偏硝盐氢钠仲石拱卧球形蒸汽"
                                   /* 256-287 */ "尺距离开手启闭短地址扫描路只能连台功打印容稍等几钟储管道径周期调"
                                   /* 288-319 */ "低于盲报警语言发错误础界面程序减比股长介信号后限例权屏幕维护视终"
                                   /* 320-351 */ "继状态最探头浸小第悬停禁用弦工固产反先动当前大英更传层滞域使磨结"
                                   /* 352-383 */ "束针总阻六级内息命感顺有角导整瓦锡兰厚首波特率验奇偶预留默强差义"
                                   /* 384-415 */ "已碰撞寄存次菜忽略志构魔术望全过收为裁剪准除以跳飞频声稳记局切匹"
                                   /* 416-447 */ "馈被荷泵欠驱丢溢性弱响应格快越漂移饱和系统因尼组跑锁隔策亮控扭持"
                                   /* 448-479 */ "身代会话需要握拒绝允许尚忙采样果名站普求震足按录建立升没可振批答"
                                   /* 480-493 */ "的所受陀螺键块现处理及意续矫";
static const int StockmapLength = (sizeof(StockMap) - 1) / OLED_HANZI_UTF8_BYTES;
static const uint8_t WordStock[] =
{
    0x47,0xF0,0x21,0x20,0x20,0xC0,0x07,0xF0,0x04,0x90,0xE4,0x90,0x27,0xF0,0x24,0x90,0x24,0x90,0x27,0xF0,0x24,0x90,0x24,0xB0,0x50,0x00,0x8F,0xF8, /* "通",0 */
    0x40,0x00,0x2F,0xE0,0x22,0x20,0x02,0x20,0x02,0x20,0xE2,0x20,0x2F,0xE0,0x22,0x20,0x22,0x20,0x22,0x28,0x2A,0x28,0x32,0x28,0x22,0x18,0x02,0x08, /* "讯",1 */
    0x02,0x00,0x22,0x20,0x12,0x40,0xFF,0xF8,0x80,0x08,0x80,0x08,0x1F,0xC0,0x00,0x00,0x00,0x00,0x7F,0xF0,0x08,0x00,0x10,0x40,0x3F,0xE0,0x00,0x20, /* "尝",2 */
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    0x00,0x40,0x7F,0x40,0x48,0x40,0x48,0x40,0x48,0x60,0x7E,0x50,0x42,0x48,0x42,0x48,0x7E,0x40,0x48,0x40,0x48,0x40,0x48,0x40,0x7F,0x40,0x00,0x40, /* "卧",251 */

};

static const uint8_t WordStock2[] =
{
    0x00,0x50,0x00,0x48,0xF8,0x40,0x23,0xF8,0x20,0x40,0x22,0x48,0xF9,0x50,0x20,0x60,0x20,0xE0,0x21,0x50,0x3A,0x50,0xE4,0x48,0x00,0x40,0x01,0xC0, /* "球",252 */
    0x00,0x10,0x7E,0x10,0x24,0x20,0x24,0x40,0x24,0x90,0x24,0x10,0xFF,0x20,0x24,0x40,0x24,0x88,0x24,0x08,0x24,0x10,0x24,0x20,0x44,0x40,0x84,0x80, /* "形",253 */
    0x08,0x80,0xFF,0xF8,0x08,0x80,0x3F,0xC0,0x00,0x80,0x7D,0x10,0x09,0xA0,0x31,0x60,0xC7,0x18,0x00,0x00,0x3F,0xE0,0x00,0x00,0x48,0x90,0x84,0x48, /* "蒸",254 */
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    0x40,0x70,0x43,0x80,0x70,0x80,0xA0,0x80,0x27,0xF8,0x21,0x20,0x22,0x10,0xF4,0x08,0x21,0x20,0x21,0x20,0x51,0x20,0x51,0x20,0x42,0x20,0x84,0x20, /* "矫",493 */
};
static const int WordStockGlyphCount = sizeof(WordStock) / OLED_HANZI_GLYPH_BYTES;
_Static_assert(((sizeof(StockMap) - 1U) % OLED_HANZI_UTF8_BYTES) == 0U,
               "StockMap must contain complete UTF-8 glyph keys");
_Static_assert((sizeof(WordStock) % OLED_HANZI_GLYPH_BYTES) == 0U,
               "WordStock byte count must align to glyph size");
_Static_assert((sizeof(WordStock2) % OLED_HANZI_GLYPH_BYTES) == 0U,
               "WordStock2 byte count must align to glyph size");
_Static_assert(((sizeof(StockMap) - 1U) / OLED_HANZI_UTF8_BYTES) ==
                   ((sizeof(WordStock) + sizeof(WordStock2)) / OLED_HANZI_GLYPH_BYTES),
               "StockMap and glyph table counts must match");
_Static_assert((sizeof(WordStock) / OLED_HANZI_GLYPH_BYTES) <= OLED_HANZI_TABLE_MAX_GLYPHS,
               "WordStock exceeds uint8_t glyph index capacity");
_Static_assert((sizeof(WordStock2) / OLED_HANZI_GLYPH_BYTES) <= OLED_HANZI_TABLE_MAX_GLYPHS,
               "WordStock2 exceeds uint8_t glyph index capacity");
static const uint8_t NumberStock[] = {

0x00,0x00,0x00,0x3C,0x66,0x6E,0x6E,0x66,0x76,0x76,0x66,0x3C,0x00,0x00, /* "0",0 */
0x00,0x00,0x00,0x0C,0x1C,0x7C,0x0C,0x0C,0x0C,0x0C,0x0C,0x0C,0x00,0x00, /* "1",1 */
0x00,0x00,0x00,0x3C,0x66,0x66,0x06,0x0C,0x18,0x30,0x60,0x7E,0x00,0x00, /* "2",2 */
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0x00,0x00,0x00,0x00,0x00,0x00,0x00,0x7E,0x00,0x00,0x00,0x00,0x00,0x00, /* "-",11 */

};

static const uint8_t CharStockMap[] = "abcdefghijklmnopqrstuvwxyzABCDEFGHIJKLMNOPQRSTUVWXYZ./0123456789: +-?!%()";
static const int CharStockMapLength = (sizeof(CharStockMap) - 1);
static const uint8_t CharStock[] = {

0x00,0x00,0x00,0x00,0x00,0x3C,0x06,0x06,0x3E,0x66,0x66,0x3E,0x00,0x00, /* "a",0 */
0x00,0x00,0x00,0x60,0x60,0x7C,0x66,0x66,0x66,0x66,0x66,0x7C,0x00,0x00, /* "b",1 */
0x00,0x00,0x00,0x00,0x00,0x3C,0x66,0x60,0x60,0x60,0x66,0x3C,0x00,0x00, /* "c",2 */
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0x00,0x00,0x00,0x30,0x18,0x18,0x0C,0x0C,0x0C,0x0C,0x0C,0x18,0x18,0x30, /* ")",72 */
};

/**
 * @brief 按当前字节编码在 OLED 上绘制 ASCII 字符或中文字模，并计算下一横向绘制坐标。
 *
 * 函数读取 display 指向的字节序列：ASCII 字节在 CharStockMap 中匹配并按 4 列推进，中文字节组在 StockMap、WordStock 和 WordStock2 中匹配并按
 * 7 列推进。
 * 达到 cnt 指定的编码字节数或横坐标到达 OLED_LINE8_END 后停止；字库缺字时仍保留对应中文字符的横向空位。
 *
 * @param display 指向待绘制只读字节序列首地址；函数只推进局部读取指针，不修改源字符串。
 * @param cnt 本次最多消费的编码字节数；ASCII字符计1字节，当前UTF-8中文字符按3字节累计。
 * @param x 首个字符的 OLED 横向列坐标；函数在此基础上累加字符宽度并返回下一可用坐标。
 * @param y 字符或中文字模的 OLED 纵向绘制坐标。
 * @param shift 传给字模绘制函数的阴码、阳码选择值。
 * @return 返回本轮绘制结束后的下一 OLED 横向列坐标；ASCII 每个推进 4 列，中文字符每个推进 7 列，达到 OLED_LINE8_END 时提前停止。
 * @note 函数只在局部变量中推进字符串读取指针；返回值用于调用方继续安排同一行后续绘制位置。
 */
static uint8_t matchingwordstock(const uint8_t *display,int cnt,int x,int y,int shift);
/**
 * @brief 统计有符号整数绝对值的十进制数字个数。
 *
 * @param value 待统计位数的有符号整数；负号不计入位数，函数按绝对值统计。
 * @return 返回 value 绝对值的十进制数字个数；0 返回 1，负号不计入位数。
 */
static uint8_t judgedecimals(int value);
/**
 * @brief 按符号、整数位数和小数位数在 OLED 指定位置逐位绘制数值。
 *
 * @param sgn 数值符号，1 表示正数，-1 表示负数。
 * @param value 待格式化并绘制到 OLED 的数值。
 * @param points value 需要显示的小数位数；决定小数点位置和小数部分循环次数。
 * @param line OLED 绘制使用的横向列位置。
 * @param row OLED 绘制使用的行号。取值使用 OLED_ROW4_x 等页面行坐标常量，决定文字或数字写入的纵向基线。
 * @param shift OLED 字模阴码/阳码或显示偏移选项。
 * @param deci 当前数值整数部分的十进制位数。
 * @return 返回符号、整数、小数点和小数位全部绘制完成后的下一 OLED 横坐标。
 */
static uint8_t dis_number(int sgn,int value,int points,uint8_t line,uint8_t row,uint8_t shift,uint8_t deci);
/**
 * @brief 裁剪小数尾随0: 16.000->16, 16.100->16.1, 16.120->16.12。
 *
 * @param value 以定点整数保存的显示数值；函数会原地除去与尾随零对应的十进制位。
 * @param points 当前定点数值保留的小数位数，也是允许裁剪的最大位数。
 * @return 返回裁剪后的有效小数位数；value 为 NULL 时保持传入的 points 不变。
 */
static uint8_t trim_display_points(int *value, uint8_t points);
/**
 * @brief 根据刷新周期和状态页布局变化，选择高亮恢复、全量重绘或差量更新当前设备数据。
 *
 * 未到采样周期且布局稳定时只恢复按键高亮；需要刷新时先构建设备状态快照，再依据恢复请求和布局变化决定全量或差量绘制。
 * 绘制完成后保存本轮快照并重置状态数据刷新时刻，供下一帧判断变化范围。
 */
static void oled_workingdata(void);
/**
 * @brief 根据设备状态、结果上下文和当前分页，绘制状态标题、故障详情及有效测量与调试数据。
 *
 * 先绘制当前设备状态；无线配对进行中不追加测量数据，配对结束时单独显示成功取得的 MAC 或不可用提示。
 * 普通状态页按 ValidParaDisArr 的有效标志和页码，选择显示故障原因、液位、水位、密度、温度、位置、扭力、扭力模块温度、频率、电容、姿态角、罐高、无线 RSSI 和从机 MAC。
 * 各数据项使用当前测量结果上下文选择来源，并通过状态槽位计算差量绘制偏移和工程单位。
 */
static void oled_equipment(void);
/**
 * @brief 根据当前测量结果上下文生成 OLED 结果页的有效参数布局。
 *
 * 函数先根据设备状态取得结果页上下文，再逐项判定故障详情、液位、密度、温度、水位、位置、扭力、部件参数、传感器原始量、姿态角、罐高和无线信息是否需要显示。
 * 每个有效项目按显示顺序写入 ValidParaDisArr 的 PARA_NUM 和 PARA_VALID；需要两行的故障原因会占用两个连续项目，读取部件参数时为扭力模块温度、RSSI 和 MAC
 * 保留固定项目。
 * 液位有效时结果区每页排两行并从 OLED_ROW4_3 开始，否则每页排三行并从 OLED_ROW4_2 开始；随后计算 PageAmount 以及每个有效项目的页号和行坐标。
 *
 * @note 函数直接更新 ValidParaDisArr、PageAmount、FlagofTotalTwoRow 和液位有效标志，调用方应在测量快照更新后再生成页面布局。
 */
static void CalculateValidPara(void);
/**
 * @brief 绘制状态页顶部设备状态及维护/模拟徽标；协议不匹配优先覆盖普通运行态，快照失效时保留曾确认的维护提示。
 *
 * 函数根据当前结果页是否仅有两行选择标题行，并把非法语言索引收敛为英文；设备状态文字通常从状态表取得，CPU2 协议不匹配时则强制显示协议错误。
 * 维护模式只信任完整运行态快照；曾确认维护开启后若快照暂时失效，继续显示维护状态未知，直到新快照明确确认维护已经关闭。
 * 维护模式与 AO 模拟状态组合为右侧徽标；没有徽标时显示电机运行图标。增量刷新前统一清理当前徽标区域，行位置变化时同时清除旧行，避免 OLED 残影。
 * 设备处于错误状态时，在状态文字之后追加由错误类型和错误位置组成的十进制故障码。
 */
static void DIS_Equipment(void);
/**
 * @brief 判断是否需要息屏。
 *
 * @return true 表示需要息屏；false 表示不需要息屏。
 */
static bool ScreenOff( void );
/**
 * @brief 清除本轮按键唤醒标志，不直接发送 OLED 关显示命令。
 */
static void SetScreenOffState( void );
/**
 * @brief 采集设备状态、语言和当前页槽位，构建本次状态页渲染快照。
 *
 * @param snapshot 可写 CPU3 状态页快照；函数追加或读取固定槽位中的文字、数值、位置、反显和数据新鲜度，最终用于全量或差量绘制。
 */
static void Display_BuildStatusSnapshot(DisplayStatusSnapshot *snapshot);
/**
 * @brief 比较两次快照的页面和槽位布局，判断是否需要全量重绘。
 *
 * @param current 本次准备显示的当前状态页快照。
 * @param last 上一次保存的值、状态或快照。
 * @return true 表示页面类型、槽位数量、槽位标识、行位置或文字或数值布局中至少一项发生变化；false 表示两份状态页快照的布局完全一致。
 */
static bool Display_StatusLayoutChanged(const DisplayStatusSnapshot *current,
                                        const DisplayStatusSnapshot *last);
/**
 * @brief 判断状态页是否需要重新采样运行数据。
 *
 * @param now 本次判断使用的当前系统节拍，单位 ms；调用方在同一轮处理内复用该快照，避免多次取时造成边界漂移。
 * @return true 表示需要按当前 g_measurement 生成新快照，false 表示仅允许恢复反白显示。
 */
static bool Display_ShouldSampleStatusData(uint32_t now);
/**
 * @brief 记录状态页最近一次按运行数据采样的节拍。
 *
 * @param now 本次判断使用的当前系统节拍，单位 ms；调用方在同一轮处理内复用该快照，避免多次取时造成边界漂移。
 */
static void Display_ResetStatusDataRefreshTick(uint32_t now);
/**
 * @brief 按状态页快照重画单个数值或文本区域。
 *
 * @param slot 状态页显示项快照。
 * @param shift 非 0 时按反显方式绘制。
 */
static void Display_DrawStatusSlotValue(const DisplayStatusSlot *slot, uint8_t shift);
/**
 * @brief 非采样刷新时重画状态行并恢复反白区域，不重新采样状态页数值。
 */
static void Display_DrawStatusHighlightRestore(void);
/**
 * @brief 全量绘制状态快照并保存为当前活动快照。
 *
 * @param snapshot 可写 CPU3 状态页快照；函数追加或读取固定槽位中的文字、数值、位置、反显和数据新鲜度，最终用于全量或差量绘制。
 */
static bool Display_DrawStatusFull(DisplayStatusSnapshot *snapshot);
/**
 * @brief 比较前后快照，只重绘发生变化的状态槽。
 *
 * @param current 本次准备显示的当前状态页快照。
 * @param last 上一次保存的值、状态或快照。
 */
static void Display_DrawStatusDelta(DisplayStatusSnapshot *current,
                                    const DisplayStatusSnapshot *last);
/**
 * @brief 存在到期反白且状态页可见时请求一次非采样刷新。
 * @return true 表示状态页有效且可见，并存在保持期刚到期的反白槽位；false 表示状态页无效、罐上操作或息屏正在占用界面，或所有反白仍在保持期内或已经清除。
 */
static bool Display_ShouldRequestStatusHighlightRefresh(void);
/**
 * @brief 仅在匹配槽位仍处于反白期且内容一致时返回反色标志。
 *
 * @param id 编号。该值是 CPU3 状态页固定槽位标识，用于在快照中定位同一业务字段并执行全量或差量重绘。
 * @param row OLED 绘制使用的行号。取值使用 OLED_ROW4_x 等页面行坐标常量，决定文字或数字写入的纵向基线。
 * @param value 待格式化并绘制到 OLED 的数值。
 * @param is_text true 表示按文字宽度计算布局，false 表示按数值格式计算。
 * @param text 待测量、排版或写入状态槽的 NUL 结尾显示文字；宽度计算同时处理 ASCII 与中文字节。
 * @return 1 表示目标状态槽仍处于内容一致的反白保持期；槽位无效、内容变化或保持期结束时返回 0。
 */
static uint8_t Display_GetStatusSlotShift(DisplayStatusSlotId id,
                                          uint8_t row,
                                          int32_t value,
                                          bool is_text,
                                          const char *text);
/**
 * @brief 按页面清屏策略清除下一次绘制涉及的 OLED 区域。
 * @return true 表示普通清屏或硬恢复成功；false 表示底层发送失败，本帧不得继续绘制。
 */
static bool Display_ClearBeforeDraw(void);
/**
 * @brief 执行一次 OLED 硬恢复，并在失败时安排不超过上限的后续重试。
 * @return true 表示本次硬恢复成功；false 表示失败，本帧不得继续绘制或提交。
 */
static bool Display_PerformRecovery(void);
/**
 * @brief 请求一轮新的 OLED 硬恢复，并重置该轮连续失败计数。
 */
static void Display_RequestRecovery(void);
/**
 * @brief 主动恢复、SPI 错误计数变化或周期到期时，要求下一帧恢复 OLED 状态。
 * @return true 表示收到主动恢复请求、OLED SPI 累计错误数发生变化，或周期恢复时限已到；false 表示本帧无需重新初始化 OLED 绘制状态。
 */
static bool Display_ShouldRecoverBeforeDraw(void);
/**
 * @brief 执行确认键或返回键长按动作，并提交对应前景绘制帧。
 *
 * @param long_press_key 长按按键。
 */
static void Display_ProcessLongPressAction(uint8_t long_press_key);
/**
 * @brief 主循环中优先处理长按动作，再依次消费普通按键事件。
 */
static void Display_ProcessPendingInput(void);
/**
 * @brief 记录菜单最近一次有效交互时间。
 *
 * @param now 当前 HAL tick。该值单位为 ms，用于记录最近菜单操作时间并计算状态页自动恢复等待时间。
 * @note 仅在主循环处理菜单进入或有效按键后调用，不在中断中修改页面状态。
 */
static void Display_RecordMenuActivity(uint32_t now);
/**
 * @brief 菜单长时间无操作时自动退回状态页。
 * @note 电机运行监控、扭力等待等业务等待页不参与普通菜单空闲退出。
 */
static void Display_ProcessMenuIdleExit(void);


/**
 * @brief 按当前字节编码在 OLED 上绘制 ASCII 字符或中文字模，并计算下一横向绘制坐标。
 *
 * 函数读取 display 指向的字节序列：ASCII 字节在 CharStockMap 中匹配并按 4 列推进，中文字节组在 StockMap、WordStock 和 WordStock2 中匹配并按
 * 7 列推进。
 * 达到 cnt 指定的编码字节数或横坐标到达 OLED_LINE8_END 后停止；字库缺字时仍保留对应中文字符的横向空位。
 *
 * @param display 指向待绘制字节序列首地址的二级指针；函数读取 *display，但不会把局部推进后的地址回写给调用方。
 * @param cnt 本次最多消费的编码字节数；ASCII字符计1字节，当前UTF-8中文字符按3字节累计。
 * @param x 首个字符的 OLED 横向列坐标；函数在此基础上累加字符宽度并返回下一可用坐标。
 * @param y 字符或中文字模的 OLED 纵向绘制坐标。
 * @param shift 传给字模绘制函数的阴码、阳码选择值。
 * @return 返回本轮绘制结束后的下一 OLED 横向列坐标；ASCII 每个推进 4 列，中文字符每个推进 7 列，达到 OLED_LINE8_END 时提前停止。
 * @note 函数只在局部变量中推进字符串读取指针，不会回写调用方的 *display；返回值用于调用方继续安排同一行后续绘制位置。
 */
static uint8_t matchingwordstock(const uint8_t *display,int cnt,int x,int y,int shift)
{
    int i,j;
    const uint8_t *pdisplay;
    const uint8_t *pstockmap;

    pdisplay = display; /* 指向要显示的字符串首地址 */
    for(i = 0;i < cnt;)
    {
        if(x >= OLED_LINE8_END)
            break;
        if((*pdisplay) < 128)
        {
            pstockmap = CharStockMap;
            for(j=0;j<CharStockMapLength;j++)
            {
                if(*pstockmap == *pdisplay)
                {
                    write_816(x,y,CharStock,j,shift);
                }
                pstockmap++;
            }
            x += 4;
            pdisplay++;
            i++;
        }
        else
        {
            pstockmap = StockMap; /* 指向索引字库首地址 */
            /* 遍历字库中是否有要显示的汉字 */
            for(j = 0;j< StockmapLength ;j++)
            {
                if((*pstockmap == *pdisplay) && (*(pstockmap + 1)== *(pdisplay + 1)) && (*(pstockmap + 2)== *(pdisplay + 2)))
                {
                    if(j < WordStockGlyphCount)
                    {
                        write_hanzi16(x,y,WordStock,j,j + 1,shift);
                    }
                    else
                    {
                        write_hanzi16(x,y,WordStock2,j - WordStockGlyphCount,j + 1 - WordStockGlyphCount,shift);
                    }
                    break;
                }
                /* 当前UTF-8中文字库索引每个字符占3字节。 */
            pstockmap += OLED_HANZI_UTF8_BYTES;
            }
            /* 无论字库是否包含要显示的字,位置都向右移,字库中没有的空出位置 */
            x += 7;
            pdisplay += OLED_HANZI_UTF8_BYTES;
            i += OLED_HANZI_UTF8_BYTES;
        }
    }
    return x;
}
/**
 * @brief 显示多个汉字或字符。
 *
 * @param data 待绘制的只读NUL结尾OLED文字字节串；ASCII和中文字节按当前字库规则依次推进横向列坐标。
 * @param x 算法、坐标或比较使用的 X 值。
 * @param y 算法、坐标或比较使用的 Y 值。
 * @param shift OLED 字模阴码/阳码或显示偏移选项。
 * @return 返回字符串绘制完成后的下一 OLED 横坐标；data 为空时保持传入横坐标 y。
 */
uint8_t OledDisplayLineWords(const void *data,uint8_t x,uint8_t y,uint8_t shift)
{
    const uint8_t *display = (const uint8_t *)data;
    int len = 0;
    if(display == NULL)
        return y;
    while(*(display + len) != 0)
    {
        len++;
    }
    y = matchingwordstock(display,len,x,y,shift);
    return y;
}
/**
 * @brief 设备刚上电还未与CPU2通讯时显示初始化中。
 */
void EquipFirstPower(void)
{
    int line;
    if (!Display_ClearBeforeDraw()) {
        return;
    }
    DisplayLangaugeLineWords((uint8_t*)"通讯尝试中...",0,OLED_ROW4_1,0,(u8*)"Communicate Attempt...");
    line = DisplayLangaugeLineWords((uint8_t*)"版本:",0,OLED_ROW4_2,0,(u8*)"Version:");
    OledDisplayLineWords(CPU3_APP_VERSION_STRING,line,OLED_ROW4_2,0);
}
/**
 * @brief OLED 初始化完成后立即绘制启动页。
 *
 * @details 调用场景：CPU3 上电初始化显示模块后调用。
 * @note 关键约束：不得在首帧前阻塞等待，CPU2 快照未完成时由现有启动页门禁显示通讯提示。
 */
void DisplayAubonLogo(void)
{
    RefreshScreen();
}
/**
 * @brief 根据刷新周期和状态页布局变化，选择高亮恢复、全量重绘或差量更新当前设备数据。
 *
 * 未到采样周期且布局稳定时只恢复按键高亮；需要刷新时先构建设备状态快照，再依据恢复请求和布局变化决定全量或差量绘制。
 * 绘制完成后保存本轮快照并重置状态数据刷新时刻，供下一帧判断变化范围。
 */
static void oled_workingdata(void)
{
    DisplayStatusSnapshot current_snapshot;
    uint32_t now = HAL_GetTick();

    if (!display_status_full_redraw_required &&
        !display_recover_before_draw &&
        display_status_active_snapshot.valid &&
        !Display_ShouldSampleStatusData(now)) {
        Display_DrawStatusHighlightRestore();
        return;
    }

    Display_BuildStatusSnapshot(&current_snapshot);
    if (display_status_full_redraw_required ||
        display_recover_before_draw ||
        Display_StatusLayoutChanged(&current_snapshot, &display_status_last_snapshot)) {
        if (!Display_DrawStatusFull(&current_snapshot)) {
            return;
        }
    } else {
        Display_DrawStatusDelta(&current_snapshot, &display_status_last_snapshot);
    }
    display_status_last_snapshot = current_snapshot;
    Display_ResetStatusDataRefreshTick(now);
}
/**
 * @brief 显示一个数字。
 *
 * @param c 待绘制的十进制数字，合法范围为 0 至 9。
 * @param row OLED 绘制使用的行号。取值使用 OLED_ROW4_x 等页面行坐标常量，决定文字或数字写入的纵向基线。
 * @param line OLED 绘制使用的横向列位置。
 * @param shift OLED 字模阴码/阳码或显示偏移选项。
 * @return 返回单个数字字模绘制完成后的下一 OLED 横坐标，即传入 line 加 4。
 */
uint8_t OledDisplayOneNmb(int c,uint8_t row,uint8_t line,uint8_t shift)
{
    write_816(line,row,NumberStock,c,shift);
    return (line + 4);
}
/**
 * @brief 裁剪定点数尾随零后，在 OLED 指定位置绘制带符号数值及可选工程单位。
 *
 * @param value 待格式化并绘制到 OLED 的数值。
 * @param line OLED 绘制使用的横向列位置。
 * @param row OLED 绘制使用的行号。取值使用 OLED_ROW4_x 等页面行坐标常量，决定文字或数字写入的纵向基线。
 * @param shift OLED 字模阴码/阳码或显示偏移选项。
 * @param points value 当前采用的小数位数；函数先裁掉尾随零，再按剩余位数插入小数点。
 * @param unit 数值对应的工程单位文字。
 * @return 返回数值及可选单位绘制完成后的下一 OLED 横坐标。
 */
uint8_t OledValueDisplay(int value,uint8_t line,uint8_t row,uint8_t shift,uint8_t points,uint8_t* unit)
{
    uint8_t deci;
    int sgn = 1;
    /* 求出要显示的数据的符号，并裁剪小数末尾无效的0 */
    if(value < 0)
    {
        sgn = -1;
        value = abs(value);
    }
    points = trim_display_points(&value, points);
    deci = judgedecimals(value);
    /* 显示数值 */
    line = dis_number(sgn,value,points,line,row,shift,deci);
    /* 显示单位 */
    if(unit != NULL)
        line = OledDisplayLineWords(unit,line,row,shift);
    return line;
}
/**
 * @brief 裁剪小数尾随0: 16.000->16, 16.100->16.1, 16.120->16.12。
 *
 * @param value 以定点整数保存的显示数值；函数会原地除去与尾随零对应的十进制位。
 * @param points 当前定点数值保留的小数位数，也是允许裁剪的最大位数。
 * @return 返回裁剪后的有效小数位数；value 为 NULL 时保持传入的 points 不变。
 */
static uint8_t trim_display_points(int *value, uint8_t points)
{
    if(value == NULL)
        return points;

    while(points > 0U && ((*value % 10) == 0))
    {
        *value /= 10;
        points--;
    }

    return points;
}
/**
 * @brief 统计有符号整数绝对值的十进制数字个数。
 *
 * @param value 待统计位数的有符号整数；负号不计入位数，函数按绝对值统计。
 * @return 返回 value 绝对值的十进制数字个数；0 返回 1，负号不计入位数。
 */
static uint8_t judgedecimals(int value)
{
    uint8_t cnt = 1;
    uint32_t number;

    number = abs(value);
    while(number / 10)
    {
        cnt++;
        number /= 10;
    }
    return cnt;
}
/**
 * @brief 按符号、整数位数和小数位数在 OLED 指定位置逐位绘制数值。
 *
 * @param sgn 数值符号，1 表示正数，-1 表示负数。
 * @param value 待格式化并绘制到 OLED 的数值。
 * @param points value 需要显示的小数位数；决定小数点位置和小数部分循环次数。
 * @param line OLED 绘制使用的横向列位置。
 * @param row OLED 绘制使用的行号。取值使用 OLED_ROW4_x 等页面行坐标常量，决定文字或数字写入的纵向基线。
 * @param shift OLED 字模阴码/阳码或显示偏移选项。
 * @param deci 当前数值整数部分的十进制位数。
 * @return 返回符号、整数、小数点和小数位全部绘制完成后的下一 OLED 横坐标。
 */
static uint8_t dis_number(int sgn,int value,int points,uint8_t line,uint8_t row,uint8_t shift,uint8_t deci)
{
    int i;
    int n;

    /* 若有负号先显示出负号 */
    if(sgn == -1)
        line = OledDisplayOneNmb(11,row,line,shift);
    /* 显示数字 */
    if(deci <= points)
        line = OledDisplayOneNmb(0,row,line,shift);
    
    for(i = deci - 1;i >= points;i--)
    {
        n = value / pow(10,i) ;
        line = OledDisplayOneNmb(n,row,line,shift);
        value %= (uint32_t)pow(10,i);
    }
    if(points > 0)
    {
        line = OledDisplayOneNmb(10,row,line,shift);
        line -= 2;
        for(i = points - 1;i >= 0;i--)
        {
            n = value / pow(10,i) ;
            line = OledDisplayOneNmb(n,row,line,shift);
            value %= (uint32_t)pow(10,i);
        }
    }
    return line;
}
/**
 * @brief 初始化 OLED、显示恢复节拍、按键计时、刷新定时器以及菜单输入状态。
 */
void DisplayInit(void)
{
    OLED_Init();    /* 屏幕初始化 */
    display_last_recover_tick = HAL_GetTick();
    display_last_key_tick = display_last_recover_tick;
    display_last_spi_error_count = OLED_GetSpiErrorCount();
    HAL_TIM_Base_Start_IT(&htim3);
/* Timer7Init(); / /长按确定键计时定时器 */
/* Timer1Init(); / /检测按键,超时退出罐上操作定时器 */
/* Timer6Init(); / /刷新屏幕定时器 */
/* Timer6Start(3);/ /3S刷新一次屏幕状态 */
/* readParaInit(); */
    ClearPageNum();
    InputValueInit();
}

/**
 * @brief 请求主循环执行一次屏幕刷新，不在中断中直接绘制 OLED。
 */
void Display_RequestRefresh(void)
{
    display_refresh_pending = true;
}

/**
 * @brief 按页面清屏策略清除下一次绘制涉及的 OLED 区域。
 */
static bool Display_ClearBeforeDraw(void)
{
    if (display_recover_before_draw) {
        return Display_PerformRecovery();
    }
    return OLED_Clear() == HAL_OK;
}

/**
 * @brief 请求一轮新的 OLED 硬恢复，并重置该轮连续失败计数。
 */
static void Display_RequestRecovery(void)
{
    display_recover_attempt_count = 0U;
    display_recover_requested = true;
}

/**
 * @brief 执行一次 OLED 硬恢复，并在失败时安排不超过上限的后续重试。
 * @return true 表示本次硬恢复成功；false 表示失败，本帧不得继续绘制或提交。
 */
static bool Display_PerformRecovery(void)
{
    HAL_StatusTypeDef status = OLED_RecoverAndClear();

    /* 本次恢复产生的 SPI 错误已经在底层累计，立即确认计数，避免同一错误绕过重试上限。 */
    display_last_spi_error_count = OLED_GetSpiErrorCount();
    if (status == HAL_OK) {
        display_recover_attempt_count = 0U;
        display_recover_requested = false;
        return true;
    }

    if (display_recover_attempt_count < DISPLAY_RECOVER_MAX_ATTEMPTS) {
        display_recover_attempt_count++;
    }
    display_last_recover_tick = HAL_GetTick();
    display_recover_requested =
        (display_recover_attempt_count < DISPLAY_RECOVER_MAX_ATTEMPTS);
    return false;
}

/**
 * @brief 主动恢复、SPI 错误计数变化或周期到期时，要求下一帧恢复 OLED 状态。
 * @return true 表示收到主动恢复请求、OLED SPI 累计错误数发生变化，或周期恢复时限已到；false 表示本帧无需重新初始化 OLED 绘制状态。
 */
static bool Display_ShouldRecoverBeforeDraw(void)
{
    uint32_t now = HAL_GetTick();
    uint32_t spi_error_count = OLED_GetSpiErrorCount();

    if (display_recover_requested) {
        display_recover_requested = false;
        display_last_recover_tick = now;
        return true;
    }

    /* OLED SPI 累计错误数一旦增加，下一帧立即执行恢复；不能继续等待周期性恢复窗口。 */
    if (spi_error_count != display_last_spi_error_count) {
        display_last_spi_error_count = spi_error_count;
        display_recover_attempt_count = 0U;
        display_last_recover_tick = now;
        return true;
    }

    if ((now - display_last_recover_tick) >= DISPLAY_RECOVER_INTERVAL_MS) {
        display_recover_attempt_count = 0U;
        display_last_recover_tick = now;
        return true;
    }

    return false;
}

/**
 * @brief 记录显示帧开始时的 SPI 错误计数，供帧结束时判断本次绘制是否无新增错误。
 * @return 返回进入本次显示帧时的 OLED SPI 累计错误计数快照；帧结束时与新计数比较。
 */
static uint32_t Display_BeginFrame(void)
{
    return OLED_GetSpiErrorCount();
}

/**
 * @brief 清除本次恢复标记；若绘制期间无新增 SPI 错误，则记录逻辑显示帧完成。
 *
 * @param frame_spi_error_start 本帧开始绘制前读取的 OLED SPI 累计错误计数快照；结束时与当前计数比较，用于判断绘制期间是否新增传输错误。
 */
static void Display_FinishFrame(uint32_t frame_spi_error_start)
{
    display_recover_before_draw = false;
    /* 只有本帧绘制期间没有新增 SPI 错误，才更新影子显存 CRC 并推进完整刷新序号。 */
    if (OLED_GetSpiErrorCount() == frame_spi_error_start) {
        OLED_MarkFrameComplete();
    }
}

/**
 * @brief 前景页绘制前重置状态页局部刷新缓存，并按需恢复 OLED。
 *
 * @param frame_spi_error_start 输出前景绘制开始时的 OLED SPI 累计错误计数，供帧结束时判断是否新增传输错误。
 * @return true 表示可以继续绘制；false 表示 OLED 恢复失败，本帧必须停止。
 */
static bool Display_PrepareForForegroundDraw(uint32_t *frame_spi_error_start)
{
    bool should_recover;

    if (frame_spi_error_start == NULL) {
        return false;
    }
    *frame_spi_error_start = Display_BeginFrame();

    /* 菜单、确认页等前景界面会覆盖整屏，回到状态页时不能继续用状态页局部刷新缓存。 */
    display_status_full_redraw_required = true;

    if (display_screen_off_active) {
        OLED_DisplayOn();
        Display_RequestRecovery();
        display_screen_off_active = false;
    }

    should_recover = Display_ShouldRecoverBeforeDraw();
    display_recover_before_draw = false;
    if (should_recover && !Display_PerformRecovery()) {
        return false;
    }

    return true;
}

/**
 * @brief 执行确认键或返回键长按动作，并提交对应前景绘制帧。
 *
 * @param long_press_key 长按按键。
 */
static void Display_ProcessLongPressAction(uint8_t long_press_key)
{
    if (long_press_key == LONG_PRESS_KEY_SURE) {
        uint32_t frame_spi_error_start;

        if (!Display_PrepareForForegroundDraw(&frame_spi_error_start)) {
            return;
        }
        FlagofTankOpera = true;
        Display_RecordMenuActivity(HAL_GetTick());
        useKey();
        keymenu[KEYNUM_IF_ENTER_MAINMENU].execute_opera();
        Display_FinishFrame(frame_spi_error_start);
    } else if (long_press_key == LONG_PRESS_KEY_BACK) {
        bool prepared = false;
        uint32_t frame_spi_error_start = 0U;

        /* 与长按确认进菜单一致：先进入确认页，确认键再执行对应动作。 */
        if (Display_CanEnterCancelMeasurementConfirm()) {
            if (!Display_PrepareForForegroundDraw(&frame_spi_error_start)) {
                return;
            }
            prepared = true;
        }
        if (Display_EnterCancelMeasurementConfirm()) {
            Display_RecordMenuActivity(HAL_GetTick());
            Display_FinishFrame(frame_spi_error_start);
        } else if (prepared) {
            display_recover_before_draw = false;
        }
    }
}

/**
 * @brief 主循环中优先处理长按动作，再依次消费普通按键事件。
 */
static void Display_ProcessPendingInput(void)
{
    uint8_t keypress;
    uint8_t long_press_key = Display_TakePendingLongPressAction();

    if (long_press_key != LONG_PRESS_KEY_NONE) {
        Display_ProcessLongPressAction(long_press_key);
        return;
    }

    do {
        keypress = Display_TakePendingKey();
        if ((keypress != 0U) && (FlagofTankOpera == true)) {
            bool prepared = false;
            uint32_t frame_spi_error_start = 0U;

            if (DisplayTankOpera_CanProcessKey(keypress)) {
                if (!Display_PrepareForForegroundDraw(&frame_spi_error_start)) {
                    return;
                }
                prepared = true;
            }
            if (KeyProcess(keypress)) {
                Display_RecordMenuActivity(HAL_GetTick());
                Display_FinishFrame(frame_spi_error_start);
            } else if (prepared) {
                display_recover_before_draw = false;
            }
        }
    } while (keypress != 0U);
}

/**
 * @brief 记录菜单最近一次有效交互时间。
 *
 * @param now 当前 HAL tick。该值单位为 ms，用于记录最近菜单操作时间并计算状态页自动恢复等待时间。
 * @note 仅在主循环处理菜单进入或有效按键后调用，不在中断中修改页面状态。
 */
static void Display_RecordMenuActivity(uint32_t now)
{
    display_menu_last_activity_tick = now;
}

/**
 * @brief 菜单长时间无操作时自动退回状态页。
 * @note 电机运行监控、扭力等待等业务等待页不参与普通菜单空闲退出。
 */
static void Display_ProcessMenuIdleExit(void)
{
    uint32_t now;

    if (!DisplayTankOpera_CanIdleExit()) {
        display_menu_last_activity_tick = HAL_GetTick();
        return;
    }

    now = HAL_GetTick();
    if ((uint32_t)(now - display_menu_last_activity_tick) < DISPLAY_MENU_IDLE_EXIT_MS) {
        return;
    }

    exitTankOpera();
    Display_ClearPendingKeys();
    Display_RecordMenuActivity(now);
    Display_RequestRefresh();
}

/**
 * @brief 处理显示刷新、按键事件和状态页增量更新。
 */
void Display_Task(void)
{
    Display_UpdateLongPressReleaseGuard();
    Display_ProcessPendingInput();
    Display_ProcessMenuIdleExit();

    if (!display_refresh_pending && Display_ShouldRequestStatusHighlightRefresh()) {
        display_refresh_pending = true;
    }

    if (display_refresh_pending) {
        uint32_t start_tick = HAL_GetTick();
        display_refresh_pending = false;
        RefreshScreen();
        display_last_refresh_ms = HAL_GetTick() - start_tick;
        /* 完整刷新耗时超过门限时累计超时次数，供显示性能诊断；该统计不在此处中断当前页面流程。 */
        if (display_last_refresh_ms > DISPLAY_REFRESH_TIMEOUT_MS) {
            display_refresh_timeout_count++;
        }
    }
}

/**
 * @brief 将三段 MAC 快照格式化为两行十六进制文本。
 *
 * @param status 已经完成配对结果和 MAC 有效性校验的无线状态快照。
 * @param line1 用于返回无线 MAC 地址前半段显示文字的定长缓存。
 * @param line2 用于返回无线 MAC 地址后半段显示文字的定长缓存。
 */
static void Display_FormatWirelessPairingMac(const volatile WirelessPairingStatus *status,
                                             char line1[9],
                                             char line2[9])
{
    uint32_t mac_high = status->mac_high;
    uint32_t mac_mid = status->mac_mid;
    uint32_t mac_low = status->mac_low;

    snprintf(line1, 9, "%02lX:%02lX:%02lX",
             (unsigned long)((mac_high >> 8) & 0xFFU),
             (unsigned long)(mac_high & 0xFFU),
             (unsigned long)((mac_mid >> 8) & 0xFFU));
    snprintf(line2, 9, "%02lX:%02lX:%02lX",
             (unsigned long)(mac_mid & 0xFFU),
             (unsigned long)((mac_low >> 8) & 0xFFU),
             (unsigned long)(mac_low & 0xFFU));
}

/**
 * @brief 格式化读取部件参数页的连接从机蓝牙 MAC。
 *
 * @param status 无线连接状态。
 * @param line 输出显示文本。
 * @param line_size 输出缓冲区长度。
 */
static void Display_FormatWirelessConnectionMacCompact(const volatile WirelessPairingStatus *status,
                                                       char *line,
                                                       size_t line_size)
{
    uint32_t mac_high;
    uint32_t mac_mid;
    uint32_t mac_low;

    if ((status == NULL) || (line == NULL) || (line_size == 0U)) {
        return;
    }

    mac_high = status->mac_high;
    mac_mid = status->mac_mid;
    mac_low = status->mac_low;
    snprintf(line,
             line_size,
             "MAC:%02lX%02lX%02lX%02lX%02lX%02lX",
             (unsigned long)((mac_high >> 8) & 0xFFU),
             (unsigned long)(mac_high & 0xFFU),
             (unsigned long)((mac_mid >> 8) & 0xFFU),
             (unsigned long)(mac_mid & 0xFFU),
             (unsigned long)((mac_low >> 8) & 0xFFU),
             (unsigned long)(mac_low & 0xFFU));
}

/**
 * @brief 按当前语言设置返回中文或英文显示文字。
 *
 * @param name_cn 当前语言为中文时返回的只读文字；允许为 NULL。
 * @param name_en 当前语言为英文时返回的只读文字；为空时回退到中文文字。
 * @return 返回按当前语言设置返回中文或英文显示文字对应的只读文本首地址；内容由当前输入或语言配置选择，调用方不得修改或释放。
 */
static const char *Display_SelectLanguageText(const uint8_t *name_cn, const uint8_t *name_en)
{
    if ((screen_parameter.language == LANGUAGE_ENGLISH) && (name_en != NULL)) {
        return (const char *)name_en;
    }

    return (const char *)name_cn;
}

/**
 * @brief 计算中英文标签绘制后占用的最后一行。
 *
 * @param name_cn 用于计算中文标签宽度的只读文字。
 * @param name_en 用于计算英文标签宽度的只读文字；为空时使用中文标签。
 * @return 返回中英文标签绘制后占用的最后一行的有效长度，单位字节；0 表示没有可供消费的数据。
 */
static uint8_t Display_GetLabelEndLine(const uint8_t *name_cn, const uint8_t *name_en)
{
    return Display_GetTextWidth(Display_SelectLanguageText(name_cn, name_en), 63U);
}

/**
 * @brief 把状态文字安全复制到固定长度的状态槽缓存。
 *
 * @param dest 状态文字的目标定长缓存。
 * @param src 待复制到状态槽的只读文字；NULL 按空字符串处理。
 */
static void Display_CopyStatusText(char dest[32], const char *src)
{
    uint8_t i;

    if (src == NULL) {
        dest[0] = '\0';
        return;
    }

    for (i = 0U; (src[i] != '\0') && (i < 31U); i++) {
        dest[i] = src[i];
    }
    dest[i] = '\0';
}

/**
 * @brief 向状态页快照追加一个有序显示槽；参数无效或容量已满时返回 NULL，成功后由调用方填入数值或文本。
 *
 * @param snapshot 可写 CPU3 状态页快照；函数追加或读取固定槽位中的文字、数值、位置、反显和数据新鲜度，最终用于全量或差量绘制。
 * @param id 编号。该值是 CPU3 状态页固定槽位标识，用于在快照中定位同一业务字段并执行全量或差量重绘。
 * @param row OLED 绘制使用的行号。取值使用 OLED_ROW4_x 等页面行坐标常量，决定文字或数字写入的纵向基线。
 * @param value_line 状态槽数值或文字在 OLED 上开始绘制的横向像素位置。
 * @return 成功时返回指向向状态页快照追加一个有序显示槽；参数无效或容量已满时返回 NULL，成功后由调用方填入数值或文本的指针；输入非法或未找到匹配项时返回 NULL。
 */
static DisplayStatusSlot *Display_AddStatusSlot(DisplayStatusSnapshot *snapshot,
                                                DisplayStatusSlotId id,
                                                uint8_t row,
                                                uint8_t value_line)
{
    DisplayStatusSlot *slot;

    if ((snapshot == NULL) || (snapshot->slot_count >= DISPLAY_STATUS_MAX_SLOTS)) {
        return NULL;
    }

    slot = &snapshot->slots[snapshot->slot_count];
    memset(slot, 0, sizeof(*slot));
    slot->id = id;
    slot->row = row;
    slot->value_line = value_line;
    snapshot->slot_count++;
    return slot;
}

/**
 * @brief 向状态页快照追加数值槽，并记录显示值、小数位和单位。
 *
 * @param snapshot 可写 CPU3 状态页快照；函数追加或读取固定槽位中的文字、数值、位置、反显和数据新鲜度，最终用于全量或差量绘制。
 * @param id 编号。该值是 CPU3 状态页固定槽位标识，用于在快照中定位同一业务字段并执行全量或差量重绘。
 * @param row OLED 绘制使用的行号。取值使用 OLED_ROW4_x 等页面行坐标常量，决定文字或数字写入的纵向基线。
 * @param value_line 状态槽数值或文字在 OLED 上开始绘制的横向像素位置。
 * @param value 待格式化并绘制到 OLED 的数值。
 * @param points 状态页数值槽的小数位数；后续绘制按该位数缩放和格式化 value。
 * @param unit 数值对应的工程单位文字。
 */
static void Display_AddValueStatusSlot(DisplayStatusSnapshot *snapshot,
                                       DisplayStatusSlotId id,
                                       uint8_t row,
                                       uint8_t value_line,
                                       int32_t value,
                                       uint8_t points,
                                       const uint8_t *unit)
{
    DisplayStatusSlot *slot = Display_AddStatusSlot(snapshot, id, row, value_line);

    if (slot != NULL) {
        slot->is_text = false;
        slot->value = value;
        slot->points = points;
        slot->unit = unit;
    }
}

/**
 * @brief 向状态页快照追加文本槽，并复制受长度限制的显示文本。
 *
 * @param snapshot 可写 CPU3 状态页快照；函数追加或读取固定槽位中的文字、数值、位置、反显和数据新鲜度，最终用于全量或差量绘制。
 * @param id 编号。该值是 CPU3 状态页固定槽位标识，用于在快照中定位同一业务字段并执行全量或差量重绘。
 * @param row OLED 绘制使用的行号。取值使用 OLED_ROW4_x 等页面行坐标常量，决定文字或数字写入的纵向基线。
 * @param value_line 状态槽数值或文字在 OLED 上开始绘制的横向像素位置。
 * @param text 待测量、排版或写入状态槽的 NUL 结尾显示文字；宽度计算同时处理 ASCII 与中文字节。
 */
static void Display_AddTextStatusSlot(DisplayStatusSnapshot *snapshot,
                                      DisplayStatusSlotId id,
                                      uint8_t row,
                                      uint8_t value_line,
                                      const char *text)
{
    DisplayStatusSlot *slot = Display_AddStatusSlot(snapshot, id, row, value_line);

    if (slot != NULL) {
        slot->is_text = true;
        Display_CopyStatusText(slot->text, text);
    }
}

/**
 * @brief 按 OLED 可用宽度拆分当前故障原因，并加入状态页文本槽。
 *
 * @param snapshot 可写 CPU3 状态页快照；函数追加或读取固定槽位中的文字、数值、位置、反显和数据新鲜度，最终用于全量或差量绘制。
 * @param now_page 页面。
 */
static void Display_AddErrorReasonStatusSlots(DisplayStatusSnapshot *snapshot, int now_page)
{
    const char *reason = Display_GetErrorReasonByCode(g_measurement.device_status.error_code);
    char first_line[32];
    uint8_t prefix_width = Display_GetTextWidth("故障:", 7U);
    uint8_t first_bytes = Display_GetFitTextBytes(reason, prefix_width);

    /* 当前页包含故障原因首行槽位时，只复制本行能够容纳的完整字节。 */
    if ((ValidParaDisArr[Para_ErrorReason][PARA_VALID] == true) &&
        (now_page == ValidParaDisArr[Para_ErrorReason][PARA_PAGE])) {
        uint8_t i;

        for (i = 0U; (i < first_bytes) && (i < (sizeof(first_line) - 1U)); i++) {
            first_line[i] = reason[i];
        }
        first_line[i] = '\0';
        Display_AddTextStatusSlot(snapshot,
                                  DISPLAY_STATUS_SLOT_ERROR_REASON,
                                  (uint8_t)ValidParaDisArr[Para_ErrorReason][PARA_X],
                                  prefix_width,
                                  first_line);
    }

    /* 仅当原因仍有剩余文本且当前页分配了续行槽位时，才发布第二行故障原因。 */
    if ((ValidParaDisArr[Para_ErrorReasonMore][PARA_VALID] == true) &&
        (now_page == ValidParaDisArr[Para_ErrorReasonMore][PARA_PAGE]) &&
        (reason[first_bytes] != '\0')) {
        Display_AddTextStatusSlot(snapshot,
                                  DISPLAY_STATUS_SLOT_ERROR_REASON_MORE,
                                  (uint8_t)ValidParaDisArr[Para_ErrorReasonMore][PARA_X],
                                  OLED_LINE8_1,
                                  &reason[first_bytes]);
    }
}

/**
 * @brief 根据当前状态页及数据有效性构建本页数值和文本槽。
 *
 * 函数先追加当前错误原因槽，再依据 ValidParaDisArr
 * 中每个项目的有效标志、所属页号和行坐标，为当前页选择性追加液位、水位、密度、温度、位置、扭力、扭力模块温度、传感器频率、电容、姿态角、罐高、无线 RSSI 和对端 MAC。
 * 数值来源随 snapshot->ctx 切换：结果页优先读取已经发布的测量结果，部件读取页使用调试快照；温度按内部偏移恢复为 0.01 ℃，长度保留 0.1 mm，密度保留两位小数，频率使用
 * Hz，RSSI 使用 dB。
 * 液位处于下盲区时显示“低于盲区”而不是伪造数值；扭力模块温度无效时显示“--.--”，RSSI 或 MAC 尚未确认时分别追加 N/A 文本槽。
 * 本函数只向 DisplayStatusSnapshot 追加用于后续全量或差量绘制的槽，不直接刷新 OLED；同一槽位编号用于让绘制层识别内容变化并清除旧区域。
 *
 * @param snapshot 当前结果页的可写状态快照；函数向其中追加带固定槽位编号的文字或数值项，供后续全量或差量 OLED 绘制。
 * @param now_page 当前待构建的结果页页号；仅追加 ValidParaDisArr 中 PARA_PAGE 与该值相等的项目。
 * @note 调用方必须传入已初始化且可继续追加槽位的 snapshot，并先完成 CalculateValidPara 页面布局；本函数不检查 snapshot 空指针。
 */
static void Display_AddCurrentPageValueStatusSlots(DisplayStatusSnapshot *snapshot, int now_page)
{
    uint8_t row;
    uint8_t line;
    uint32_t display_value = 0U;
    int display_position = 0;
    int display_frequency;
    int display_capacitance;
    int32_t torque_temperature_x100;

    Display_AddErrorReasonStatusSlots(snapshot, now_page);

    if (flagofoillevelvalid == true) {
        row = FlagofTotalTwoRow ? OLED_ROW4_3 : OLED_ROW4_2;
        line = Display_GetLabelEndLine((uint8_t*)"液位:", (uint8_t*)"Level:");
        if (Display_GetOilLevelValue(snapshot->ctx, &display_value) &&
            ((display_value == OILLEVELDOWNLIMIT) || (display_value == LEVEL_DOWNLIMIT))) {
            Display_AddTextStatusSlot(snapshot,
                                      DISPLAY_STATUS_SLOT_OIL_LEVEL,
                                      row,
                                      line,
                                      Display_SelectLanguageText((uint8_t*)"低于盲区",
                                                                 (uint8_t*)"Below Blind"));
        } else {
            Display_AddValueStatusSlot(snapshot,
                                       DISPLAY_STATUS_SLOT_OIL_LEVEL,
                                       row,
                                       line,
                                       (int32_t)display_value,
                                       1U,
                                       (uint8_t*)"mm");
        }
    }

    if ((ValidParaDisArr[Para_Waterlevel][PARA_VALID] == true) &&
        (now_page == ValidParaDisArr[Para_Waterlevel][PARA_PAGE]) &&
        Display_GetWaterLevelValue(snapshot->ctx, &display_value)) {
        Display_AddValueStatusSlot(snapshot,
                                   DISPLAY_STATUS_SLOT_WATER_LEVEL,
                                   (uint8_t)ValidParaDisArr[Para_Waterlevel][PARA_X],
                                   Display_GetLabelEndLine((uint8_t*)"水位:", (uint8_t*)"Water:"),
                                   (int32_t)display_value,
                                   1U,
                                   (uint8_t*)"mm");
    }

    if ((ValidParaDisArr[Para_AveDensity][PARA_VALID] == true) &&
        (now_page == ValidParaDisArr[Para_AveDensity][PARA_PAGE]) &&
        Display_GetDensityValue(snapshot->ctx, &display_value)) {
        Display_AddValueStatusSlot(snapshot,
                                   DISPLAY_STATUS_SLOT_DENSITY,
                                   (uint8_t)ValidParaDisArr[Para_AveDensity][PARA_X],
                                   Display_GetLabelEndLine((uint8_t*)"密度:", (uint8_t*)"D:"),
                                   (int32_t)display_value,
                                   2U,
                                   (uint8_t*)"kg/m3");
    }

    if ((ValidParaDisArr[Para_AveTemperature][PARA_VALID] == true) &&
        (now_page == ValidParaDisArr[Para_AveTemperature][PARA_PAGE]) &&
        Display_GetTemperatureValue(snapshot->ctx, &display_value)) {
        Display_AddValueStatusSlot(snapshot,
                                   DISPLAY_STATUS_SLOT_TEMPERATURE,
                                   (uint8_t)ValidParaDisArr[Para_AveTemperature][PARA_X],
                                   Display_GetLabelEndLine((uint8_t*)"温度:", (uint8_t*)"Temp:"),
                                   (int32_t)display_value - 20000,
                                   2U,
                                   (uint8_t*)"℃");
    }

    if ((ValidParaDisArr[Para_position][PARA_VALID] == true) &&
        (now_page == ValidParaDisArr[Para_position][PARA_PAGE]) &&
        Display_GetPositionValue(snapshot->ctx, &display_position)) {
        Display_AddValueStatusSlot(snapshot,
                                   DISPLAY_STATUS_SLOT_POSITION,
                                   (uint8_t)ValidParaDisArr[Para_position][PARA_X],
                                   Display_GetLabelEndLine((uint8_t*)"位置:", (uint8_t*)"Pos:"),
                                   (int32_t)display_position,
                                   1U,
                                   (uint8_t*)"mm");
    }

    if ((ValidParaDisArr[Para_weight][PARA_VALID] == true) &&
        (now_page == ValidParaDisArr[Para_weight][PARA_PAGE])) {
        Display_AddValueStatusSlot(snapshot,
                                   DISPLAY_STATUS_SLOT_WEIGHT,
                                   (uint8_t)ValidParaDisArr[Para_weight][PARA_X],
                                   Display_GetLabelEndLine((uint8_t*)"扭力:", (uint8_t*)"Torque:"),
                                   (int32_t)g_measurement.debug_data.current_weight,
                                   0U,
                                   (uint8_t*)" ");
    }

    if ((ValidParaDisArr[Para_torque_temperature][PARA_VALID] == true) &&
        (now_page == ValidParaDisArr[Para_torque_temperature][PARA_PAGE])) {
        row = (uint8_t)ValidParaDisArr[Para_torque_temperature][PARA_X];
        line = Display_GetLabelEndLine((uint8_t*)"扭温:", (uint8_t*)"T.Temp:");
        if (Display_GetTorqueTemperatureX100(snapshot->ctx, &torque_temperature_x100)) {
            Display_AddValueStatusSlot(snapshot,
                                       DISPLAY_STATUS_SLOT_TORQUE_TEMPERATURE,
                                       row,
                                       line,
                                       torque_temperature_x100,
                                       2U,
                                       (uint8_t*)"℃");
        } else {
            Display_AddTextStatusSlot(snapshot,
                                      DISPLAY_STATUS_SLOT_TORQUE_TEMPERATURE,
                                      row,
                                      line,
                                      "--.--");
        }
    }

    if ((ValidParaDisArr[Para_sensor_value][PARA_VALID] == true) &&
        (now_page == ValidParaDisArr[Para_sensor_value][PARA_PAGE])) {
        display_frequency = (snapshot->ctx == DISPLAY_RESULT_CONTEXT_READ_PARAMETER)
            ? (int)g_measurement.debug_data.frequency
            : GetOilSensorFrequencyForDisplay();
        Display_AddValueStatusSlot(snapshot,
                                   DISPLAY_STATUS_SLOT_FREQUENCY,
                                   (uint8_t)ValidParaDisArr[Para_sensor_value][PARA_X],
                                   Display_GetLabelEndLine((uint8_t*)"频率:", (uint8_t*)"Freq:"),
                                   (int32_t)display_frequency,
                                   0U,
                                   (uint8_t*)"Hz");
    }

    if ((ValidParaDisArr[Para_capacitance][PARA_VALID] == true) &&
        (now_page == ValidParaDisArr[Para_capacitance][PARA_PAGE])) {
        display_capacitance = (snapshot->ctx == DISPLAY_RESULT_CONTEXT_READ_PARAMETER)
            ? (int)g_measurement.debug_data.water_capacitance_x10
            : (int)(g_measurement.water_measurement.current_capacitance * 10.0f);
        Display_AddValueStatusSlot(snapshot,
                                   DISPLAY_STATUS_SLOT_CAPACITANCE,
                                   (uint8_t)ValidParaDisArr[Para_capacitance][PARA_X],
                                   Display_GetLabelEndLine((uint8_t*)"电容:", (uint8_t*)"Cap:"),
                                   (int32_t)display_capacitance,
                                   1U,
                                   NULL);
    }

    if ((ValidParaDisArr[Para_angle_x][PARA_VALID] == true) &&
        (now_page == ValidParaDisArr[Para_angle_x][PARA_PAGE])) {
        Display_AddValueStatusSlot(snapshot,
                                   DISPLAY_STATUS_SLOT_ANGLE_X,
                                   (uint8_t)ValidParaDisArr[Para_angle_x][PARA_X],
                                   Display_GetLabelEndLine((uint8_t*)"X角:", (uint8_t*)"AngX:"),
                                   (int32_t)g_measurement.debug_data.angle_x,
                                   2U,
                                   (uint8_t*)"°");
    }

    if ((ValidParaDisArr[Para_angle_y][PARA_VALID] == true) &&
        (now_page == ValidParaDisArr[Para_angle_y][PARA_PAGE])) {
        Display_AddValueStatusSlot(snapshot,
                                   DISPLAY_STATUS_SLOT_ANGLE_Y,
                                   (uint8_t)ValidParaDisArr[Para_angle_y][PARA_X],
                                   Display_GetLabelEndLine((uint8_t*)"Y角:", (uint8_t*)"AngY:"),
                                   (int32_t)g_measurement.debug_data.angle_y,
                                   2U,
                                   (uint8_t*)"°");
    }

    if ((ValidParaDisArr[Para_tankheight][PARA_VALID] == true) &&
        (now_page == ValidParaDisArr[Para_tankheight][PARA_PAGE])) {
        Display_AddValueStatusSlot(snapshot,
                                   DISPLAY_STATUS_SLOT_TANK_HEIGHT,
                                   (uint8_t)ValidParaDisArr[Para_tankheight][PARA_X],
                                   Display_GetLabelEndLine((uint8_t*)"罐高:", (uint8_t*)"tankH:"),
                                   (int32_t)g_measurement.height_measurement.current_real_height,
                                   1U,
                                   (uint8_t*)"mm");
    }

    if ((ValidParaDisArr[Para_wireless_rssi][PARA_VALID] == true) &&
        (now_page == ValidParaDisArr[Para_wireless_rssi][PARA_PAGE])) {
        if (g_measurement.wireless_pairing_status.rssi_valid != 0U) {
            Display_AddValueStatusSlot(snapshot,
                                       DISPLAY_STATUS_SLOT_WIRELESS_RSSI,
                                       (uint8_t)ValidParaDisArr[Para_wireless_rssi][PARA_X],
                                       Display_GetLabelEndLine((uint8_t*)"RSSI:", (uint8_t*)"RSSI:"),
                                       g_measurement.wireless_pairing_status.rssi,
                                       0U,
                                       (uint8_t*)"dB");
        } else {
            Display_AddTextStatusSlot(snapshot,
                                      DISPLAY_STATUS_SLOT_WIRELESS_RSSI_NA,
                                      (uint8_t)ValidParaDisArr[Para_wireless_rssi][PARA_X],
                                      OLED_LINE8_1,
                                      "RSSI:N/A");
        }
    }

    if ((ValidParaDisArr[Para_wireless_mac][PARA_VALID] == true) &&
        (now_page == ValidParaDisArr[Para_wireless_mac][PARA_PAGE])) {
        const volatile WirelessPairingStatus *status = &g_measurement.wireless_pairing_status;

        if ((status->connection_valid != 0U) && (status->mac_valid != 0U)) {
            char mac_line[17];

            Display_FormatWirelessConnectionMacCompact(status, mac_line, sizeof(mac_line));
            Display_AddTextStatusSlot(snapshot,
                                      DISPLAY_STATUS_SLOT_WIRELESS_MAC_COMPACT,
                                      (uint8_t)ValidParaDisArr[Para_wireless_mac][PARA_X],
                                      OLED_LINE8_1,
                                      mac_line);
        } else {
            Display_AddTextStatusSlot(snapshot,
                                      DISPLAY_STATUS_SLOT_WIRELESS_MAC_NA,
                                      (uint8_t)ValidParaDisArr[Para_wireless_mac][PARA_X],
                                      OLED_LINE8_1,
                                      "MAC N/A");
        }
    }
}

/**
 * @brief 按配对结果和 MAC 有效性追加无线状态槽。
 *
 * @param snapshot 可写 CPU3 状态页快照；函数追加或读取固定槽位中的文字、数值、位置、反显和数据新鲜度，最终用于全量或差量绘制。
 */
static void Display_AddWirelessPairingSlots(DisplayStatusSnapshot *snapshot)
{
    const volatile WirelessPairingStatus *status = &g_measurement.wireless_pairing_status;

    if ((snapshot->state != STATE_WIRELESS_PAIRING_OVER) ||
        (status->result != WIRELESS_PAIRING_RESULT_SUCCESS) ||
        (status->mac_valid == 0U)) {
        if (snapshot->state == STATE_WIRELESS_PAIRING_OVER) {
            Display_AddTextStatusSlot(snapshot,
                                      DISPLAY_STATUS_SLOT_WIRELESS_MAC_NA,
                                      OLED_ROW4_2,
                                      OLED_LINE8_2,
                                      "MAC N/A");
        }
        return;
    }

    {
        char mac_line1[9];
        char mac_line2[9];

        Display_FormatWirelessPairingMac(status, mac_line1, mac_line2);
        Display_AddTextStatusSlot(snapshot,
                                  DISPLAY_STATUS_SLOT_WIRELESS_MAC_1,
                                  OLED_ROW4_3,
                                  OLED_LINE8_2,
                                  mac_line1);
        Display_AddTextStatusSlot(snapshot,
                                  DISPLAY_STATUS_SLOT_WIRELESS_MAC_2,
                                  OLED_ROW4_4,
                                  OLED_LINE8_2,
                                  mac_line2);
    }
}

/**
 * @brief 达到页面保持次数后推进多页状态索引。
 *
 * @param page_amount 当前状态页实际可轮换的页面总数；小于等于 1 时固定显示第 0 页，否则按保持刷新次数循环推进。
 */
static void Display_AdvanceStatusPage(int page_amount)
{
    if (page_amount <= 1) {
        display_status_page_index = 0;
        display_status_page_hold_count = 0U;
        return;
    }

    if (display_status_page_hold_count < (DISPLAY_STATUS_PAGE_HOLD_REFRESHES - 1U)) {
        display_status_page_hold_count++;
        return;
    }

    display_status_page_hold_count = 0U;
    display_status_page_index++;
    if (display_status_page_index >= page_amount) {
        display_status_page_index = 0;
    }
}

/**
 * @brief 采集设备状态、语言和当前页槽位，构建本次状态页渲染快照。
 *
 * @param snapshot 可写 CPU3 状态页快照；函数追加或读取固定槽位中的文字、数值、位置、反显和数据新鲜度，最终用于全量或差量绘制。
 */
static void Display_BuildStatusSnapshot(DisplayStatusSnapshot *snapshot)
{
    uint8_t lang;

    if (snapshot == NULL) {
        return;
    }

    memset(snapshot, 0, sizeof(*snapshot));
    snapshot->valid = true;
    snapshot->state = g_measurement.device_status.device_state;
    snapshot->error_code = g_measurement.device_status.error_code;
    snapshot->ctx = Display_GetResultContext(g_measurement.device_status.device_state);
    snapshot->protocol_compatible = IsCpu2ProtocolCompatible();
    snapshot->protocol_mismatch = IsCpu2ProtocolMismatch();
    lang = (uint8_t)screen_parameter.language;
    if (lang > LANGUAGE_ENGLISH) {
        lang = LANGUAGE_ENGLISH;
    }
    snapshot->language = lang;

    CalculateValidPara();
    if ((PageAmount <= 0) || (display_status_page_index >= PageAmount)) {
        display_status_page_index = 0;
        display_status_page_hold_count = 0U;
    }

    snapshot->page = display_status_page_index;
    snapshot->page_amount = PageAmount;
    snapshot->total_two_row = FlagofTotalTwoRow;

    if ((snapshot->state == STATE_WIRELESS_PAIRING) ||
        (snapshot->state == STATE_WIRELESS_PAIRING_OVER)) {
        Display_AddWirelessPairingSlots(snapshot);
    } else {
        Display_AddCurrentPageValueStatusSlots(snapshot, snapshot->page);
    }

    Display_AdvanceStatusPage(PageAmount);
}

/**
 * @brief 判断状态槽的标签、行号或布局参数是否发生变化。
 *
 * @param current 本次准备显示的当前状态页快照。
 * @param last 上一次保存的值、状态或快照。
 * @return true 表示两个槽位的 id、文本或数值类型、行号、数值列、小数位或单位中至少一项不同；false 表示上述全部布局字段完全一致。
 */
static bool Display_StatusSlotLayoutChanged(const DisplayStatusSlot *current,
                                            const DisplayStatusSlot *last)
{
    return (current->id != last->id) ||
           (current->is_text != last->is_text) ||
           (current->row != last->row) ||
           (current->value_line != last->value_line) ||
           (current->points != last->points) ||
           (current->unit != last->unit);
}

/**
 * @brief 比较两次快照的页面和槽位布局，判断是否需要全量重绘。
 *
 * @param current 本次准备显示的当前状态页快照。
 * @param last 上一次保存的值、状态或快照。
 * @return true 表示页面类型、槽位数量、槽位标识、行位置或文字/数值布局中至少一项发生变化；false 表示两份状态页快照的布局完全一致。
 */
static bool Display_StatusLayoutChanged(const DisplayStatusSnapshot *current,
                                        const DisplayStatusSnapshot *last)
{
    uint8_t i;

    if ((current == NULL) || (last == NULL) || !last->valid) {
        return true;
    }

    if ((current->state != last->state) ||
        (current->error_code != last->error_code) ||
        (current->ctx != last->ctx) ||
        (current->protocol_compatible != last->protocol_compatible) ||
        (current->protocol_mismatch != last->protocol_mismatch) ||
        (current->language != last->language) ||
        (current->total_two_row != last->total_two_row) ||
        (current->page != last->page) ||
        (current->page_amount != last->page_amount) ||
        (current->slot_count != last->slot_count)) {
        return true;
    }

    for (i = 0U; i < current->slot_count; i++) {
        if (Display_StatusSlotLayoutChanged(&current->slots[i], &last->slots[i])) {
            return true;
        }
    }

    return false;
}

/**
 * @brief 判断状态页是否需要重新采样运行数据。
 *
 * @param now 本次判断使用的当前系统节拍，单位 ms；调用方在同一轮处理内复用该快照，避免多次取时造成边界漂移。
 * @return true 表示需要按当前 g_measurement 生成新快照，false 表示仅允许恢复反白显示。
 */
static bool Display_ShouldSampleStatusData(uint32_t now)
{
    uint8_t lang = (uint8_t)screen_parameter.language;

    if (!display_status_active_snapshot.valid) {
        return true;
    }

    if (lang > LANGUAGE_ENGLISH) {
        lang = LANGUAGE_ENGLISH;
    }

    if ((display_status_active_snapshot.state != g_measurement.device_status.device_state) ||
        (display_status_active_snapshot.error_code != g_measurement.device_status.error_code) ||
        (display_status_active_snapshot.language != lang) ||
        (display_status_active_snapshot.protocol_compatible != IsCpu2ProtocolCompatible()) ||
        (display_status_active_snapshot.protocol_mismatch != IsCpu2ProtocolMismatch())) {
        return true;
    }

    return ((now - display_status_last_data_refresh_tick) >= DISPLAY_STATUS_DATA_REFRESH_MS);
}

/**
 * @brief 记录状态页最近一次按运行数据采样的节拍。
 *
 * @param now 本次判断使用的当前系统节拍，单位 ms；调用方在同一轮处理内复用该快照，避免多次取时造成边界漂移。
 */
static void Display_ResetStatusDataRefreshTick(uint32_t now)
{
    display_status_last_data_refresh_tick = now;
}

/**
 * @brief 按状态页快照重画单个数值或文本区域。
 *
 * @param slot 状态页显示项快照。
 * @param shift 非 0 时按反显方式绘制。
 */
static void Display_DrawStatusSlotValue(const DisplayStatusSlot *slot, uint8_t shift)
{
    if (slot == NULL) {
        return;
    }

    if (slot->is_text) {
        OledDisplayLineWords(slot->text, slot->value_line, slot->row, shift);
    } else {
        OledValueDisplay((int)slot->value,
                         slot->value_line,
                         slot->row,
                         shift,
                         slot->points,
                         (uint8_t *)slot->unit);
    }
}

/**
 * @brief 判断状态槽的显示值或有效性是否发生变化。
 *
 * @param current 本次准备显示的当前状态页快照。
 * @param last 上一次保存的值、状态或快照。
 * @return true 表示任一槽位指针为空、文本或数值类型不同、文本内容不同，或数值不同；false 表示两个有效槽位类型一致且对应文本或数值内容相同。
 */
static bool Display_StatusSlotValueChanged(const DisplayStatusSlot *current,
                                           const DisplayStatusSlot *last)
{
    if ((current == NULL) || (last == NULL) || (current->is_text != last->is_text)) {
        return true;
    }

    if (current->is_text) {
        return (strncmp(current->text, last->text, sizeof(current->text)) != 0);
    }

    return (current->value != last->value);
}

/**
 * @brief 按无符号节拍回绕规则判断一个时刻是否早于另一个时刻。
 *
 * @param left 区间左端值或左侧比较对象。
 * @param right 区间右端值或右侧比较对象。
 * @return true 表示 left 按 32 位节拍回绕规则早于 right；false 表示 left 已经到达或晚于 right。
 */
static bool Display_StatusTickBefore(uint32_t left, uint32_t right)
{
    return ((int32_t)(left - right) < 0);
}

/**
 * @brief 判断指定状态槽当前是否处于高亮保持期。
 *
 * @param slot 待检查的状态槽快照，提供高亮可见标志和高亮截止节拍。
 * @param now 本次判断使用的当前系统节拍，单位 ms；调用方在同一轮处理内复用该快照，避免多次取时造成边界漂移。
 * @return true 表示槽位指针有效、反白可见标志已置位，且当前时刻仍早于反白截止时刻；false 表示槽位为空、反白未启用，或保持时间已经到期。
 */
static bool Display_IsStatusHighlightActive(const DisplayStatusSlot *slot, uint32_t now)
{
    return ((slot != NULL) &&
            slot->highlight_visible &&
            Display_StatusTickBefore(now, slot->highlight_until_tick));
}

/**
 * @brief 清除指定状态槽上一次数值占用的 OLED 区域。
 *
 * @param slot 待清除的状态槽布局，提供数值起始列和所在 OLED 行。
 */
static void Display_ClearStatusSlotValueArea(const DisplayStatusSlot *slot)
{
    uint8_t width;

    if ((slot == NULL) || (slot->value_line > OLED_LINE8_END)) {
        return;
    }

    width = (uint8_t)(OLED_LINE8_END + 1U - slot->value_line);
    OLED_ClearArea(slot->value_line, slot->row, width, DISPLAY_VALUE_AREA_HEIGHT);
}

/**
 * @brief 检测槽位值变化并更新短时反白截止时间。
 *
 * @param current 本次准备显示的当前状态页快照。
 * @param last 上一次保存的值、状态或快照。
 */
static void Display_UpdateStatusHighlights(DisplayStatusSnapshot *current,
                                           const DisplayStatusSnapshot *last)
{
    uint8_t i;
    uint32_t now = HAL_GetTick();

    if ((current == NULL) || (last == NULL)) {
        return;
    }

    for (i = 0U; i < current->slot_count; i++) {
        DisplayStatusSlot *current_slot = &current->slots[i];
        const DisplayStatusSlot *last_slot = &last->slots[i];
        bool value_changed = Display_StatusSlotValueChanged(current_slot, last_slot);

        if (value_changed) {
            current_slot->highlight_visible = true;
            current_slot->highlight_until_tick = now + DISPLAY_VALUE_HIGHLIGHT_MS;
        } else if (Display_IsStatusHighlightActive(last_slot, now)) {
            current_slot->highlight_visible = true;
            current_slot->highlight_until_tick = last_slot->highlight_until_tick;
        } else {
            current_slot->highlight_visible = false;
            current_slot->highlight_until_tick = 0U;
        }

        if (value_changed ||
            current_slot->highlight_visible ||
            last_slot->highlight_visible) {
            Display_ClearStatusSlotValueArea(current_slot);
        }
    }
}

/**
 * @brief 全量绘制状态快照并保存为当前活动快照。
 *
 * @param snapshot 可写 CPU3 状态页快照；函数追加或读取固定槽位中的文字、数值、位置、反显和数据新鲜度，最终用于全量或差量绘制。
 */
static bool Display_DrawStatusFull(DisplayStatusSnapshot *snapshot)
{
    uint8_t i;

    if (snapshot == NULL) {
        return false;
    }

    for (i = 0U; i < snapshot->slot_count; i++) {
        snapshot->slots[i].highlight_visible = false;
        snapshot->slots[i].highlight_until_tick = 0U;
    }

    if (!Display_ClearBeforeDraw()) {
        return false;
    }
    display_status_active_snapshot = *snapshot;
    display_status_full_redraw_required = false;
    oled_equipment();
    return true;
}

/**
 * @brief 比较前后快照，只重绘发生变化的状态槽。
 *
 * @param current 本次准备显示的当前状态页快照。
 * @param last 上一次保存的值、状态或快照。
 */
static void Display_DrawStatusDelta(DisplayStatusSnapshot *current,
                                    const DisplayStatusSnapshot *last)
{
    uint8_t i;

    if (current == NULL) {
        return;
    }

    Display_UpdateStatusHighlights(current, last);
    display_status_active_snapshot = *current;
    DIS_Equipment();
    for (i = 0U; i < current->slot_count; i++) {
        DisplayStatusSlot *slot = &current->slots[i];
        const DisplayStatusSlot *last_slot = &last->slots[i];
        bool redraw_slot = Display_StatusSlotValueChanged(slot, last_slot) ||
                           slot->highlight_visible ||
                           last_slot->highlight_visible;

        if (redraw_slot) {
            uint8_t shift = Display_IsStatusHighlightActive(slot, HAL_GetTick()) ? 1U : 0U;
            Display_DrawStatusSlotValue(slot, shift);
        }
    }
}

/**
 * @brief 非采样刷新时重画状态行并恢复反白区域，不重新采样状态页数值。
 */
static void Display_DrawStatusHighlightRestore(void)
{
    uint8_t i;
    uint32_t now = HAL_GetTick();
    bool any_restored = false;

    DIS_Equipment();

    for (i = 0U; i < display_status_active_snapshot.slot_count; i++) {
        DisplayStatusSlot *slot = &display_status_active_snapshot.slots[i];

        if (slot->highlight_visible &&
            !Display_StatusTickBefore(now, slot->highlight_until_tick)) {
            Display_ClearStatusSlotValueArea(slot);
            slot->highlight_visible = false;
            slot->highlight_until_tick = 0U;
            Display_DrawStatusSlotValue(slot, 0U);
            any_restored = true;
        }
    }

    if (any_restored) {
        display_status_last_snapshot = display_status_active_snapshot;
    }
}

/**
 * @brief 存在到期反白且状态页可见时请求一次非采样刷新。
 * @return true 表示状态页有效且可见，并存在保持期刚到期的反白槽位；false 表示状态页无效、罐上操作或息屏正在占用界面，或所有反白仍在保持期内/已经清除。
 */
static bool Display_ShouldRequestStatusHighlightRefresh(void)
{
    uint8_t i;
    uint32_t now;

    if (!display_status_active_snapshot.valid ||
        FlagofTankOpera ||
        display_screen_off_active) {
        return false;
    }

    now = HAL_GetTick();
    for (i = 0U; i < display_status_active_snapshot.slot_count; i++) {
        const DisplayStatusSlot *slot = &display_status_active_snapshot.slots[i];

        if (slot->highlight_visible &&
            !Display_StatusTickBefore(now, slot->highlight_until_tick)) {
            return true;
        }
    }

    return false;
}

/**
 * @brief 按优先级查找当前应显示的活动状态槽。
 *
 * @param id 编号。该值是 CPU3 状态页固定槽位标识，用于在快照中定位同一业务字段并执行全量或差量重绘。
 * @param row OLED 绘制使用的行号。取值使用 OLED_ROW4_x 等页面行坐标常量，决定文字或数字写入的纵向基线。
 * @param is_text true 表示按文字宽度计算布局，false 表示按数值格式计算。
 * @return 成功时返回指向按优先级查找当前应显示的活动状态槽的指针；输入非法或未找到匹配项时返回 NULL。
 */
static const DisplayStatusSlot *Display_FindActiveStatusSlot(DisplayStatusSlotId id,
                                                            uint8_t row,
                                                            bool is_text)
{
    uint8_t i;

    for (i = 0U; i < display_status_active_snapshot.slot_count; i++) {
        const DisplayStatusSlot *slot = &display_status_active_snapshot.slots[i];

        if ((slot->id == id) && (slot->row == row) && (slot->is_text == is_text)) {
            return slot;
        }
    }

    return NULL;
}

/**
 * @brief 仅在匹配槽位仍处于反白期且内容一致时返回反色标志。
 *
 * @param id 编号。该值是 CPU3 状态页固定槽位标识，用于在快照中定位同一业务字段并执行全量或差量重绘。
 * @param row OLED 绘制使用的行号。取值使用 OLED_ROW4_x 等页面行坐标常量，决定文字或数字写入的纵向基线。
 * @param value 待格式化并绘制到 OLED 的数值。
 * @param is_text true 表示按文字宽度计算布局，false 表示按数值格式计算。
 * @param text 待测量、排版或写入状态槽的 NUL 结尾显示文字；宽度计算同时处理 ASCII 与中文字节。
 * @return 1 表示目标状态槽仍处于内容一致的反白保持期；槽位无效、内容变化或保持期结束时返回 0。
 */
static uint8_t Display_GetStatusSlotShift(DisplayStatusSlotId id,
                                          uint8_t row,
                                          int32_t value,
                                          bool is_text,
                                          const char *text)
{
    const DisplayStatusSlot *slot = Display_FindActiveStatusSlot(id, row, is_text);

    if ((slot == NULL) || !slot->highlight_visible) {
        return 0U;
    }

    if (is_text) {
        if ((text == NULL) || (strncmp(slot->text, text, sizeof(slot->text)) == 0)) {
            return 1U;
        }
        return 0U;
    }

    return (slot->value == value) ? 1U : 0U;
}

/**
 * @brief 根据当前前景页、恢复标志和状态快照选择局部或全量方式刷新 OLED。
 *
 * @note 罐上操作页只在监控页、恢复请求或显式重绘时刷新；状态页按布局变化选择全量绘制或差量绘制，并在每帧结束时核对 OLED SPI 错误计数。
 */
void RefreshScreen(void)
{
    uint32_t frame_spi_error_start;

    display_recover_before_draw = false;

    if (FlagofTankOpera == true) {
        if (DisplayTankOpera_IsMotorRunMonitorActive() ||
            DisplayTankOpera_IsDebugWeightWaitActive() ||
            DisplayTankOpera_IsAoRuntimeActive() ||
            DisplayTankOpera_IsCpu2CommHealthActive()) {
            if (!Display_PrepareForForegroundDraw(&frame_spi_error_start)) {
                return;
            }
            if (DisplayTankOpera_RedrawCurrentPage()) {
                Display_FinishFrame(frame_spi_error_start);
            }
            return;
        }
        if (Display_ShouldRecoverBeforeDraw()) {
            frame_spi_error_start = Display_BeginFrame();
            if (Display_PerformRecovery() && DisplayTankOpera_RedrawCurrentPage()) {
                Display_FinishFrame(frame_spi_error_start);
            }
        }
        return;
    }

    if(ScreenOff()) {
        if (!display_screen_off_active) {
            frame_spi_error_start = Display_BeginFrame();
            OLED_DisplayOff();
            display_screen_off_active = true;
            Display_FinishFrame(frame_spi_error_start);
        }
    }
    else
    {
        frame_spi_error_start = Display_BeginFrame();
        if (display_screen_off_active) {
            OLED_DisplayOn();
            Display_RequestRecovery();
            display_screen_off_active = false;
        }
        SetScreenOffState();
        display_recover_before_draw = Display_ShouldRecoverBeforeDraw();
        /* 首次状态和当前连接协议快照完成前保持通讯尝试页，第十次失败后由故障页接管。 */
        if (CPU2_CommShouldShowStartup())
            EquipFirstPower();
        else
            oled_workingdata();
        display_recover_before_draw = false;
        Display_FinishFrame(frame_spi_error_start);
    }
}
/**
 * @brief 根据设备状态、结果上下文和当前分页，绘制状态标题、故障详情及有效测量与调试数据。
 *
 * 先绘制当前设备状态；无线配对进行中不追加测量数据，配对结束时单独显示成功取得的 MAC 或不可用提示。
 * 普通状态页按 ValidParaDisArr 的有效标志和页码，选择显示故障原因、液位、水位、密度、温度、位置、扭力、扭力模块温度、频率、电容、姿态角、罐高、无线 RSSI 和从机 MAC。
 * 各数据项使用当前测量结果上下文选择来源，并通过状态槽位计算差量绘制偏移和工程单位。
 */
static void oled_equipment(void)
{
    u8 row = OLED_ROW4_2,line = 0;
    DisplayResultContext ctx = Display_GetResultContext(g_measurement.device_status.device_state);
    int now_page = display_status_active_snapshot.page;
    uint32_t display_value = 0U;
    int display_position = 0;
    int display_frequency = 0;
    int display_capacitance = 0;
    int32_t torque_temperature_x100;
    
    /* 显示当前设备状态 */
    DIS_Equipment();

    if (g_measurement.device_status.device_state == STATE_WIRELESS_PAIRING) {
        return;
    }

    if (g_measurement.device_status.device_state == STATE_WIRELESS_PAIRING_OVER) {
        const volatile WirelessPairingStatus *status = &g_measurement.wireless_pairing_status;

        if ((status->result == WIRELESS_PAIRING_RESULT_SUCCESS) && (status->mac_valid != 0U)) {
            char mac_line1[9];
            char mac_line2[9];

            Display_FormatWirelessPairingMac(status, mac_line1, mac_line2);
            OledDisplayLineWords("MAC:", OLED_LINE8_1, OLED_ROW4_2, 0);
            OledDisplayLineWords(mac_line1,
                                 OLED_LINE8_2,
                                 OLED_ROW4_3,
                                 Display_GetStatusSlotShift(DISPLAY_STATUS_SLOT_WIRELESS_MAC_1,
                                                            OLED_ROW4_3,
                                                            0,
                                                            true,
                                                            mac_line1));
            OledDisplayLineWords(mac_line2,
                                 OLED_LINE8_2,
                                 OLED_ROW4_4,
                                 Display_GetStatusSlotShift(DISPLAY_STATUS_SLOT_WIRELESS_MAC_2,
                                                            OLED_ROW4_4,
                                                            0,
                                                            true,
                                                            mac_line2));
        } else {
            OledDisplayLineWords("MAC N/A",
                                 OLED_LINE8_2,
                                 OLED_ROW4_2,
                                 Display_GetStatusSlotShift(DISPLAY_STATUS_SLOT_WIRELESS_MAC_NA,
                                                            OLED_ROW4_2,
                                                            0,
                                                            true,
                                                            "MAC N/A"));
        }
        return;
    }

    /* 故障详情 */
    if (ValidParaDisArr[Para_ErrorReason][PARA_VALID] == true &&
        now_page == ValidParaDisArr[Para_ErrorReason][PARA_PAGE])
    {
        row = ValidParaDisArr[Para_ErrorReason][PARA_X];
        Display_ErrorReasonLine(row);
    }

    /* 故障原因确实占用第二行且该槽位位于当前页时，再绘制续行，避免覆盖后续状态字段。 */
    if (ValidParaDisArr[Para_ErrorReasonMore][PARA_VALID] == true &&
        now_page == ValidParaDisArr[Para_ErrorReasonMore][PARA_PAGE])
    {
        row = ValidParaDisArr[Para_ErrorReasonMore][PARA_X];
        Display_ErrorReasonMoreLine(row);
    }

    /* 液位 */
    if(flagofoillevelvalid == true)
    {
        if(FlagofTotalTwoRow == true)
            row = OLED_ROW4_3;
        else
            row = OLED_ROW4_2;
        line = DisplayLangaugeLineWords((u8*)"液位:",OLED_LINE8_1,row,0,(u8*)"Level:");
        if (Display_GetOilLevelValue(ctx, &display_value) &&
            ((display_value == OILLEVELDOWNLIMIT) || (display_value == LEVEL_DOWNLIMIT)))
        {
            const char *text = Display_SelectLanguageText((uint8_t*)"低于盲区",
                                                          (uint8_t*)"Below Blind");
            DisplayLangaugeLineWords((u8*)"低于盲区",
                                     line,
                                     row,
                                     Display_GetStatusSlotShift(DISPLAY_STATUS_SLOT_OIL_LEVEL,
                                                                row,
                                                                0,
                                                                true,
                                                                text),
                                     (u8*)"Below Blind");
        }
        else
        {
            OledValueDisplay((int)display_value,
                             line,
                             row,
                             Display_GetStatusSlotShift(DISPLAY_STATUS_SLOT_OIL_LEVEL,
                                                        row,
                                                        (int32_t)display_value,
                                                        false,
                                                        NULL),
                             1,
                             (u8*)"mm");
        }
    }
    /* 水位 */
    if(ValidParaDisArr[Para_Waterlevel][PARA_VALID] == true && now_page == ValidParaDisArr[Para_Waterlevel][PARA_PAGE])
    {
        row = ValidParaDisArr[Para_Waterlevel][PARA_X];
        line = DisplayLangaugeLineWords((u8*)"水位:",OLED_LINE8_1,row,0,(u8*)"Water:");
        if (Display_GetWaterLevelValue(ctx, &display_value))
        {
            OledValueDisplay((int)display_value,
                             line,
                             row,
                             Display_GetStatusSlotShift(DISPLAY_STATUS_SLOT_WATER_LEVEL,
                                                        row,
                                                        (int32_t)display_value,
                                                        false,
                                                        NULL),
                             1,
                             (u8*)"mm");
        }
    }
    /* 密度 */
    if(ValidParaDisArr[Para_AveDensity][PARA_VALID] == true && now_page == ValidParaDisArr[Para_AveDensity][PARA_PAGE])
    {
        row = ValidParaDisArr[Para_AveDensity][PARA_X];
        line = DisplayLangaugeLineWords((u8*)"密度:",OLED_LINE8_1,row,0,(u8*)"D:");
        if (Display_GetDensityValue(ctx, &display_value))
        {
            OledValueDisplay((int)display_value,
                             line,
                             row,
                             Display_GetStatusSlotShift(DISPLAY_STATUS_SLOT_DENSITY,
                                                        row,
                                                        (int32_t)display_value,
                                                        false,
                                                        NULL),
                             2,
                             (u8*)"kg/m3");
        }
    }
    /* 温度 */
    if(ValidParaDisArr[Para_AveTemperature][PARA_VALID] == true && now_page == ValidParaDisArr[Para_AveTemperature][PARA_PAGE])
    {
        row = ValidParaDisArr[Para_AveTemperature][PARA_X];
        line = DisplayLangaugeLineWords((u8*)"温度:",OLED_LINE8_1,row,0,(u8*)"Temp:");
        if (Display_GetTemperatureValue(ctx, &display_value))
        {
            OledValueDisplay((int)display_value - 20000,
                             line,
                             row,
                             Display_GetStatusSlotShift(DISPLAY_STATUS_SLOT_TEMPERATURE,
                                                        row,
                                                        (int32_t)display_value - 20000,
                                                        false,
                                                        NULL),
                             2,
                             (u8*)"℃");
        }
    }
 
    /* 位置 */
    if(ValidParaDisArr[Para_position][PARA_VALID] == true && now_page == ValidParaDisArr[Para_position][PARA_PAGE])
    {
        row = ValidParaDisArr[Para_position][PARA_X];
        line = DisplayLangaugeLineWords((u8*)"位置:",OLED_LINE8_1,row,0,(u8*)"Pos:");
        if (Display_GetPositionValue(ctx, &display_position))
        {
            OledValueDisplay(display_position,
                             line,
                             row,
                             Display_GetStatusSlotShift(DISPLAY_STATUS_SLOT_POSITION,
                                                        row,
                                                        (int32_t)display_position,
                                                        false,
                                                        NULL),
                             1,
                             (u8*)"mm");
        }
    }
    /* 扭力 */
	if (ValidParaDisArr[Para_weight][PARA_VALID] == true && now_page == ValidParaDisArr[Para_weight][PARA_PAGE]) {
		row = ValidParaDisArr[Para_weight][PARA_X];
		line = DisplayLangaugeLineWords((u8*) "扭力:", OLED_LINE8_1, row, 0, (u8*) "Torque:");
		OledValueDisplay(g_measurement.debug_data.current_weight,
                         line,
                         row,
                         Display_GetStatusSlotShift(DISPLAY_STATUS_SLOT_WEIGHT,
                                                    row,
                                                    (int32_t)g_measurement.debug_data.current_weight,
                                                    false,
                                                    NULL),
                         0,
                         (u8*) " ");
	}
    /* 扭力模块温度 */
    if (ValidParaDisArr[Para_torque_temperature][PARA_VALID] == true &&
        now_page == ValidParaDisArr[Para_torque_temperature][PARA_PAGE])
    {
        row = ValidParaDisArr[Para_torque_temperature][PARA_X];
        line = DisplayLangaugeLineWords((u8*)"扭温:", OLED_LINE8_1, row, 0, (u8*)"T.Temp:");
        if (Display_GetTorqueTemperatureX100(ctx, &torque_temperature_x100))
        {
            OledValueDisplay((int)torque_temperature_x100,
                             line,
                             row,
                             Display_GetStatusSlotShift(DISPLAY_STATUS_SLOT_TORQUE_TEMPERATURE,
                                                        row,
                                                        torque_temperature_x100,
                                                        false,
                                                        NULL),
                             2,
                             (u8*)"℃");
        }
        else
        {
            OledDisplayLineWords("--.--",
                                 line,
                                 row,
                                 Display_GetStatusSlotShift(DISPLAY_STATUS_SLOT_TORQUE_TEMPERATURE,
                                                            row,
                                                            0,
                                                            true,
                                                            "--.--"));
        }
    }
    /* 频率 */
    if (ValidParaDisArr[Para_sensor_value][PARA_VALID] == true &&
        now_page == ValidParaDisArr[Para_sensor_value][PARA_PAGE])
    {
        row = ValidParaDisArr[Para_sensor_value][PARA_X];
        line = DisplayLangaugeLineWords((u8*)"频率:", OLED_LINE8_1, row, 0, (u8*)"Freq:");
        display_frequency = (ctx == DISPLAY_RESULT_CONTEXT_READ_PARAMETER)
            ? (int)g_measurement.debug_data.frequency
            : GetOilSensorFrequencyForDisplay();
        OledValueDisplay(display_frequency,
                         line,
                         row,
                         Display_GetStatusSlotShift(DISPLAY_STATUS_SLOT_FREQUENCY,
                                                    row,
                                                    (int32_t)display_frequency,
                                                    false,
                                                    NULL),
                         0,
                         (u8*)"Hz");
    }

    /* 电容 */
    if (ValidParaDisArr[Para_capacitance][PARA_VALID] == true &&
        now_page == ValidParaDisArr[Para_capacitance][PARA_PAGE])
    {
        row = ValidParaDisArr[Para_capacitance][PARA_X];
        line = DisplayLangaugeLineWords((u8*)"电容:", OLED_LINE8_1, row, 0, (u8*)"Cap:");
        display_capacitance = (ctx == DISPLAY_RESULT_CONTEXT_READ_PARAMETER)
            ? (int)g_measurement.debug_data.water_capacitance_x10
            : (int)(g_measurement.water_measurement.current_capacitance * 10.0f);
        OledValueDisplay(display_capacitance,
                         line,
                         row,
                         Display_GetStatusSlotShift(DISPLAY_STATUS_SLOT_CAPACITANCE,
                                                    row,
                                                    (int32_t)display_capacitance,
                                                    false,
                                                    NULL),
                         1,
                         NULL);
    }
    /* 陀螺仪角度 X */
    if (ValidParaDisArr[Para_angle_x][PARA_VALID] == true &&
        now_page == ValidParaDisArr[Para_angle_x][PARA_PAGE])
    {
        row = ValidParaDisArr[Para_angle_x][PARA_X];
        line = DisplayLangaugeLineWords((u8*)"X角:", OLED_LINE8_1, row, 0, (u8*)"AngX:");
        OledValueDisplay(g_measurement.debug_data.angle_x,
                         line,
                         row,
                         Display_GetStatusSlotShift(DISPLAY_STATUS_SLOT_ANGLE_X,
                                                    row,
                                                    (int32_t)g_measurement.debug_data.angle_x,
                                                    false,
                                                    NULL),
                         2,
                         (u8*)"°");
    }

    /* 陀螺仪角度 Y */
    if (ValidParaDisArr[Para_angle_y][PARA_VALID] == true &&
        now_page == ValidParaDisArr[Para_angle_y][PARA_PAGE])
    {
        row = ValidParaDisArr[Para_angle_y][PARA_X];
        line = DisplayLangaugeLineWords((u8*)"Y角:", OLED_LINE8_1, row, 0, (u8*)"AngY:");
        OledValueDisplay(g_measurement.debug_data.angle_y,
                         line,
                         row,
                         Display_GetStatusSlotShift(DISPLAY_STATUS_SLOT_ANGLE_Y,
                                                    row,
                                                    (int32_t)g_measurement.debug_data.angle_y,
                                                    false,
                                                    NULL),
                         2,
                         (u8*)"°");
    }
    /* 罐高显示 */
    if (ValidParaDisArr[Para_tankheight][PARA_VALID] == true &&
        now_page == ValidParaDisArr[Para_tankheight][PARA_PAGE])
    {
        row = ValidParaDisArr[Para_tankheight][PARA_X];
        line = DisplayLangaugeLineWords((u8*)"罐高:", OLED_LINE8_1, row, 0, (u8*)"tankH:");
        OledValueDisplay(g_measurement.height_measurement.current_real_height,
                         line,
                         row,
                         Display_GetStatusSlotShift(DISPLAY_STATUS_SLOT_TANK_HEIGHT,
                                                    row,
                                                    (int32_t)g_measurement.height_measurement.current_real_height,
                                                    false,
                                                    NULL),
                         1,
                         (u8*)"mm");
    }
    /* 蓝牙连接 RSSI */
    if (ValidParaDisArr[Para_wireless_rssi][PARA_VALID] == true &&
        now_page == ValidParaDisArr[Para_wireless_rssi][PARA_PAGE])
    {
        row = ValidParaDisArr[Para_wireless_rssi][PARA_X];
        if (g_measurement.wireless_pairing_status.rssi_valid != 0U)
        {
            line = DisplayLangaugeLineWords((u8*)"RSSI:", OLED_LINE8_1, row, 0, (u8*)"RSSI:");
            OledValueDisplay((int)g_measurement.wireless_pairing_status.rssi,
                             line,
                             row,
                             Display_GetStatusSlotShift(DISPLAY_STATUS_SLOT_WIRELESS_RSSI,
                                                        row,
                                                        g_measurement.wireless_pairing_status.rssi,
                                                        false,
                                                        NULL),
                             0,
                             (u8*)"dB");
        }
        else
        {
            OledDisplayLineWords("RSSI:N/A",
                                 OLED_LINE8_1,
                                 row,
                                 Display_GetStatusSlotShift(DISPLAY_STATUS_SLOT_WIRELESS_RSSI_NA,
                                                            row,
                                                            0,
                                                            true,
                                                            "RSSI:N/A"));
        }
    }
    /* 连接从机蓝牙 MAC */
    if (ValidParaDisArr[Para_wireless_mac][PARA_VALID] == true &&
        now_page == ValidParaDisArr[Para_wireless_mac][PARA_PAGE])
    {
        const volatile WirelessPairingStatus *status = &g_measurement.wireless_pairing_status;

        row = ValidParaDisArr[Para_wireless_mac][PARA_X];
        if ((status->connection_valid != 0U) && (status->mac_valid != 0U))
        {
            char mac_line[17];

            Display_FormatWirelessConnectionMacCompact(status, mac_line, sizeof(mac_line));
            OledDisplayLineWords(mac_line,
                                 OLED_LINE8_1,
                                 row,
                                 Display_GetStatusSlotShift(DISPLAY_STATUS_SLOT_WIRELESS_MAC_COMPACT,
                                                            row,
                                                            0,
                                                            true,
                                                            mac_line));
        }
        else
        {
            OledDisplayLineWords("MAC N/A",
                                 OLED_LINE8_1,
                                 row,
                                 Display_GetStatusSlotShift(DISPLAY_STATUS_SLOT_WIRELESS_MAC_NA,
                                                            row,
                                                            0,
                                                            true,
                                                            "MAC N/A"));
        }
    }
}
/**
 * @brief 显示多个汉字或字符 - 带中英文选择。
 *
 * @param name1 中文模式使用的显示文字。
 * @param line OLED 绘制使用的横向列位置。
 * @param row OLED 绘制使用的行号。取值使用 OLED_ROW4_x 等页面行坐标常量，决定文字或数字写入的纵向基线。
 * @param shift OLED 字模阴码/阳码或显示偏移选项。
 * @param name2 英文模式使用的显示文字；为 NULL 时沿用中文文字。
 * @return 返回当前语言文本绘制完成后的下一 OLED 横坐标；英文文本为空时使用中文文本。
 */
uint8_t DisplayLangaugeLineWords(uint8_t* name1,uint8_t line,uint8_t row,uint8_t shift,uint8_t* name2)
{
    if(screen_parameter.language == LANGUAGE_CHINESE || name2 == NULL)
        line = OledDisplayLineWords(name1,line,row,shift);
    else if(screen_parameter.language == LANGUAGE_ENGLISH)
        line = OledDisplayLineWords(name2,line,row,shift);
    return line;
}

/**
 * @brief 根据当前测量结果上下文生成 OLED 结果页的有效参数布局。
 *
 * 函数先根据设备状态取得结果页上下文，再逐项判定故障详情、液位、密度、温度、水位、位置、扭力、部件参数、传感器原始量、姿态角、罐高和无线信息是否需要显示。
 * 每个有效项目按显示顺序写入 ValidParaDisArr 的 PARA_NUM 和 PARA_VALID；需要两行的故障原因会占用两个连续项目，读取部件参数时为扭力模块温度、RSSI 和 MAC
 * 保留固定项目。
 * 液位有效时结果区每页排两行并从 OLED_ROW4_3 开始，否则每页排三行并从 OLED_ROW4_2 开始；随后计算 PageAmount 以及每个有效项目的页号和行坐标。
 *
 * @note 函数直接更新 ValidParaDisArr、PageAmount、FlagofTotalTwoRow 和液位有效标志，调用方应在测量快照更新后再生成页面布局。
 */
static void CalculateValidPara(void)
{
    static int ValidParaCnt = 0; /* 需要显示的有效参数 */
    static u8 start_x = 0;
    static int rowsperpage = 2;
    int i;
    DisplayResultContext ctx = Display_GetResultContext(g_measurement.device_status.device_state);
    uint32_t display_value = 0U;
    int display_position = 0;
    
    /* *****计算总共有多少个有效参数需要显示***** */
    ValidParaCnt = 0;
    /* 故障详情 */
    if (Display_ShouldShowErrorReason(ctx))
    {
        ValidParaCnt++;
        ValidParaDisArr[Para_ErrorReason][PARA_NUM] = ValidParaCnt;
        ValidParaDisArr[Para_ErrorReason][PARA_VALID] = true;
        /* 长故障原因需要两个状态槽位；短原因只登记首行，并显式关闭旧页面残留的续行槽位。 */
        if (Display_IsErrorReasonNeedTwoRows())
        {
            ValidParaCnt++;
            ValidParaDisArr[Para_ErrorReasonMore][PARA_NUM] = ValidParaCnt;
            ValidParaDisArr[Para_ErrorReasonMore][PARA_VALID] = true;
        }
        else
        {
            ValidParaDisArr[Para_ErrorReasonMore][PARA_VALID] = false;
        }
    }
    else
    {
        ValidParaDisArr[Para_ErrorReason][PARA_VALID] = false;
        ValidParaDisArr[Para_ErrorReasonMore][PARA_VALID] = false;
    }
    /* 液位 */
    flagofoillevelvalid = Display_ShouldShowOilLevel(ctx);
    /* 密度 */
    if(Display_GetDensityValue(ctx, &display_value))
    {
        ValidParaCnt++;
        ValidParaDisArr[Para_AveDensity][PARA_NUM] = ValidParaCnt;
		
        ValidParaDisArr[Para_AveDensity][PARA_VALID] = true;
    }
    else
        ValidParaDisArr[Para_AveDensity][PARA_VALID] = false;
    /* 温度 */
    if(Display_GetTemperatureValue(ctx, &display_value))
    {
        ValidParaCnt++;
        ValidParaDisArr[Para_AveTemperature][PARA_NUM] = ValidParaCnt;
        ValidParaDisArr[Para_AveTemperature][PARA_VALID] = true;
    }
    else
        ValidParaDisArr[Para_AveTemperature][PARA_VALID] = false;
    /* 水位 */
    if(Display_ShouldShowWaterLevel(ctx))
    {
        ValidParaCnt++;
        ValidParaDisArr[Para_Waterlevel][PARA_NUM] = ValidParaCnt;
        ValidParaDisArr[Para_Waterlevel][PARA_VALID] = true;
    }
    else
        ValidParaDisArr[Para_Waterlevel][PARA_VALID] = false;
  
    /* 位置 */
    if(Display_GetPositionValue(ctx, &display_position))
    {
        ValidParaCnt++;
        ValidParaDisArr[Para_position][PARA_NUM] = ValidParaCnt;
        ValidParaDisArr[Para_position][PARA_VALID] = true;
    }
    else
        ValidParaDisArr[Para_position][PARA_VALID] = false;
    /* 扭力 */
    if(Display_ShouldShowWeight(ctx))
    {
        ValidParaCnt++;
        ValidParaDisArr[Para_weight][PARA_NUM] = ValidParaCnt;
        ValidParaDisArr[Para_weight][PARA_VALID] = true;
    }
    else
        ValidParaDisArr[Para_weight][PARA_VALID] = false;
    /* 扭力模块温度在读取部件参数结果页固定占一项，无效时显示占位。 */
    if (ctx == DISPLAY_RESULT_CONTEXT_READ_PARAMETER)
    {
        ValidParaCnt++;
        ValidParaDisArr[Para_torque_temperature][PARA_NUM] = ValidParaCnt;
        ValidParaDisArr[Para_torque_temperature][PARA_VALID] = true;
    }
    else
        ValidParaDisArr[Para_torque_temperature][PARA_VALID] = false;
    /* 频率 */
    if (Display_ShouldShowOilFrequencyValue(ctx))
    {
        ValidParaCnt++;
        ValidParaDisArr[Para_sensor_value][PARA_NUM] = ValidParaCnt;
        ValidParaDisArr[Para_sensor_value][PARA_VALID] = true;
    }
    else
        ValidParaDisArr[Para_sensor_value][PARA_VALID] = false;
    /* 电容 */
    if (Display_ShouldShowWaterCapacitanceValue(ctx))
    {
        ValidParaCnt++;
        ValidParaDisArr[Para_capacitance][PARA_NUM] = ValidParaCnt;
        ValidParaDisArr[Para_capacitance][PARA_VALID] = true;
    }
    else
        ValidParaDisArr[Para_capacitance][PARA_VALID] = false;
    /* 陀螺仪角度 X */
    if (((ctx == DISPLAY_RESULT_CONTEXT_READ_PARAMETER) ||
         ((ctx == DISPLAY_RESULT_CONTEXT_BOTTOM_HEIGHT) && IsBottomAngleDisplayEnabled())) &&
        (g_measurement.debug_data.angle_x != 0))
    {
        ValidParaCnt++;
        ValidParaDisArr[Para_angle_x][PARA_NUM] = ValidParaCnt;
        ValidParaDisArr[Para_angle_x][PARA_VALID] = true;
    }
    else {
        ValidParaDisArr[Para_angle_x][PARA_VALID] = false;
    }

    /* 陀螺仪角度 Y */
    if (((ctx == DISPLAY_RESULT_CONTEXT_READ_PARAMETER) ||
         ((ctx == DISPLAY_RESULT_CONTEXT_BOTTOM_HEIGHT) && IsBottomAngleDisplayEnabled())) &&
        (g_measurement.debug_data.angle_y != 0))
    {
        ValidParaCnt++;
        ValidParaDisArr[Para_angle_y][PARA_NUM] = ValidParaCnt;
        ValidParaDisArr[Para_angle_y][PARA_VALID] = true;
    }
    else {
        ValidParaDisArr[Para_angle_y][PARA_VALID] = false;
    }
    /* 罐高 */
    /* 读取参数态不展示历史罐高，避免把上一次业务结果误认为本次部件参数。 */
    if ((g_measurement.height_measurement.current_real_height != 0) &&
        ((g_measurement.device_status.device_state == STATE_FINDBOTTOM_OVER) ||
         (g_measurement.device_status.device_state == STATE_CALIBRATE_TANKHEIGHT_OVER)))
    {
        ValidParaCnt++;
        ValidParaDisArr[Para_tankheight][PARA_NUM] = ValidParaCnt;
        ValidParaDisArr[Para_tankheight][PARA_VALID] = true;
    }
    else {
        ValidParaDisArr[Para_tankheight][PARA_VALID] = false;
    }
    /* 蓝牙连接 RSSI */
    if (ctx == DISPLAY_RESULT_CONTEXT_READ_PARAMETER)
    {
        ValidParaCnt++;
        ValidParaDisArr[Para_wireless_rssi][PARA_NUM] = ValidParaCnt;
        ValidParaDisArr[Para_wireless_rssi][PARA_VALID] = true;
        ValidParaCnt++;
        ValidParaDisArr[Para_wireless_mac][PARA_NUM] = ValidParaCnt;
        ValidParaDisArr[Para_wireless_mac][PARA_VALID] = true;
    }
    else {
        ValidParaDisArr[Para_wireless_rssi][PARA_VALID] = false;
        ValidParaDisArr[Para_wireless_mac][PARA_VALID] = false;
    }
    #if DEBUG_DISPLAY
    printf("ValidParaCnt = %d\n",ValidParaCnt);
    #endif
    /* *****计算总共需用几页,以及起始行***** */
    if(flagofoillevelvalid == true)
    {
        rowsperpage = 2;
        PageAmount = ceil(ValidParaCnt / (float)rowsperpage);
        start_x = OLED_ROW4_3;
    }
    else
    {
        rowsperpage = 3;
        PageAmount = ceil(ValidParaCnt / (float)rowsperpage);
        start_x = OLED_ROW4_2;
    }
    #if DEBUG_DISPLAY
    printf("rowsperpage = %d\n",rowsperpage);
    printf("PageAmount = %d\n",PageAmount);
    printf("start_x = %d\n",start_x);
    #endif
    /* *****计算每一个参数对应的行号和页号***** */
    if(PageAmount == 0 && rowsperpage == 2) /* 特殊情况:一共只显示两行的情况下这两行要居中显示 */
    {
        FlagofTotalTwoRow = true;
    }
    else
    {
        FlagofTotalTwoRow = false;
        for(i = 0;i<Para_Amount;i++)
        {
            ValidParaDisArr[i][PARA_X] = ((ValidParaDisArr[i][PARA_NUM] - 1) % rowsperpage ) * (OLED_ROW4_2 - OLED_ROW4_1) + start_x;
            ValidParaDisArr[i][PARA_PAGE] = (ValidParaDisArr[i][PARA_NUM] - 1) / rowsperpage;
            #if DEBUG_DISPLAY
            printf("%d\tx = %d\tpage = %d\tnum = %d\n",i,ValidParaDisArr[i][PARA_X],ValidParaDisArr[i][PARA_PAGE],ValidParaDisArr[i][PARA_NUM]);
            #endif
        }
    }
}
/* 设备状态显示表 */
static const EquipStateDisplay state_display_table[] = {

    /* ===================== 运行中状态 ===================== */
    { STATE_STANDBY,                 "待机中",                   "Standby" },
    { STATE_INIT,                    "设备初始化",               "Initializing" },
    { STATE_BACKZEROING,             "回零点中",                 "Back to Zero" },
    { STATE_FINDZEROING,             "标定零点中",               "Zero Calibration" },
    { STATE_SINGLEPOINTING,          "单点测量中",               "Single Point-M" },
    { STATE_RUNTOPOINTING,           "运行到测量点中",           "Run to Point" },
    { STATE_GB_SPREADPOINTING,       "国标分布测量中",           "GB Spread Point-M" },
    { STATE_SPREADPOINTING,          "分布测量中",               "Spread Point-M" },
    { STATE_CALIBRATIONOILING,       "标定液位中",               "Calibrating Oil Level" },
    { STATE_READPARAMETERING,        "读取参数中",               "Reading Parameters" },
    { STATE_RUNUPING,                "向上运行中",               "Running Up" },
    { STATE_RUNDOWNING,              "向下运行中",               "Running Down" },
    { STATE_SETZEROCIRCLING,         "设置零点编码值中",         "Set Zero Circle" },
    { STATE_SETZEROANGLING,          "设置零点编码值中",         "Set Zero Angle" },
    { STATE_EFACTORYSETTING_RESTORING,"恢复出厂设置中",         "Factory Resetting" },
    { STATE_BACKUPING,               "备份配置文件中",           "Backing Up" },
    { STATE_RESTORYING,              "恢复配置文件中",           "Restoring Config" },
    { STATE_FINDOIL,                 "寻找液位中",               "Finding Oil Level" },
    { STATE_FINDWATER,               "寻找水位中",               "Finding Water Level" },
    { STATE_FINDBOTTOM,              "寻找罐底中",               "Finding Bottom" },
    { STATE_FORCEZERO,               "设置电机零点中",           "Setting Motor Zero" },
    { STATE_ONTANKOPRATIONING,       "罐上仪表操作中",           "On-Tank Operation" },
    { STATE_SYNTHETICING,            "综合指令中",               "Synthetics Running" },

    /* ===== 水位跟随与扩展测量运行态 ===== */
    { STATE_FOLLOW_WATER_POINT_SEARCHING, "寻找水位跟随点",             "Searching Water Follow Point" },
    { STATE_METER_DENSITY,           "密度每米测量中",           "Meter Density Measuring" },
    { STATE_INTERVAL_DENSITY,        "液位区间测量中",           "Interval Density Measuring" },
    { STATE_GET_FULLWEIGHT,          "获取满载扭力中",           "Getting Full Torque" },
    { STATE_GET_EMPTYWEIGHT,         "获取空载扭力中",           "Getting Empty Torque" },
    { STATE_MAINTENANCEMODE,         "维护模式中",               "Maintenance Mode" },

    /* ===== 手动运动、标定与维护运行态 ===== */
    { STATE_RUN_TO_POSITIONING,      "运行到指定位置中",         "Run to Position" },
    { STATE_FORCE_RUNUPING,          "电机强制上行中",           "Force Running Up" },
    { STATE_FORCE_RUNDOWNING,        "电机强制下行中",           "Force Running Down" },
    { STATE_CALIBRATE_WATERING,      "水位标定中",               "Calibrating Water Level" },
    { STATE_CALIBRATE_TANKHEIGHTING, "罐高标定中",               "Calibrating Tank Height" },
    { STATE_WIRELESS_PAIRING,        "无线滑环匹配中",           "Wireless Pairing" },
    { STATE_DEBUG_MODE,              "调试模式中",               "Debug Mode" },

    /* ===== 瓦西莱密度 ===== */
    { STATE_WARTSILA_DENSITY_START,      "LTD密度分布开始",       "Wartsila Density Start" },
    { STATE_WARTSILA_DENSITY_MEASURING,  "LTD密度分布测量",       "Wartsila Density Measuring" },

    /* ===================== 完成态 ===================== */
    { STATE_FINDZEROOVER,            "标定零点完成",             "Zero Calibration Done" },
    { STATE_SINGLEPOINTOVER,         "单点测量完成",             "Single Point Done" },
    { STATE_SPTESTING,               "正在单点密度测量",         "Single Point Testing" },
    { STATE_GB_SPREADPOINTOVER,      "国标分布测量完成",         "AI Spread Done" },
    { STATE_SPREADPOINTOVER,         "分布测量完成",             "Spread Measurement Done" },
    { STATE_FINDOILOVER,             "标定液位完成",             "Oil Calibration Done" },
    { STATE_READPARAMETEROVER,       "读取参数完成",             "Read Parameter Done" },
    { STATE_RUNUPOVER,               "向上运行完成",             "Run Up Done" },
    { STATE_RUNDOWNOVER,             "向下运行完成",             "Run Down Done" },
    { STATE_SETZEROCIRCLOVER,        "设置零点编码值完成",       "Zero Circle Done" },
    { STATE_SETZEROANGLOVER,         "设置零点编码值完成",       "Zero Angle Done" },
    { STATE_EFACTORYSETTING_RESTOROVER,"恢复出厂设置完成",      "Factory Reset Done" },
    { STATE_BACKUPOVER,              "备份配置文件完成",         "Backup Done" },
    { STATE_RESTORYOVER,             "恢复配置文件完成",         "Restore Done" },
    { STATE_FLOWOIL,                 "液位跟随中",               "Level Following" },

    /* ===== 水位跟随、测量与手动控制完成态 ===== */
    { STATE_FOLLOW_WATERING,         "水位跟随中",                 "Water Level Following" },
    { STATE_FINDWATER_OVER,          "寻找水位完成",             "Water Level Done" },
    { STATE_FINDBOTTOM_OVER,         "寻找罐底完成",             "Tank Bottom Done" },
    { STATE_FORCEZERO_OVER,          "设置电机零点完成",         "Motor Zero Done" },
    { STATE_ONTANKOPRATIONCOMPLATE,  "罐上仪表操作完成",         "Tank Operation Done" },
    { STATE_SYNTHETICING_OVER,       "综合指令完成",             "Synthetics Done" },
    { STATE_COM_METER_DENSITY_OVER,  "密度每米测量完成",         "Meter Density Done" },
    { STATE_INTERVAL_DENSITY_OVER,   "液位区间测量完成",         "Interval Density Done" },

    { STATE_RUN_TO_POSITION_OVER,    "运行到指定位置完成",       "Run to Position Done" },
    { STATE_FORCE_RUNUP_OVER,        "强制上行完成",             "Force Run Up Done" },
    { STATE_FORCE_RUNDOWN_OVER,      "强制下行完成",             "Force Run Down Done" },
    { STATE_CALIBRATE_WATER_OVER,    "水位标定完成",             "Water Calibration Done" },
    { STATE_CALIBRATE_TANKHEIGHT_OVER,"罐高标定完成",             "Tank Height Calibration Done" },
    { STATE_WIRELESS_PAIRING_OVER,   "无线滑环匹配完成",         "Wireless Pair Done" },

    { STATE_WARTSILA_DENSITY_OVER,   "LTD密度分布完成",          "Wartsila Density Done" },

    { STATE_GET_FULLWEIGHT_OVER,     "获取满载扭力完成",         "Get Full Torque Done" },
    { STATE_GET_EMPTYWEIGHT_OVER,    "获取空载扭力完成",         "Get Empty Torque Done" },

    { STATE_ERROR,                   "故障",                     "Failure" },
};


/**
 * @brief 把设备运行状态转换为当前语言的状态文字。
 *
 * @param state CPU2 共享的 16 位设备状态码；函数按当前语言查找对应状态文字。
 * @param lang 状态文字使用的语言枚举值。
 * @return 返回当前语言的状态文字对应的只读文本首地址；内容由当前输入或语言配置选择，调用方不得修改或释放。
 */
const char* GetStateString(uint16_t state, uint8_t lang)
{
    for (int i = 0; i < sizeof(state_display_table) / sizeof(state_display_table[0]); i++) {
        if (state_display_table[i].state == state)
            return (lang == 0) ? state_display_table[i].disp_cn : state_display_table[i].disp_en;
    }
    return (lang == 0) ? "未知" : "Unknown";
}
/**
 * @brief 绘制状态页顶部设备状态及维护/模拟徽标；协议不匹配优先覆盖普通运行态，快照失效时保留曾确认的维护提示。
 *
 * 函数根据当前结果页是否仅有两行选择标题行，并把非法语言索引收敛为英文；设备状态文字通常从状态表取得，CPU2 协议不匹配时则强制显示协议错误。
 * 维护模式只信任完整运行态快照；曾确认维护开启后若快照暂时失效，继续显示维护状态未知，直到新快照明确确认维护已经关闭。
 * 维护模式与 AO 模拟状态组合为右侧徽标；没有徽标时显示电机运行图标。增量刷新前统一清理当前徽标区域，行位置变化时同时清除旧行，避免 OLED 残影。
 * 设备处于错误状态时，在状态文字之后追加由错误类型和错误位置组成的十进制故障码。
 */
static void DIS_Equipment(void)
{
    int row, line;
    uint16_t state = g_measurement.device_status.device_state;
    uint8_t lang = screen_parameter.language;
    bool protocol_compatible = IsCpu2ProtocolCompatible();
    bool protocol_mismatch = IsCpu2ProtocolMismatch();
    bool runtime_snapshot_valid = CPU2_CommHasRuntimeSnapshot();
    bool maintenance_active;
    bool maintenance_unknown;
    bool ao_simulation_active;
    const char *badge_text = NULL;
    uint8_t badge_line = OLED_LINE8_8;
    static bool maintenance_last_confirmed_active = false;
    static bool status_badge_visible = false;
    static uint8_t status_badge_row = OLED_ROW4_1;

    if (lang > 1) lang = 1;
    row = FlagofTotalTwoRow ? OLED_ROW4_2 : OLED_ROW4_1;

    /*
     * 维护态只信任当前完整运行快照。曾确认维护开启后若快照失效，保留维护未知提示，
     * 直到新快照明确确认关闭，避免通信抖动把仍可能有效的维护态显示成普通运行。
     */
    if (runtime_snapshot_valid) {
        maintenance_active = (g_measurement.device_status.maintenance_mode_active != 0U);
        maintenance_last_confirmed_active = maintenance_active;
        maintenance_unknown = false;
    } else {
        maintenance_active = false;
        maintenance_unknown = maintenance_last_confirmed_active;
    }
    ao_simulation_active = runtime_snapshot_valid && protocol_compatible &&
                           (g_measurement.ao_output_runtime.simulation_enabled != 0U);

    if (maintenance_unknown) {
        badge_text = (lang == LANGUAGE_CHINESE) ? "维护?" : "MNT?";
        badge_line = (lang == LANGUAGE_CHINESE) ? OLED_LINE8_7 : OLED_LINE8_6;
    } else if (maintenance_active && ao_simulation_active) {
        badge_text = (lang == LANGUAGE_CHINESE) ? "维模" : "M/S";
        badge_line = (lang == LANGUAGE_CHINESE) ? OLED_LINE8_8 : OLED_LINE8_7;
    } else if (maintenance_active) {
        badge_text = (lang == LANGUAGE_CHINESE) ? "维护" : "MNT";
        badge_line = (lang == LANGUAGE_CHINESE) ? OLED_LINE8_8 : OLED_LINE8_7;
    } else if (ao_simulation_active) {
        badge_text = (lang == LANGUAGE_CHINESE) ? "模拟" : "SIM";
        badge_line = (lang == LANGUAGE_CHINESE) ? OLED_LINE8_8 : OLED_LINE8_7;
    }

    /* 徽标最长四字符，统一清除右侧四列；换行时同时清除旧行，防止增量刷新残留。 */
    if (status_badge_visible && (status_badge_row != (uint8_t)row)) {
        OLED_ClearArea(OLED_LINE8_6,
                       status_badge_row,
                       (uint8_t)(OLED_LINE8_END - OLED_LINE8_6 + 1U),
                       OLED_ROW4_2);
    }
    OLED_ClearArea(OLED_LINE8_6,
                   (uint8_t)row,
                   (uint8_t)(OLED_LINE8_END - OLED_LINE8_6 + 1U),
                   OLED_ROW4_2);

    /* 协议不匹配是整机状态问题，优先覆盖普通运行状态，避免用户只在参数页才看到。 */
    const char *disp_str = protocol_mismatch
                           ? ((lang == LANGUAGE_CHINESE) ? "协议版本不匹配" : "ProtoErr")
                           : GetStateString(state, lang);
    line = OledDisplayLineWords(disp_str, OLED_LINE8_1, row, 0);

    if (state == 0xFFFF) {
		uint16_t err_type = (g_measurement.device_status.error_code >> 16) & 0xFFFF;
		uint16_t err_pos  = g_measurement.device_status.error_code & 0xFFFF;

		char err_text[16];
		snprintf(err_text, sizeof(err_text), "%d-%d", err_type, err_pos);
		line = OledDisplayLineWords(err_text, line, row, 0);
    }

    if (badge_text != NULL) {
        OledDisplayLineWords(badge_text,
                             badge_line,
                             (uint8_t)row,
                             1U);
    } else {
        uint8_t motor_icon_index = GetMotorRunIconIndex();
        write_hanzi16(OLED_LINE8_9, row, MotorRunIcon16Stock,
                      motor_icon_index, motor_icon_index + 1U, 0);
    }
    status_badge_visible = (badge_text != NULL);
    status_badge_row = (uint8_t)row;
}


/**
 * @brief 判断是否需要息屏。
 *
 * @return true 表示需要息屏；false 表示不需要息屏。
 */
static bool ScreenOff( void )
{
    uint32_t now = HAL_GetTick();

    if(screen_parameter.screenoff == 0)
        return false;

    if(flag_bright)
        return false;

    if ((now - display_last_key_tick) < DISPLAY_SCREEN_OFF_IDLE_MS)
        return false;
    
    return true;
}

/**
 * @brief 记录按键唤醒时刻，并在屏幕已经关闭时请求 OLED 刷新。
 */
void SetScreenBright( void )
{
    flag_bright = true;
    display_last_key_tick = HAL_GetTick();
    if (display_screen_off_active) {
        Display_RequestRefresh();
    }
}

/**
 * @brief 清除本轮按键唤醒标志，不直接发送 OLED 关显示命令。
 */
static void SetScreenOffState( void )
{
    flag_bright = false;
}
